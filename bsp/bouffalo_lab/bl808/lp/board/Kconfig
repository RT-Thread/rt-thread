## bsp/cvitek/cv18xx_aarch64/board/Kconfig
```kconfig
menu "General Drivers Configuration"
    config BSP_SUPPORT_FPU
        bool "Using Float"
        default y

    config BSP_USING_GIC
        bool
        default y

    choice
        prompt "GIC Version"
        default BSP_USING_GICV2

        config BSP_USING_GICV2
            bool "GICv2"

        config BSP_USING_GICV3
            bool "GICv3"
    endchoice

    menuconfig BSP_USING_UART
        bool "Using UART"
        select RT_USING_SERIAL
        default y

        if BSP_USING_UART
            config BSP_USING_UART0
                bool "Enable UART 0"
                default y

                if BSP_USING_UART0
                    config BSP_UART0_RX_PINNAME
                        string "uart0 rx pin name"
                        default "UART0_RX"
                    config BSP_UART0_TX_PINNAME
                        string "uart0 tx pin name"
                        default "UART0_TX"
                endif

            config BSP_USING_UART1
                bool "Enable UART 1"
                default n

                if BSP_USING_UART1
                    config BSP_UART1_RX_PINNAME
                        string "uart1 rx pin name"
                        default ""
                    config BSP_UART1_TX_PINNAME
                        string "uart1 tx pin name"
                        default ""
                endif

            config BSP_USING_UART2
                bool "Enable UART 2"
                default n

                if BSP_USING_UART2
                    config BSP_UART2_RX_PINNAME
                        string "uart2 rx pin name"
                        default ""
                    config BSP_UART2_TX_PINNAME
                        string "uart2 tx pin name"
                        default ""
                endif

            config BSP_USING_UART3
                bool "Enable UART 3"
                default n

                if BSP_USING_UART3
                    config BSP_UART3_RX_PINNAME
                        string "uart3 rx pin name"
                        default ""
                    config BSP_UART3_TX_PINNAME
                        string "uart3 tx pin name"
                        default ""
                endif

            config BSP_USING_UART4
                bool "Enable UART 4"
                default n

                if BSP_USING_UART4
                    config BSP_UART4_RX_PINNAME
                        string "uart4 rx pin name"
                        default ""
                    config BSP_UART4_TX_PINNAME
                        string "uart4 tx pin name"
                        default ""
                endif

            config BSP_UART_IRQ_BASE
                int
                default 60
        endif
        
    config BSP_USING_ADC
        bool "Using ADC"
        select RT_USING_ADC
        default n

    config BSP_USING_SPI
        bool "Using SPI"
        select RT_USING_SPI
        default n

    menuconfig BSP_USING_PWM
        bool "Using PWM"
        select RT_USING_PWM
        default n

        if BSP_USING_PWM
            config BSP_USING_PWM0
            bool "Enable PWM 0"
            default n

            config BSP_USING_PWM1
            bool "Enable PWM 1"
            default n

            config BSP_USING_PWM2
            bool "Enable PWM 2"
            default n

            config BSP_USING_PWM3
            bool "Enable PWM 3"
            default n
            
        endif

endmenu
```

## bsp/cvitek/cv18xx_aarch64/dtb/milkv-duo256m/multi.its
```
/*
 * U-Boot uImage source file with multiple kernels, ramdisks and FDT blobs
 */

/dts-v1/;

/ {
	description = "Various kernels, ramdisks and FDT blobs";
	#address-cells = <2>;

	images {
		kernel-1 {
			description = "cvitek kernel";
			data = /incbin/("./Image.lzma");
			type = "kernel";
			arch = "arm64";
			os = "linux";
			compression = "lzma";
			load = <0x0 0x80200000>;
			entry = <0x0 0x80200000>;
			hash-2 {
				algo = "crc32";
			};
		};


		/*FDT*/
    
        fdt-sg2002_milkv_duo256m_arm_sd {
            description = "cvitek device tree - sg2002_milkv_duo256m_arm_sd";
            data = /incbin/("./sg2002_milkv_duo256m_arm_sd.dtb");
            type = "flat_dt";
            arch = "arm64";
            compression = "none";
            hash-1 {
                algo = "sha256";
            };
        };



	};

	/*CFG*/
    configurations {
        
        config-sg2002_milkv_duo256m_arm_sd {
            description = "boot cvitek system with board sg2002_milkv_duo256m_arm_sd";
            kernel = "kernel-1";
            fdt = "fdt-sg2002_milkv_duo256m_arm_sd";
        };

    };


};
```

## bsp/cvitek/cv18xx_risc-v/Kconfig
```kconfig
mainmenu "RT-Thread Project Configuration"

BSP_DIR := .

RTT_DIR := ../../..

PKGS_DIR := packages

source "$(RTT_DIR)/Kconfig"
osource "$PKGS_DIR/Kconfig"
rsource "board/Kconfig"

config BSP_USING_CV18XX
    bool
    select ARCH_RISCV64
    select ARCH_RISCV_FPU_D
    select ARCH_USING_RISCV_COMMON64
    select RT_USING_SYSTEM_WORKQUEUE
    select RT_USING_COMPONENTS_INIT
    select RT_USING_USER_MAIN
    select RT_USING_CACHE
    select ARCH_MM_MMU
    select RT_USING_DEVICE_OPS
    select ARCH_REMAP_KERNEL if RT_USING_SMART
    default y

config C906_PLIC_PHY_ADDR
    hex
    default 0x70000000

config IRQ_MAX_NR
    int
    default 101

config BSP_GPIO_IRQ_BASE
    int
    default 60

config BSP_SYS_GPIO_IRQ_BASE
    int
    default 70

config __STACKSIZE__
    int "stack size for interrupt"
    default 4096

config SOC_TYPE_CV180X
    bool
    default n

config SOC_TYPE_SG2000
    bool
    default n

config SOC_TYPE_SG2002
    bool
    default n

choice
    prompt "Board Type"
    default BOARD_TYPE_MILKV_DUO256M

    config BOARD_TYPE_MILKV_DUO
        select SOC_TYPE_CV180X
        bool "milkv-duo"

    config BOARD_TYPE_MILKV_DUO_SPINOR
        select SOC_TYPE_CV180X
        bool "milkv-duo-spinor"

    config BOARD_TYPE_MILKV_DUO256M
        select SOC_TYPE_SG2002
        bool "milkv-duo256m"

    config BOARD_TYPE_MILKV_DUO256M_SPINOR
        select SOC_TYPE_SG2002
        bool "milkv-duo256m-spinor"

    config BOARD_TYPE_MILKV_DUOS
        select SOC_TYPE_SG2000
        bool "milkv-duos"

endchoice

choice BSP_ROOTFS_TYPE
    prompt "rootfs type"
    default BSP_ROOTFS_TYPE_DISKFS

    config BSP_ROOTFS_TYPE_DISKFS
        bool "Disk FileSystems, e.g. ext4, fat ..."
        select RT_USING_DFS_ROMFS

    config BSP_ROOTFS_TYPE_CROMFS
        bool "CROMFS"
        select RT_USING_DFS_CROMFS
        select PKG_USING_ZLIB
        select PKG_USING_ZLIB_LATEST_VERSION
endchoice
```

## bsp/cvitek/cv18xx_risc-v/board/Kconfig
```kconfig
menu "General Drivers Configuration"

    menuconfig BSP_USING_UART
        bool "Using UART"
        select RT_USING_SERIAL
        default y

        if BSP_USING_UART
            config RT_USING_UART0
            bool "Enable UART 0"
            default y

            config UART_IRQ_BASE
            int
            default 44
            
            config RT_USING_UART1
            bool "Enable UART 1"
            default n

            config RT_USING_UART2
            bool "Enable UART 2"
            default n

            config RT_USING_UART3
            bool "Enable UART 3"
            default n

            config RT_USING_UART4
            bool "Enable UART 4"
            default n

        endif

    menuconfig BSP_USING_I2C
        bool "Using HW I2C"
        select RT_USING_I2C
        select RT_USING_I2C_BITOPS
        select RT_USING_PIN
        default n

        if BSP_USING_I2C
            config BSP_USING_I2C0
                bool "Enable I2C0"
                default n

            config BSP_USING_I2C1
                bool "Enable I2C1"
                default n

            config I2C_IRQ_BASE
            int
            default 49
        endif

    config BSP_USING_ADC
        bool "Using ADC"
        select RT_USING_ADC
        default n

    config BSP_USING_SPI
        bool "Using SPI"
        select RT_USING_SPI
        default n

    menuconfig BSP_USING_WDT
        bool "Enable Watchdog Timer"
        select RT_USING_WDT
        default n

        if BSP_USING_WDT
            config BSP_USING_WDT0
                bool "Enable WDT0"
                default n

            config BSP_USING_WDT1
                bool "Enable WDT1"
                default n

            config BSP_USING_WDT2
                bool "Enable WDT2"
                default n
        endif

    menuconfig BSP_USING_PWM
        bool "Using PWM"
        select RT_USING_PWM
        default n

        if BSP_USING_PWM
            config BSP_USING_PWM0
            bool "Enable PWM 0"
            default n

            config BSP_USING_PWM1
            bool "Enable PWM 1"
            default n

            config BSP_USING_PWM2
            bool "Enable PWM 2"
            default n

            config BSP_USING_PWM3
            bool "Enable PWM 3"
            default n
        endif

    config BSP_USING_SDH
        select RT_USING_SDIO
        select RT_USING_DFS
        select RT_USING_DFS_ELMFAT
        select RT_USING_DFS_ROMFS
        bool "Enable Secure Digital Host Controller"
        default n

    config BSP_USING_ETH
        bool "Enable Ethernet"
        default n
        select RT_USING_LWIP
        select RT_USING_POSIX_FS
        select RT_USING_POSIX_SOCKET

endmenu
```

## bsp/cvitek/cv18xx_risc-v/dtb/milkv-duo/multi.its
```
/*
 * U-Boot uImage source file with multiple kernels, ramdisks and FDT blobs
 */

/dts-v1/;

/ {
	description = "Various kernels, ramdisks and FDT blobs";
	#address-cells = <2>;

	images {
		kernel-1 {
			description = "cvitek kernel";
			data = /incbin/("./Image.lzma");
			type = "kernel";
			arch = "riscv";
			os = "linux";
			compression = "lzma";
			load = <0x0 0x80200000>;
			entry = <0x0 0x80200000>;
			hash-2 {
				algo = "crc32";
			};
		};


		/*FDT*/
    
        fdt-cv1800b_milkv_duo_sd {
            description = "cvitek device tree - cv1800b_milkv_duo_sd";
            data = /incbin/("./cv1800b_milkv_duo_sd.dtb");
            type = "flat_dt";
            arch = "riscv";
            compression = "none";
            hash-1 {
                algo = "sha256";
            };
        };



	};

	/*CFG*/
    configurations {
        
        config-cv1800b_milkv_duo_sd {
            description = "boot cvitek system with board cv1800b_milkv_duo_sd";
            kernel = "kernel-1";
            fdt = "fdt-cv1800b_milkv_duo_sd";
        };

    };


};
```

## bsp/cvitek/cv18xx_risc-v/dtb/milkv_duos_sd/multi.its
```
/*
 * U-Boot uImage source file with multiple kernels, ramdisks and FDT blobs
 */

/dts-v1/;

/ {
	description = "Various kernels, ramdisks and FDT blobs";
	#address-cells = <2>;

	images {
		kernel-1 {
			description = "cvitek kernel";
			data = /incbin/("./Image.lzma");
			type = "kernel";
			arch = "riscv";
			os = "linux";
			compression = "lzma";
			load = <0x0 0x80200000>;
			entry = <0x0 0x80200000>;
			hash-2 {
				algo = "crc32";
			};
		};


		/*FDT*/
    
        fdt-cv1813h_milkv_duos_sd {
            description = "cvitek device tree - cv1813h_milkv_duos_sd";
            data = /incbin/("./cv1813h_milkv_duos_sd.dtb");
            type = "flat_dt";
            arch = "riscv";
            compression = "none";
            hash-1 {
                algo = "sha256";
            };
        };



	};

	/*CFG*/
    configurations {
        
        config-cv1813h_milkv_duos_sd {
            description = "boot cvitek system with board cv1813h_milkv_duos_sd";
            kernel = "kernel-1";
            fdt = "fdt-cv1813h_milkv_duos_sd";
        };

    };


};
```

## bsp/cy8c6347bzi-cy-062/drivers/Kconfig
```kconfig
config RT_USING_UART0
    bool "Enable UART0 (The UART component name is UART0 in the TopDesign of PSoC Creator)"
    default y
```

## bsp/cypress/psoc6-cy8cproto-4343w/board/Kconfig
```kconfig
menu "Hardware Drivers Config"

config SOC_IFX_PSOC6_43012
    bool
    select SOC_SERIES_IFX_PSOC6
    select RT_USING_COMPONENTS_INIT
    select RT_USING_USER_MAIN
    default y

menu "Onboard Peripheral Drivers"

    config BSP_USING_USB_TO_USART
        bool "Enable USB TO USART (uart1)"
        select BSP_USING_UART
        select BSP_USING_UART1
        default y
 
endmenu

menu "On-chip Peripheral Drivers"

    config BSP_USING_GPIO
        bool "Enable GPIO"
        select RT_USING_PIN
        default y

    menuconfig BSP_USING_UART
        bool "Enable UART"
        default y
        select RT_USING_SERIAL
        if BSP_USING_UART
            config BSP_USING_UART1
                bool "Enable UART1"
                default y
        endif

    menuconfig BSP_USING_ADC
        bool "Enable ADC"
        default n
        select RT_USING_ADC
        if BSP_USING_ADC
            config BSP_USING_ADC1
                bool "Enable ADC1"
                default n
        endif    
endmenu

menu "Board extended module Drivers"

endmenu
 
endmenu
```

## bsp/dm365/Kconfig
```kconfig
mainmenu "RT-Thread Configuration"

BSP_DIR := .

RTT_DIR := ../..

PKGS_DIR := packages

source "$(RTT_DIR)/Kconfig"
osource "$PKGS_DIR/Kconfig"

config SOC_DM365
    bool
    select RT_USING_COMPONENTS_INIT
    select RT_USING_USER_MAIN
    default y

comment "BSP configure"

config RT_USING_GPIO_DEVICE
    bool "Using GPIO"
    default y

config RT_USING_I2C_CONTROL
    bool "Using I2C control"
    select RT_USING_I2C
    default y

config RT_USING_SDIO_CONTROL
    bool "Using SDIO control"
    select RT_USING_SDIO
    default y

config RT_USING_SPI_CONTROL
    bool "Using SPI control"
    depends on RT_USING_SPI
    default y

config RT_USING_EMAC
    bool "Using EMAC control"
    depends on RT_USING_LWIP
    default y

config RT_MMU_PTE_SIZE
    int "The first page table for MMU"
    default 4096
```

## bsp/eastsoft/es32f0654/Kconfig
```kconfig
mainmenu "RT-Thread Configuration"

config BSP_DIR
    string
    option env="BSP_ROOT"
    default "."

config RTT_DIR
    string
    option env="RTT_ROOT"
    default "../../.."

config PKGS_DIR
    string
    option env="PKGS_ROOT"
    default "packages"

source "$RTT_DIR/Kconfig"
source "$PKGS_DIR/Kconfig"

choice
    prompt "Device type"
    default ES32F0654LT
    config SOC_ES32F0653LQ
        bool "SOC_ES32F0653LQ"
    config SOC_ES32F0653NQ
        bool "SOC_ES32F0653NQ"
    config SOC_ES32F0653LT
        bool "SOC_ES32F0653LT"
    config SOC_ES32F0653LX
        bool "SOC_ES32F0653LX"
    config SOC_ES32F0654LQ
        bool "SOC_ES32F0654LQ"
    config SOC_ES32F0654NQ
        bool "SOC_ES32F0654NQ"
    config SOC_ES32F0654LT
        bool "SOC_ES32F0654LT"
    config SOC_ES32F0654LX
        bool "SOC_ES32F0654LX"
endchoice

config RT_USING_HOSC
    bool "Using HOSC as clock source"
    default n
config RT_HRC_VALUE
    int "HRC Value"
    default 24000000
    depends on !RT_USING_HOSC

if RT_USING_SERIAL
    config RT_USING_UART0
        bool "Using uart0"
        default n

    config RT_USING_UART1
        bool "Using uart1"
        default n

    config RT_USING_UART2
        bool "Using uart2"
        default y

    config RT_USING_UART3
        bool "Using uart3"
        default n 
endif
```
