## components/drivers/pin/Kconfig
```kconfig
menuconfig RT_USING_PIN
    bool "Using Generic GPIO device drivers"
    default y

config RT_PIN_PL061
    bool "ARM PL061"
    depends on RT_USING_DM
    depends on RT_USING_PIN
    default n

if RT_USING_DM && RT_USING_PIN
    osource "$(SOC_DM_PIN_DIR)/Kconfig"
endif
```

## components/drivers/pin/utest/Kconfig
```kconfig
menu "Pin Test"
    depends on RT_USING_PIN

config RT_UTEST_PIN
    bool "Pin Loopback Test"
    default n

if RT_UTEST_PIN

    config RT_UTEST_PIN_OUT_NAME
        string "Output Pin Name for Pin Test"
        default ""
        help
            Optional hardware pin name, such as PA.0 or P0.12. Leave empty to
            use RT_UTEST_PIN_OUT_NUM.

    config RT_UTEST_PIN_IN_NAME
        string "Input Pin Name for Pin Test"
        default ""
        help
            Optional hardware pin name, such as PA.1 or P0.13. Leave empty to
            use RT_UTEST_PIN_IN_NUM.

    config RT_UTEST_PIN_OUT_NUM
        int "Output Pin Number for Pin Test"
        default -1

    config RT_UTEST_PIN_IN_NUM
        int "Input Pin Number for Pin Test"
        default -1

    config RT_UTEST_PIN_SETTLE_MS
        int "Settle Delay in Milliseconds"
        range 0 1000
        default 2

    config RT_UTEST_PIN_IRQ_TIMEOUT_MS
        int "IRQ Timeout in Milliseconds"
        range 1 60000
        default 500

    config RT_UTEST_PIN_IRQ
        bool "Pin IRQ Loopback Test"
        default y

endif

endmenu
```

## components/drivers/pinctrl/Kconfig
```kconfig
menuconfig RT_USING_PINCTRL
    bool "Using Pin controllers device drivers"
    depends on RT_USING_DM
    depends on RT_USING_PIN
    default n
    help
      Enable the pinctrl framework so pin multiplexing/state tables from the
      device tree can be applied to peripherals (I2C, SPI, LEDs, etc.). Needed
      on SoCs where GPIOs share multiple alternate functions; disable on simple
      MCUs where pins have fixed roles.

config RT_PINCTRL_SCMI
    bool "Pinctrl driver via ARM SCMI interface"
    depends on RT_USING_PINCTRL
    depends on RT_FIRMWARE_ARM_SCMI
    default n

config RT_PINCTRL_SINGLE
    bool "Single Pinctrl driver"
    depends on RT_USING_PINCTRL
    default n

if RT_USING_PINCTRL
    osource "$(SOC_DM_PINCTRL_DIR)/Kconfig"
endif
```

## components/drivers/pm/Kconfig
```kconfig
config RT_USING_PM
    bool "Using Power Management device drivers"
    default n
    help
      Enable the system-level power management framework which coordinates
      suspend/resume, tickless idle, and device low-power states. Required when
      implementing sleep modes beyond simple tick suppression.

    if RT_USING_PM
        config PM_TICKLESS_THRESHOLD_TIME
            int "PM tickless threashold time"
            default 2
            help
              Minimum idle duration (in milliseconds) before the PM core enters
              tickless mode. Tune based on wake-up latency vs power savings.

        config PM_USING_CUSTOM_CONFIG
            bool "PM using custom pm config"
            default n
            help
              Allow BSPs to provide custom PM policy hooks instead of the stock
              configuration.

        config PM_ENABLE_DEBUG
            bool "PM Enable Debug"
            default n
            help
              Print suspend/resume decisions and timing for debugging purposes.

        config PM_ENABLE_SUSPEND_SLEEP_MODE
            bool "PM Device suspend change sleep mode"
            default n
            help
              Permit PM to change system sleep mode dynamically when devices
              suspend; requires board support.

        config PM_ENABLE_THRESHOLD_SLEEP_MODE
            bool "PM using threshold time change sleep mode"
            default n
            help
              Automatically select light/deep/standby sleep based on idle time
              thresholds configured below.

        if PM_ENABLE_THRESHOLD_SLEEP_MODE
            config PM_LIGHT_THRESHOLD_TIME
                int "PM light mode threashold time"
                default 5
                help
                  Idle time in milliseconds required before entering light sleep.

            config PM_DEEP_THRESHOLD_TIME
                int "PM deep mode threashold time"
                default 20
                help
                  Idle duration required before requesting deep sleep.

            config PM_STANDBY_THRESHOLD_TIME
                int "PM standby mode threashold time"
                default 100
                help
                  Idle time before transitioning into standby (longest latency)
                  mode. Increase if standby exit is expensive.
        endif
    endif
```

## components/drivers/pmdomain/Kconfig
```kconfig
if RT_USING_DM
menu "Power Management (PM) Domains device drivers"

    config RT_PMDOMAIN_SCMI
        bool "ARM SCMI"
        depends on RT_FIRMWARE_ARM_SCMI
        default n

    osource "$(SOC_DM_PMDOMAIN_DIR)/Kconfig"
endmenu
endif
```

## components/drivers/power/reset/Kconfig
```kconfig
menuconfig RT_USING_POWER_RESET
    bool "Using Board level reset or poweroff"
    depends on RT_USING_DM

config RT_POWER_RESET_GPIO_POWEROFF
    bool "GPIO poweroff"
    depends on RT_USING_POWER_RESET
    depends on RT_USING_PIN
    depends on RT_USING_PINCTRL

config RT_POWER_RESET_GPIO_RESTART
    bool "GPIO restart"
    depends on RT_USING_POWER_RESET
    depends on RT_USING_PIN
    depends on RT_USING_PINCTRL

config RT_POWER_RESET_SYSCON_POWEROFF
    bool "Generic SYSCON regmap poweroff driver"
    depends on RT_USING_POWER_RESET
    depends on RT_MFD_SYSCON

config RT_POWER_RESET_SYSCON_REBOOT_MODE
    bool "Generic SYSCON regmap reboot mode driver"
    depends on RT_USING_POWER_RESET
    depends on RT_MFD_SYSCON
    select RT_POWER_RESET_REBOOT_MODE

config RT_POWER_RESET_SYSCON_REBOOT
    bool "Generic SYSCON regmap reboot driver"
    depends on RT_USING_POWER_RESET
    depends on RT_MFD_SYSCON

if RT_USING_POWER_RESET
    osource "$(SOC_DM_POWER_RESET_DIR)/Kconfig"
endif

config RT_POWER_RESET_REBOOT_MODE
    bool
    depends on RT_USING_OFW
```

## components/drivers/power/supply/Kconfig
```kconfig
menuconfig RT_USING_POWER_SUPPLY
    bool "Using Power supply class support"
    depends on RT_USING_DM
    select RT_USING_ADT
    select RT_USING_ADT_REF
    select RT_USING_SYSTEM_WORKQUEUE
    default n

config RT_POWER_SUPPLY_DAEMON
    bool "System supply daemon"
    depends on RT_USING_POWER_SUPPLY
    default y

if RT_USING_POWER_SUPPLY
    comment "Power Supply Device Drivers"
endif

config RT_POWER_SUPPLY_EMU
    bool "Emulator battery(thermal)/charger"
    depends on RT_USING_POWER_SUPPLY
    depends on RT_USING_PM
    depends on RT_USING_CONSOLE
    depends on RT_USING_MSH
    depends on RT_USING_CPU_USAGE_TRACER
    default n

config RT_POWER_SUPPLY_CHARGER_GPIO
    bool "GPIO charger"
    depends on RT_USING_POWER_SUPPLY
    depends on RT_USING_PIN
    default y

if RT_USING_POWER_SUPPLY
    osource "$(SOC_DM_POWER_SUPPLY_DIR)/Kconfig"
endif
```

## components/drivers/ptp/Kconfig
```kconfig
menuconfig RT_USING_PTP
    bool "Using Precision Time Protocol (PTP) IEEE 1588 clock support"
    depends on RT_USING_DM
    default n

if RT_USING_PTP
    osource "$(SOC_DM_PTP_DIR)/Kconfig"
endif
```

## components/drivers/regulator/Kconfig
```kconfig
menuconfig RT_USING_REGULATOR
    bool "Using Voltage and Current Regulator"
    select RT_USING_ADT
    select RT_USING_ADT_REF
    depends on RT_USING_DM
    default n
    help
      Enable the regulator framework so power supplies described in the device
      tree can be registered, referenced, and controlled at runtime. With this
      selected, drivers may obtain regulators via `rt_regulator_get()`, request
      enable/disable, or vote for specific voltage/current levels before their
      peripherals start. The framework depends on the driver-model and ADT
      parser because it walks the same device tree phandles. Disable it only
      when the SoC has no controllable supplies and every peripheral is powered
      permanently.

config RT_REGULATOR_FIXED
    bool "Fixed regulator support"
    depends on RT_USING_REGULATOR
    depends on RT_USING_PIN
    depends on RT_USING_PINCTRL
    default y
    help
      Provide the "fixed" regulator type in which the output voltage is defined
      entirely by the hardware (for example a PMIC LDO) and RT-Thread can only
      toggle an optional GPIO enable pin. The driver parses standard device tree
      properties such as `startup-delay-us`, `off-on-delay-us`, `enable-active-
      high`, and also applies any pinctrl state before asserting the output.
      Select this when the board DTS contains `regulator-fixed` nodes; it is
      safe to leave enabled because it only instantiates devices that the DT
      describes.

config RT_REGULATOR_GPIO
    bool "GPIO regulator support"
    depends on RT_USING_REGULATOR
    depends on RT_USING_PIN
    default y
    help
      Allow the framework to emulate simple DAC-like regulators using GPIO banks
      where each output bit selects a discrete voltage/current point. The
      driver reads the `states` table from the device tree and programs the GPIO
      pins accordingly, so peripheral drivers can call `set_voltage()` and let
      the framework choose the closest valid entry. Enable this when your board
      uses GPIO strapping to select regulator levels (common with analog muxes)
      or PMIC power modes; otherwise it adds no runtime cost.

if RT_USING_REGULATOR
    osource "$(SOC_DM_REGULATOR_DIR)/Kconfig"
endif
```

## components/drivers/reset/Kconfig
```kconfig
menuconfig RT_USING_RESET
    bool "Using Reset Controller support"
    depends on RT_USING_DM
    depends on RT_USING_OFW
    default n
    help
      Turn on the reset-controller framework that lets platform drivers acquire
      reset lines by phandle, assert/deassert them, and request pulse sequences.
      This mirrors the Linux-style reset subsystem and requires both the device
      model and flattened device tree parser because controllers and consumers
      are linked by DT properties. Enable it whenever your SoC has shareable
      reset gates (RCC, PRCM, etc.) described in DTS; otherwise peripheral
      drivers such as DMA or watchdog blocks cannot safely leave reset.

config RT_RESET_SIMPLE
    bool "Simple Reset Controller Driver"
    depends on RT_USING_RESET
    default n
    help
      Build the generic MMIO reset controller that toggles bits inside one or
      more memory-mapped registers. The driver supports active-high/-low lines,
      exposes optional delay-based `reset()` callbacks, and covers many SoC
      reset managers listed in its compatible table (STM32 RCC, Allwinner,
      Synopsys DW, Sophgo SG2042, etc.). Select this when your DTS describes
      a `reset-simple`-compatible node or when downstream controllers reuse the
      same register layout; leave it disabled if you rely on a custom reset IP.

if RT_USING_RESET
    osource "$(SOC_DM_RESET_DIR)/Kconfig"
endif
```

## components/drivers/rpmsg/Kconfig
```kconfig
menuconfig RT_USING_RPMSG
    bool "Using Remote Processor Messaging (RPMSG)"
    select RT_USING_DEVICE_IPC
    select RT_USING_SYSTEM_WORKQUEUE
    default n

config RT_RPMSG_CHAR_MSG_MAX
    int "Char device message receive max"
    depends on RT_USING_RPMSG
    default 64

config RT_RPMSG_CHAR_MSG_SIZE_MAX
    int "Char device message size max"
    depends on RT_USING_RPMSG
    default 256

if RT_USING_RPMSG
    osource "$(SOC_DM_RPMSG_DIR)/Kconfig"
endif
```
