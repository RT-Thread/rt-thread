## bsp/stm32/stm32h743-openmv-h7plus/board/Kconfig
```kconfig
menu "Hardware Drivers Config"

    menu "On-chip Peripheral Drivers"

        config BSP_USING_GPIO
            bool "Enable GPIO"
            select RT_USING_PIN
            default y

        menuconfig BSP_USING_UART
            bool "Enable UART"
            default y
            select RT_USING_SERIAL

            if BSP_USING_UART
                config BSP_USING_UART1
                    bool "Enable UART1"
                    default y

                config BSP_UART1_RX_USING_DMA
                    bool "Enable UART1 RX DMA"
                    depends on BSP_USING_UART1 && RT_SERIAL_USING_DMA
                    default n

                config BSP_USING_UART2
                    bool "Enable UART2"
                    default n

                config BSP_UART2_RX_USING_DMA
                    bool "Enable UART2 RX DMA"
                    depends on BSP_USING_UART2 && RT_SERIAL_USING_DMA
                    default n

                config BSP_USING_LPUART1
                    bool "Enable LPUART1"
                    default n

                config BSP_LPUART1_RX_USING_DMA
                    bool "Enable LPUART1 RX DMA"
                    depends on BSP_USING_LPUART1 && RT_SERIAL_USING_DMA
                    default n
            endif

            config BSP_USING_QSPI
                bool "Enable QSPI BUS"
                select RT_USING_QSPI
                select RT_USING_SPI
                default n

            config BSP_USING_ONCHIP_RTC
                bool "Enable RTC"
                select RT_USING_RTC
                default n

        source "$(BSP_DIR)/../libraries/HAL_Drivers/drivers/Kconfig"

    endmenu

    menu "Onboard Peripheral Drivers"

        config BSP_USING_SDRAM
            bool "Enable SDRAM"
            default n

        config BSP_USING_QSPI_FLASH
            bool "Enable QSPI FLASH (W25Q256 qspi)"
            select BSP_USING_QSPI
            select RT_USING_SFUD
            select RT_SFUD_USING_QSPI
            default n

        config BSP_USING_SDMMC
            bool "Enable SDMMC (SD card)"
            select RT_USING_SDIO
            select RT_USING_DFS
            select RT_USING_DFS_ELMFAT
            default n

        config BSP_USING_USBD
            bool "Enable OTGFS as USB device"
            select RT_USING_USB_DEVICE
            default n

        config BSP_USING_OV5640
            bool "Enable camera (ov5640)"
            select BSP_USING_DCMI
            select RT_USING_I2C
            select RT_USING_SOFT_I2C
            select RT_USING_SOFT_I2C1
            select BSP_USING_PWM
            select BSP_USING_PWM1
            select BSP_USING_PWM1_CH1
            default n

        config BSP_USING_DCMI
            bool "Enable DCMI"
            default n

        config RT_USING_I2C
            bool
            default n
            if RT_USING_I2C
                config RT_USING_SOFT_I2C
                    bool "Enable software I2C BUS"
                    default n
                    if RT_USING_SOFT_I2C
                        menuconfig RT_USING_SOFT_I2C1
                            bool "Enable I2C1 Bus (software simulation)"
                            default n
                            if RT_USING_SOFT_I2C1
                                comment "Please refer to the 'bsp_io.h' file to configure the pins"
                                config RT_SOFT_I2C1_SCL_PIN
                                    int "i2c1 scl pin number"                        
                                    range 1 176
                                    default 24
                                config RT_SOFT_I2C1_SDA_PIN
                                    int "i2c1 sda pin number"                                
                                    range 1 176
                                    default 25
                                config RT_SOFT_I2C1_BUS_NAME
                                    string "Bus name"
                                    default "i2c1"
                                config RT_SOFT_I2C1_TIMING_DELAY
                                    int "Timing delay (us)"
                                    range 0 32767
                                    default 10
                                config RT_SOFT_I2C1_TIMING_TIMEOUT
                                    int "Timing timeout (tick)"
                                    range 0 32767
                                    default 10
                            endif
                    endif
            endif

        menuconfig BSP_USING_PWM
            bool "Enable PWM"
            default n
            select RT_USING_PWM
            if BSP_USING_PWM
            menuconfig BSP_USING_PWM1
                bool "Enable timer1 output pwm"
                default n
                if BSP_USING_PWM1
                    config BSP_USING_PWM1_CH1
                        bool "Enable PWM1 channel1"
                        default n
                endif
            endif

    endmenu

endmenu
```

## bsp/stm32/stm32h747-st-discovery/Kconfig
```kconfig
mainmenu "RT-Thread Configuration"

config BSP_DIR
    string
    option env="BSP_ROOT"
    default "."

config RTT_DIR
    string
    option env="RTT_ROOT"
    default "../../.."

config PKGS_DIR
    string
    option env="PKGS_ROOT"
    default "packages"

config SOC_STM32H747XI
    bool
    select SOC_SERIES_STM32H7
    select RT_USING_COMPONENTS_INIT
    select RT_USING_USER_MAIN
    default y

source "$RTT_DIR/Kconfig"
source "$PKGS_DIR/Kconfig"
source "../libraries/Kconfig"

if !RT_USING_NANO
source "board/Kconfig"
endif
```

## bsp/stm32/stm32h747-st-discovery/board/Kconfig
```kconfig
menu "Hardware Drivers Config"

config SOC_STM32H747XI
    bool
    select SOC_SERIES_STM32H7
    select RT_USING_COMPONENTS_INIT
    select RT_USING_USER_MAIN
    default y

menu "Onboard Peripheral Drivers"

endmenu

menu "On-chip Peripheral Drivers"

    config BSP_USING_GPIO
        bool "Enable GPIO"
        select RT_USING_PIN
        default y

    menuconfig BSP_USING_UART
        bool "Enable UART"
        default y
        select RT_USING_SERIAL
        if BSP_USING_UART
            config BSP_USING_UART1
                bool "Enable UART1"
                default y

        endif

    source "../libraries/HAL_Drivers/Kconfig"

endmenu

menu "Board extended module Drivers"

endmenu

endmenu
```

## bsp/stm32/stm32h750-armfly-h7-tool/board/Kconfig
```kconfig
menu "Hardware Drivers Config"

menu "Onboard Peripheral Drivers"

    config BSP_USING_QSPI_FLASH
        bool "Enable QSPI FLASH (W25Q256)"
        select BSP_USING_QSPI
        select RT_USING_SFUD
        select RT_SFUD_USING_QSPI
        default n

    config PHY_USING_LAN8720A
        bool

    menuconfig BSP_USING_ETH
        bool "Enable Ethernet"
        select RT_USING_LWIP
        select PHY_USING_LAN8720A
        default n

    config BSP_USING_LCD
        bool "Enable LCD"
        select BSP_USING_PWM
        default n

    config BSP_USING_ESP32
        bool "Enable ESP32"
        select BSP_USING_UART4
        select RT_USING_AT
        select AT_USING_CLIENT
        select AT_USING_SOCKET
        select PKG_USING_AT_DEVICE
        select AT_DEVICE_USING_ESP32
        default n
endmenu

menu "On-chip Peripheral Drivers"

    config BSP_USING_GPIO
        bool "Enable GPIO"
        select RT_USING_PIN
        default y

    menuconfig BSP_USING_UART
        bool "Enable UART"
        default y
        select RT_USING_SERIAL
        if BSP_USING_UART
            config BSP_STM32_UART_V1_TX_TIMEOUT
                int "UART TX timeout"
                default 6000
                depends on RT_USING_SERIAL_V1
                
            menuconfig BSP_USING_UART1
                bool "Enable UART1"
                default y
                if BSP_USING_UART1
                    config BSP_UART1_RX_USING_DMA
                        bool "Enable UART1 RX DMA"
                        depends on BSP_USING_UART1 && RT_SERIAL_USING_DMA
                        default n

                    config BSP_UART1_TX_USING_DMA
                        bool "Enable UART1 TX DMA"
                        depends on BSP_USING_UART1 && RT_SERIAL_USING_DMA
                        default n

                    config BSP_UART1_RX_BUFSIZE
                        int "Set UART1 RX buffer size"
                        range 64 65535
                        depends on RT_USING_SERIAL_V2
                        default 256

                    config BSP_UART1_TX_BUFSIZE
                        int "Set UART1 TX buffer size"
                        range 0 65535
                        depends on RT_USING_SERIAL_V2
                        default 0

                    config BSP_UART1_DMA_PING_BUFSIZE
                        int "Set UART1 RX DMA ping-pong buffer size"
                        range 32 65535
                        depends on RT_USING_SERIAL_V2 && BSP_UART1_RX_USING_DMA
                        default 64    
                endif

            menuconfig BSP_USING_UART4
                bool "Enable UART4"
                default y
                if BSP_USING_UART4
                    config BSP_UART4_RX_USING_DMA
                        bool "Enable UART4 RX DMA"
                        select RT_SERIAL_USING_DMA
                        default n

                    config BSP_UART4_TX_USING_DMA
                        bool "Enable UART4 TX DMA"
                        select RT_SERIAL_USING_DMA
                        default n

                    config BSP_UART4_RX_BUFSIZE
                        int "Set UART4 RX buffer size"
                        range 64 65535
                        depends on BSP_USING_UART4
                        default 256

                    config BSP_UART4_TX_BUFSIZE
                        int "Set UART4 TX buffer size"
                        range 0 65535
                        depends on BSP_USING_UART4
                        default 0

                    config BSP_UART4_DMA_PING_BUFSIZE
                        int "Set UART4 RX DMA ping-pong buffer size"
                        range 32 65535
                        depends on RT_USING_SERIAL_V2 && BSP_UART4_RX_USING_DMA
                        default 64                        
                endif
        endif

    config BSP_USING_QSPI
        bool "Enable QSPI BUS"
        select RT_USING_QSPI
        select RT_USING_SPI
        default n

    config BSP_QSPI_USING_DMA
        bool "Enable QSPI DMA support"
        default n

    menuconfig BSP_USING_SOFT_I2C
        bool "Enable software I2C (swi2c)"
        default n
        select RT_USING_I2C
        select RT_USING_SOFT_I2C
        if BSP_USING_SOFT_I2C
        menuconfig BSP_USING_SOFT_I2C1
            bool "Enable software I2C1 Bus (swi2c1)"
            default n
            select RT_USING_SOFT_I2C1
            if BSP_USING_SOFT_I2C1
                config RT_SOFT_I2C1_SCL_PIN
                    int "swi2c1 SCL pin number"
                    default 135
                config RT_SOFT_I2C1_SDA_PIN
                    int "swi2c1 SDA pin number"
                    default 95
            endif
        endif
    menuconfig BSP_USING_PWM
        bool "Enable PWM"
        default n
        select RT_USING_PWM
        if BSP_USING_PWM
        menuconfig BSP_USING_PWM2
            bool "Enable timer2 output PWM"
            default n
            if BSP_USING_PWM2
                config BSP_USING_PWM2_CH2
                    bool "Enable PWM2 channel2"
                    default n
            endif
        endif

    menuconfig BSP_USING_ADC
        bool "Enable ADC"
        default n
        select RT_USING_ADC
        if BSP_USING_ADC
            config BSP_USING_ADC1
                bool "Enable ADC1"
                default n

            config BSP_USING_ADC2
                bool "Enable ADC2"
                default n

            config BSP_USING_ADC3
                bool "Enable ADC3"
                default n
        endif

    config BSP_USING_SDIO
        bool "Enable SDIO"
        select RT_USING_SDIO
        select RT_USING_DFS
        default n

    config BSP_USING_USBD
        bool "Enable OTGHS as USB device"
        select RT_USING_USB_DEVICE
        select BSP_USBD_TYPE_HS
        select BSP_USBD_SPEED_HS
        select BSP_USBD_PHY_ULPI
        default n

    source "$(BSP_DIR)/../libraries/HAL_Drivers/drivers/Kconfig"

endmenu

menu "Board extended module Drivers"

endmenu

    config RT_SOFT_I2C1_HAS_PIN_DEFAULT
        bool
        default y if RT_USING_SOFT_I2C1

    config RT_SOFT_I2C1_SCL_PIN_DEFAULT
        int
        default 135 if RT_USING_SOFT_I2C1

    config RT_SOFT_I2C1_SDA_PIN_DEFAULT
        int
        default 95 if RT_USING_SOFT_I2C1

endmenu
```
