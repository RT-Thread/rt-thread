## bsp/nxp/lpc/lpc54608-LPCXpresso/drivers/Kconfig
```kconfig
menu "Hardware Drivers Config"

config SOC_LPC54608
    bool
    select SOC_LPC54608_SERIES
    select RT_USING_COMPONENTS_INIT
    select RT_USING_USER_MAIN
    default y

menu "On-chip Peripheral Drivers"

    config BSP_USING_PIN
        bool "Enable GPIO"
        select RT_USING_PIN
        default y

    config BSP_USING_UART0
        bool "Enable UART0"
        default y

    config BSP_DRV_SDCARD
        bool "Enable SD Card"
        default y

    config BSP_DRV_SDRAM
        bool "Enable SDRAM"
        default y

endmenu

menu "Onboard Peripheral Drivers"

endmenu

menu "Board extended module Drivers"

endmenu

endmenu
```

## bsp/nxp/lpc/lpc55sxx/libraries/template/lpc55s6xxxx/Kconfig
```kconfig
mainmenu "RT-Thread Configuration"

BSP_DIR := .

RTT_DIR := ../../../../..

PKGS_DIR := packages

config SOC_LPC55S6x
    bool
    select ARCH_ARM_CORTEX_M33
    default y

source "$(RTT_DIR)/Kconfig"
osource "$PKGS_DIR/Kconfig"
rsource "../libraries/Kconfig"
rsource "board/Kconfig"
```

## bsp/nxp/lpc/lpc55sxx/lpc55s06_nxp_evk/Kconfig
```kconfig
mainmenu "RT-Thread Configuration"

BSP_DIR := .

RTT_DIR := ../../../../..

PKGS_DIR := packages

config SOC_LPC55S06
    bool
    select ARCH_ARM_CORTEX_M33
    select ARCH_ARM_CORTEX_SECURE
    select PKG_USING_NXP_LPC55S_DRIVER
    default y

source "$(RTT_DIR)/Kconfig"
osource "$PKGS_DIR/Kconfig"
rsource "../Libraries/Kconfig"
rsource "board/Kconfig"
```

## bsp/nxp/lpc/lpc55sxx/lpc55s36_nxp_evk/Kconfig
```kconfig
mainmenu "RT-Thread Configuration"

BSP_DIR := .

RTT_DIR := ../../../../..

PKGS_DIR := packages

config SOC_LPC55S36
    bool
    select ARCH_ARM_CORTEX_M33
    select ARCH_ARM_CORTEX_SECURE
    default y

source "$(RTT_DIR)/Kconfig"
osource "$PKGS_DIR/Kconfig"
rsource "../libraries/Kconfig"
rsource "board/Kconfig"
```

## bsp/nxp/lpc/lpc55sxx/lpc55s69_nxp_evk/board/Kconfig
```kconfig
menu "Hardware Drivers Config"

config SOC_LPC55S6X
    bool
    select SOC_LPC55S6X_SERIES
    select RT_USING_COMPONENTS_INIT
    select RT_USING_USER_MAIN
    default y

menu "On-chip Peripheral Drivers"

    config BSP_USING_DMA
        bool "Enable DMA"
        select RT_USING_DMA
        default n

    config BSP_USING_PIN
        bool "Enable GPIO"
        select RT_USING_PIN
        default y

    menuconfig BSP_USING_UART
        config BSP_USING_UART
            bool "Enable UART"
            select RT_USING_UART
            default y

            if BSP_USING_UART
                config BSP_USING_UART0
                    bool "Enable Flexcomm0 as UART"
                    default y
                    if BSP_USING_UART0
                        choice
                            prompt "Select UART0 badurate"
                            default HW_UART0_BAUDRATE_115200

                            config HW_UART0_BAUDRATE_9600
                                bool "Badurate 9600"

                            config HW_UART0_BAUDRATE_115200
                                bool "Badurate 115200"
                        endchoice
                    endif

                config BSP_USING_UART1
                    bool "Enable Flexcomm1 as UART"
                    default n
                    if BSP_USING_UART1
                    choice
                        prompt "Select UART1 badurate"
                        default HW_UART1_BAUDRATE_115200

                        config HW_UART1_BAUDRATE_9600
                            bool "Badurate 9600"

                        config HW_UART1_BAUDRATE_115200
                            bool "Badurate 115200"
                    endchoice
                endif

                config BSP_USING_UART2
                    bool "Enable Flexcomm2 as UART"
                    default n
                    if BSP_USING_UART2
                        choice
                            prompt "Select UART2 badurate"
                            default HW_UART2_BAUDRATE_115200

                            config HW_UART2_BAUDRATE_9600
                                bool "Badurate 9600"

                            config HW_UART2_BAUDRATE_115200
                                bool "Badurate 115200"
                        endchoice
                    endif
            endif


    menuconfig BSP_USING_I2C
        config BSP_USING_I2C
            bool "Enable I2C"
            select RT_USING_I2C
            default n

            if BSP_USING_I2C
                config BSP_USING_I2C1
                    bool "Enable Flexcomm1 I2C"
                    default n

                    if BSP_USING_I2C1
                        choice
                            prompt "Select I2C1 badurate"
                            default HW_I2C1_BAUDRATE_100kHZ

                            config HW_I2C1_BAUDRATE_100kHZ
                                bool "Badurate 100kHZ"

                            config HW_I2C1_BAUDRATE_400kHZ
                                bool "Badurate 400kHZ"
                        endchoice
                    endif

                config BSP_USING_I2C4
                    bool "Enable Flexcomm4 I2C"
                    default n
                    if BSP_USING_I2C4
                        choice
                            prompt "Select I2C4 badurate"
                            default HW_I2C4_BAUDRATE_100kHZ

                            config HW_I2C4_BAUDRATE_100kHZ
                                bool "Badurate 100kHZ"

                            config HW_I2C4_BAUDRATE_400kHZ
                                bool "Badurate 400kHZ"
                        endchoice
                    endif
            endif
    
    menuconfig BSP_USING_SOFT_I2C
        bool "Enable software I2C bus"
        select RT_USING_I2C
        select RT_USING_I2C_BITOPS
        select RT_USING_PIN
        default n

        if BSP_USING_SOFT_I2C
            config BSP_USING_SOFT_I2C1
                bool "Enable I2C1 Bus (software simulation)"
                default n
                if BSP_USING_SOFT_I2C1
                    comment "Notice: num = 32 * PORTx + PINx + 1"
                    comment "0_15 --> 16; 1_8 --> 41"
                    config BSP_SOFT_I2C1_SCL_PIN
                        int "si2c1 SCL pin number"
                        default 16
                    config BSP_SOFT_I2C1_SDA_PIN
                        int "si2c1 SDA pin number"
                        default 41
                endif

            config BSP_USING_SOFT_I2C2
                bool "Enable I2C2 Bus (software simulation)"
                default n
                if BSP_USING_SOFT_I2C2
                    comment "Notice: num = 32 * PORTx + PINx + 1"
                    comment "0_18 --> 19; 1_10 --> 43"
                    config BSP_SOFT_I2C2_SCL_PIN
                        int "si2c2 SCL pin number"
                        default 19
                    config BSP_SOFT_I2C2_SDA_PIN
                        int "si2c2 SDA pin number"
                        default 43
                endif
        endif

    menuconfig BSP_USING_SPI
        config BSP_USING_SPI
            bool "Enable SPI"
            select RT_USING_SPI
            default n

            if BSP_USING_SPI
                config BSP_USING_SPI3
                    bool "Enable Flexcomm3 as SPI"
                    default n

                config BSP_USING_SPI8
                    bool "Enable Flexcomm8 as High Speed SPI"
                    default n
            endif

    menuconfig BSP_USING_SOFT_SPI
        bool "Enable soft SPI BUS"
        default n
        select RT_USING_PIN
        select RT_USING_SPI_BITOPS
        select RT_USING_SPI
        if BSP_USING_SOFT_SPI
            config BSP_USING_SOFT_SPI1
                bool "Enable soft SPI1 BUS (software simulation)"
                default n
                if BSP_USING_SOFT_SPI1
                    comment "Notice: num = 32 * PORTx + PINx + 1"
                    comment "1_11 --> 44; 0_15 --> 16; 1_8 --> 41"
                    config BSP_S_SPI1_SCK_PIN
                        int "sspi1 SCL pin number"
                        default 44
                    config BSP_S_SPI1_MOSI_PIN
                        int "sspi1 MISO pin number"
                        default 16
                    config BSP_S_SPI1_MISO_PIN
                        int "sspi1 MOSI pin number"
                        default 41
                endif

            config BSP_USING_SOFT_SPI2
                bool "Enable soft SPI2 BUS (software simulation)"
                default n
                if BSP_USING_SOFT_SPI2
                    comment "Notice: num = 32 * PORTx + PINx + 1"
                    comment "1_9 --> 42; 0_18 --> 19; 1_10 --> 43"
                    config BSP_S_SPI2_SCK_PIN
                        int "sspi2 SCL pin number"
                        default 42
                    config BSP_S_SPI2_MOSI_PIN
                        int "sspi2 MISO pin number"
                        default 19
                    config BSP_S_SPI2_MISO_PIN
                        int "sspi2 MOSI pin number"
                        default 43
                endif
        endif
            
    menuconfig BSP_USING_ADC
        config BSP_USING_ADC
            bool "Enable ADC Channel"
            select RT_USING_ADC
            default n

            if BSP_USING_ADC
                config BSP_USING_ADC0_CH0
                    bool "Enable ADC0 Channel0"
                    default n

                config BSP_USING_ADC0_CH1
                    bool "Enable ADC0 Channel1"
                    default n

                config BSP_USING_ADC0_CH8
                    bool "Enable ADC0 Channel8"
                    default n


                config BSP_USING_ADC0_CH13
                    bool "Enable ADC0 Channel13"
                    default n


                config BSP_USING_ADC0_CH26
                    bool "Enable ADC0 Channel26"
                    default n

            endif

    config BSP_USING_SDIO
        bool "Enable SDIO SD Card Interface"
        select RT_USING_SDIO
        select RT_USING_DFS
        select RT_USING_DFS_ELMFAT
        default n

    config BSP_USING_RTC
        bool "Enable RTC"
        select RT_USING_RTC
        default n

    config BSP_USING_WDT
        bool "Enable WatchDog"
        select RT_USING_WDT
        default n

    menuconfig BSP_USING_HWTIMER
        config BSP_USING_HWTIMER
            bool "Enable Timer"
            select RT_USING_HWTIMER
            default n

            if BSP_USING_HWTIMER
                config BSP_USING_CTIMER0
                    bool "Enable CIMER0"
                    default n

                config BSP_USING_CTIMER3
                    bool "Enable CIMER3"
                    default n

                config BSP_USING_CTIMER4
                    bool "Enable CIMER4"
                    default n
            endif

    menuconfig BSP_USING_PWM
        config BSP_USING_PWM
            bool "Enable PWM"
            select RT_USING_PWM
            default n

            if BSP_USING_PWM
                config BSP_USING_CTIMER1_MAT0
                    bool "Enable CIMER1 Match0 as PWM output"
                    default n

                config BSP_USING_CTIMER2_MAT0
                    bool "Enable CIMER2 Match0 as PWM output"
                    default n

                config BSP_USING_CTIMER2_MAT1
                    bool "Enable CIMER2 Match1 as PWM output"
                    default n

                config BSP_USING_CTIMER2_MAT2
                    bool "Enable CIMER2 Match2 as PWM output"
                    default n

                config BSP_USING_CTIMER3_MAT2
                    bool "Enable CIMER3 Match2 as PWM output"
                    default n
            endif
endmenu

menu "Onboard Peripheral Drivers"
    config BSP_USING_MMA8562
        bool "Enable MMA8562"
        select BSP_USING_I2C4
        default n
        if BSP_USING_MMA8562
            config BSP_USING_MMA8562I2C
                string "the device name for 3-Axis Sensor"
                default "i2c4"
        endif

    config BSP_USING_ARDUINO
        bool "Compatible with Arduino Ecosystem (RTduino)"
        select PKG_USING_RTDUINO
        select BSP_USING_UART2
        select BSP_USING_GPIO
        select BSP_USING_ADC
        select BSP_USING_ADC0
        select BSP_USING_ADC0_CH0
        select BSP_USING_PWM
        select BSP_USING_CTIMER1_MAT0
        select BSP_USING_CTIMER2_MAT0
        select BSP_USING_CTIMER2_MAT1
        select BSP_USING_CTIMER2_MAT2
        select BSP_USING_I2C
        select BSP_USING_I2C1
        select RTDUINO_USING_WIRE
        imply RTDUINO_USING_SERVO
        default n

    if BSP_USING_ARDUINO
        config BSP_USING_ARDUINO_AHT10
            bool "Enable Arduino AHT10 sensor library"
            select BSP_USING_I2C1
            select PKG_USING_ARDUINO_ADAFRUIT_AHTX0
            depends on !BSP_USING_AHT10
            default n

        config BSP_USING_ARDUINO_AHT10_DEMO
            bool "Enable Arduino AHT10 sensor library demo"
            select PKG_USING_ARDUINO_MSGQ_C_CPP_DEMO
            depends on BSP_USING_ARDUINO_AHT10
            default n
    endif

endmenu

menu "Board extended module Drivers"
    menuconfig BSP_USING_NXP_LCDM_S
        config BSP_USING_NXP_LCDM_S
            bool "Enable NXP LCD"
            select BSP_USING_LCD
            select BSP_USING_TOUCH
            select BSP_USING_I2C
            select BSP_USING_SPI
            default n

    menuconfig BSP_USING_LCD
        config BSP_USING_LCD
            bool "Enable LCD"
            select BSP_USING_SPI
            default n
            if BSP_USING_LCD
                config BSP_LCD_SPI_BUS
                    string "the spi bus for lcd"
                    default "spi3"
                config BSP_LCD_CS_PIN
                    int "the pin of lcd cs"
                    default 5
                config BSP_LCD_RST_PIN
                    int "the pin of lcd rst"
                    default 55
                config BSP_LCD_DC_PIN
                    int "the pin of lcd dc"
                    default 3
            endif

    menuconfig BSP_USING_TOUCH
        config BSP_USING_TOUCH
            bool "Enable TOUCH"
            select BSP_USING_I2C
            default n
            if BSP_USING_TOUCH
                config BSP_TOUCH_I2C_BUS
                    string "the i2c bus for lcd"
                    default "i2c1"
            endif

    config BSP_USING_LVGL
        bool "Enable LVGL for LCD"
        select PKG_USING_LVGL
        select BSP_USING_NXP_LCDM_S
        default n

    if BSP_USING_LVGL
        config BSP_USING_LVGL_DEMO
            bool "Enable LVGL demo"
            default y
    endif

endmenu

endmenu
```

## bsp/nxp/lpc/lpc824/drivers/Kconfig
```kconfig
menu "Hardware Drivers Config"

config SOC_LPC824
    bool
    select SOC_LPC824_SERIES
    select RT_USING_COMPONENTS_INIT
    select RT_USING_USER_MAIN
    default y

menu "On-chip Peripheral Drivers"

    menuconfig BSP_USING_UART
        bool "Enable UART"
        default n
        select RT_USING_SERIAL
        if BSP_USING_UART
            config BSP_USING_UART0
                bool "Enable UART0"
                default n

            config BSP_USING_UART1
                bool "Enable UART1"
                default n

        endif

endmenu

menu "Onboard Peripheral Drivers"

endmenu

menu "Board extended module Drivers"

endmenu

endmenu
```

## bsp/nxp/mcx/mcxa/Libraries/Kconfig
```kconfig
config SOC_MCX
    bool
    select ARCH_ARM_CORTEX_M33
    select ARCH_ARM_CORTEX_FPU
```
