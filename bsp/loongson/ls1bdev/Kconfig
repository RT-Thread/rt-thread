## bsp/loongson/ls1bdev/Kconfig
```kconfig
mainmenu "RT-Thread Configuration"

BSP_DIR := .

RTT_DIR := ../../..

PKGS_DIR := packages

source "$(RTT_DIR)/Kconfig"
osource "$PKGS_DIR/Kconfig"

config SOC_LS1B
    bool
    select RT_USING_COMPONENTS_INIT
    select RT_USING_USER_MAIN
    default y

config RT_MEM_SIZE
    int "Memory Size (MByte)"
    default 256

config RT_OSC_CLK
    int "Oscillator Clock (Hz)"
    default 25000000

if RT_USING_SERIAL
config RT_USING_UART0
    bool "Using RT_USING_UART0"
    default n
config RT_USING_UART1
    bool "Using RT_USING_UART1"
    default n
config RT_USING_UART2
    bool "Using RT_USING_UART2"
    default n
config RT_USING_UART3
    bool "Using RT_USING_UART3"
    default n
config RT_USING_UART4
    bool "Using RT_USING_UART4"
    default n
config RT_USING_UART5
    bool "Using RT_USING_UART5"
    default y

config RT_UART_RX_BUFFER_SIZE
    int "The rx buffer size"
    default 64 if RT_USING_SERIAL
    default 64
endif
```

## bsp/loongson/ls1cdev/Kconfig
```kconfig
mainmenu "RT-Thread Configuration"

config BSP_DIR
    string
    option env="BSP_ROOT"
    default "."

config RTT_DIR
    string
    option env="RTT_ROOT"
    default "../../.."

config PKGS_DIR
    string
    option env="PKGS_ROOT"
    default "packages"

source "$RTT_DIR/Kconfig"
source "$RTT_DIR/libcpu/mips/common/Kconfig"
source "$PKGS_DIR/Kconfig"

config SOC_LS1C300
    bool
    select RT_USING_COMPONENTS_INIT
    select RT_USING_USER_MAIN
    default y

choice
    prompt "Board Type"
        config RT_LS1C_OPENLOONGSON
            bool "OpenLoongson Board"
        config RT_LS1C_BAICAIBOARD
            bool "Baicai Board"
endchoice

config RT_USING_SELF_BOOT
    bool "Enable RT-Thread run without bootloader"
    default n

if RT_USING_SELF_BOOT
    config RT_SELF_BOOT_DEBUG
    bool "Debug self boot code"
    default n
endif

if RT_USING_SERIAL
config RT_USING_UART2
    bool "Using RT_USING_UART2"
    default y
config RT_USING_UART1
    bool "Using RT_USING_UART1"
    default y
config RT_USING_UART3
    bool "Using RT_USING_UART3"
    default n

config RT_UART_RX_BUFFER_SIZE
    int "The rx buffer size"
    default 64 if RT_USING_SERIAL
    default 64
endif

config RT_USING_GMAC_INT_MODE
    bool "Using RT_USING_GMAC_INT_MODE"
    default y

config RT_USING_SPI0
    bool "Enable SPI0"
    select RT_USING_SPI
    default y

config RT_USING_SPI1
    bool "Enable SPI1"
    select RT_USING_SPI
    default y

if RT_USING_I2C
config RT_USING_I2C1
    bool "Enable I2C1"
    default y

config RT_USING_I2C2
    bool "Enable I2C2"
    default y
endif


config USING_BXCAN0
    bool "Enable CAN0"
    select RT_USING_CAN
    default y

config USING_BXCAN1
    bool "Enable CAN1"
    select RT_USING_CAN
    default y

if RT_USING_CAN
config RT_CAN_USING_HDR
    bool "Using RT_CAN_USING_HDR"
    select RT_USING_CAN
    default y
endif

choice
    prompt "Touch format"
    default NO_TOUCH

    config NO_TOUCH
        bool "with no touch"

if RT_USING_RTGUI
    config XPT2046_USING_TOUCH
        bool "with XPT2046 touch"
endif

    config TINA_USING_TOUCH
        bool "with TINA touch"
endchoice

if RT_USING_RTC
config RT_RTC_NAME
    string "RT_RTC_NAME"
    default "RTC"
endif
```

## bsp/loongson/ls2kdev/Kconfig
```kconfig
mainmenu "RT-Thread Configuration"

BSP_DIR := .

RTT_DIR := ../../..

# you can change the RTT_ROOT default "../../.." to your rtthread_root,
# example : default "F:/git_repositories/rt-thread"

PKGS_DIR := packages

source "$(RTT_DIR)/Kconfig"
source "$(RTT_DIR)/libcpu/mips/common/Kconfig"
osource "$PKGS_DIR/Kconfig"

config SOC_LS2K1000
    bool
    select ARCH_MIPS64
    select RT_USING_CACHE
    select RT_USING_COMPONENTS_INIT
    select RT_USING_USER_MAIN
    select RT_USING_DEVICE
    default y

if RT_USING_SERIAL
config RT_USING_UART0
    bool "Using RT_USING_UART0"
    default y

config RT_USING_UART4
    bool "Using RT_USING_UART4"
    default y
endif
```

## bsp/lpc1114/Kconfig
```kconfig
mainmenu "RT-Thread Configuration"

config BSP_DIR
    string
    option env="BSP_ROOT"
    default "."

config RTT_DIR
    string
    option env="RTT_ROOT"
    default "../.."

# you can change the RTT_ROOT default "../.." to your rtthread_root,
# example : default "F:/git_repositories/rt-thread"

config PKGS_DIR
    string
    option env="PKGS_ROOT"
    default "packages"

source "$RTT_DIR/Kconfig"
source "$PKGS_DIR/Kconfig"

config SOC_LPC1114
    bool
    select ARCH_ARM_CORTEX_M0
    select RT_USING_COMPONENTS_INIT
    select RT_USING_USER_MAIN
    default y

#source "$BSP_DIR/drivers/Kconfig"
```

## bsp/lpc176x/drivers/Kconfig
```kconfig
config RT_USING_UART0
    bool "Enable UART0"
    default y


	config RT_UART_RX_BUFFER_SIZE
		int "The buffer size for UART reception"
		default 64
```

## bsp/lpc2148/Kconfig
```kconfig
mainmenu "RT-Thread Project Configuration"

config BSP_DIR
    string
    option env="BSP_ROOT"
    default "."

# default 中的内容要灵活更改
config RTT_DIR
    string
    option env="RTT_ROOT"
    default "../.."

config PKGS_DIR
    string
    option env="PKGS_ROOT"
    default "packages"

source "$RTT_DIR/Kconfig"
source "$PKGS_DIR/Kconfig"

config SOC_LPC2148
    bool
    select ARCH_ARM
    default y
```

## bsp/lpc408x/drivers/Kconfig
```kconfig
menu "Hardware Drivers Config"

    menu "On-chip Peripheral Drivers"

        config BSP_USING_EMAC
            bool "EMAC driver"
            select RT_USING_LWIP
            default n

        config BSP_USING_HWTIMER0
            bool "Using timer0"
            select RT_USING_HWTIMER
            default n

        config BSP_USING_ADC
            bool "Using ADC"
            select RT_USING_ADC
            default n

        menu "UART Drivers"
            config BSP_USING_UART0
                bool "Enable UART0 P0.2/P0.3(T/R)"
                select RT_USING_SERIAL
                default y

            config BSP_USING_UART2
                bool "Enable UART2 P2.8/P0.11(T/R)"
                select RT_USING_SERIAL
                default n

        endmenu

    endmenu

    menu "Onboard Peripheral Drivers"

        config BSP_USING_SDRAM
            bool "Enable sdram"
            default n

        config BSP_USING_LED
            bool "Enable LED"
            default n
    endmenu

    menu "Offboard Peripheral Drivers"

    endmenu

endmenu
```

## bsp/lpc54114-lite/Kconfig
```kconfig
mainmenu "RT-Thread Configuration"

config BSP_DIR
    string
    option env="BSP_ROOT"
    default "."

config RTT_DIR
    string
    option env="RTT_ROOT"
    default "../.."

config PKGS_DIR
    string
    option env="PKGS_ROOT"
    default "packages"

source "$RTT_DIR/Kconfig"
source "$PKGS_DIR/Kconfig"

config SOC_LPC54114
    bool 
    select ARCH_ARM_CORTEX_M4
    select RT_USING_COMPONENTS_INIT
    select RT_USING_USER_MAIN
    default y


source "$BSP_DIR/drivers/Kconfig"
```

## bsp/lpc54114-lite/drivers/Kconfig
```kconfig
# LPC54110 bsp Config
menu "LPC54110 Bsp Config"

    menu "Select uart drivers"
        config BSP_USING_UART0
            bool "Enable UART0"
            default y
    endmenu

    menu "Select spi bus drivers"
        config BSP_USING_SPI2
            bool "Enable SPI2"
            default y
    endmenu

    menu "Select i2c bus drivers"
        config BSP_USING_I2C4
            bool "Enable I2C4"
            default y
    endmenu

    config BSP_USING_ROMFS
        bool "Enable ROMFS"
        select RT_USING_DFS
        select RT_USING_DFS_ROMFS
        default y

    config BSP_USING_SDCARD
        bool "Enable SDCARD"
        select BSP_USING_SPI2
        default y

    config BSP_USING_SPIFLASH
        bool "Enable SPI Flash"
        select BSP_USING_SPI2
        default y

    config BSP_USING_AUDIO
        bool "Enable Audio(WM8904&SPH0641LU4H)"
        select RT_USING_AUDIO
        default n

        if BSP_USING_AUDIO
        config BSP_USING_AUDIO_REPLAY
            bool "Enable WM8904(only replay)"
            select BSP_USING_I2C4
            default y

        config BSP_USING_AUDIO_RECORD
            bool "Enable SPH0641LU4H"
            default y
        endif
endmenu
```

## bsp/lpc54608-LPCXpresso/drivers/Kconfig
```kconfig
config RT_USING_UART0
    bool "Enable UART0"
    default y

config RT_DFS_ELM_REENTRANT
    bool "Enable SD Card"
    default y 

config USE_EXT_SDRAM
bool "Enable SDRAM"
default y 
```

## bsp/lpc55sxx/Libraries/Kconfig
```kconfig
config SOC_LPC55S28_SERIES
    bool
    select ARCH_ARM_CORTEX_M33
    select ARCH_ARM_CORTEX_FPU

config SOC_LPC55S69_SERIES
    bool
    select ARCH_ARM_CORTEX_M33
    select ARCH_ARM_CORTEX_FPU

config SOC_LPC55S06_SERIES
    bool
    select ARCH_ARM_CORTEX_M33
    select ARCH_ARM_CORTEX_FPU
```

## bsp/lpc55sxx/lpc55s06_nxp_evk/Kconfig
```kconfig
mainmenu "RT-Thread Configuration"

config BSP_DIR
    string
    option env="BSP_ROOT"
    default "."

config RTT_DIR
    string
    option env="RTT_ROOT"
    default "../../.."

config PKGS_DIR
    string
    option env="PKGS_ROOT"
    default "packages"

config SOC_LPC55S06
    bool
    select ARCH_ARM_CORTEX_M33
    select ARCH_ARM_CORTEX_SECURE
    default y

source "$RTT_DIR/Kconfig"
source "$PKGS_DIR/Kconfig"
source "../Libraries/Kconfig"
source "board/Kconfig"
```

## bsp/lpc55sxx/lpc55s69_nxp_evk/Kconfig
```kconfig
mainmenu "RT-Thread Configuration"

config BSP_DIR
    string
    option env="BSP_ROOT"
    default "."

config RTT_DIR
    string
    option env="RTT_ROOT"
    default "../../.."

config PKGS_DIR
    string
    option env="PKGS_ROOT"
    default "packages"

config SOC_LPC55S6x
    bool 
    select ARCH_ARM_CORTEX_M33
    default y

source "$RTT_DIR/Kconfig"
source "$PKGS_DIR/Kconfig"
source "../libraries/Kconfig"
source "board/Kconfig"
```
