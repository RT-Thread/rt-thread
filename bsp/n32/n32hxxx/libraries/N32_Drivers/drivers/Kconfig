## bsp/novosns/ns800/ns800rt7p65-nssinepad/board/Kconfig
```kconfig
menu "On-chip Peripheral Drivers"

    menuconfig BSP_USING_GPIO
        bool "Enable GPIO"
        select RT_USING_PIN
        default y
        if BSP_USING_GPIO
            config BSP_GPIO_PIN_IRQ
                bool "Enable GPIO pin IRQ hooks"
                default n
        endif

    menuconfig BSP_USING_UART
        bool "Enable UART"
        default y
        select RT_USING_SERIAL
        if BSP_USING_UART
            config BSP_NS800_UART_TX_TIMEOUT
                int "UART TX timeout"
                default 6000
                depends on !RT_USING_SERIAL_V2

            config BSP_UART_DEFAULT_BAUDRATE
                int "UART default baudrate"
                default 115200
                help
                    Default baudrate for all UART ports.

            choice BSP_UART_DEFAULT_DATABITS
                prompt "UART default data bits"
                default BSP_UART_DATABITS_8
                config BSP_UART_DATABITS_7
                    bool "7 bits"
                config BSP_UART_DATABITS_8
                    bool "8 bits"
                config BSP_UART_DATABITS_9
                    bool "9 bits"
            endchoice

            choice BSP_UART_DEFAULT_STOPBITS
                prompt "UART default stop bits"
                default BSP_UART_STOPBITS_1
                config BSP_UART_STOPBITS_1
                    bool "1 bit"
                config BSP_UART_STOPBITS_2
                    bool "2 bits"
            endchoice

            menuconfig BSP_USING_UART1
                bool "Enable UART1"
                default y
                if BSP_USING_UART1
                    config BSP_UART1_RX_BUFSIZE
                        int "UART1 RX buffer size"
                        range 64 65535
                        depends on RT_USING_SERIAL_V2
                        default 256

                    config BSP_UART1_TX_BUFSIZE
                        int "UART1 TX buffer size"
                        range 0 65535
                        depends on RT_USING_SERIAL_V2
                        default 0
                endif

            menuconfig BSP_USING_UART2
                bool "Enable UART2"
                default n
                if BSP_USING_UART2
                    config BSP_UART2_RX_BUFSIZE
                        int "UART2 RX buffer size"
                        range 64 65535
                        depends on RT_USING_SERIAL_V2
                        default 256

                    config BSP_UART2_TX_BUFSIZE
                        int "UART2 TX buffer size"
                        range 0 65535
                        depends on RT_USING_SERIAL_V2
                        default 0
                endif

            menuconfig BSP_USING_UART3
                bool "Enable UART3"
                default n
                if BSP_USING_UART3
                    config BSP_UART3_RX_BUFSIZE
                        int "UART3 RX buffer size"
                        range 64 65535
                        depends on RT_USING_SERIAL_V2
                        default 256

                    config BSP_UART3_TX_BUFSIZE
                        int "UART3 TX buffer size"
                        range 0 65535
                        depends on RT_USING_SERIAL_V2
                        default 0
                endif

            menuconfig BSP_USING_UART4
                bool "Enable UART4"
                default n
                if BSP_USING_UART4
                    config BSP_UART4_RX_BUFSIZE
                        int "UART4 RX buffer size"
                        range 64 65535
                        depends on RT_USING_SERIAL_V2
                        default 256

                    config BSP_UART4_TX_BUFSIZE
                        int "UART4 TX buffer size"
                        range 0 65535
                        depends on RT_USING_SERIAL_V2
                        default 0
                endif
        endif

    menuconfig BSP_USING_ECAP
        bool "Enable ECAP"
        default n
        if BSP_USING_ECAP
            menuconfig BSP_USING_ECAP1
                bool "Enable ECAP1"
                default n
            
            menuconfig BSP_USING_ECAP2
                bool "Enable ECAP2"
                default n

            menuconfig BSP_USING_ECAP3
                bool "Enable ECAP3"
                default n
            
            menuconfig BSP_USING_ECAP4
                bool "Enable ECAP4"
                default n

            menuconfig BSP_USING_ECAP5
                bool "Enable ECAP5"
                default n

            menuconfig BSP_USING_ECAP6
                bool "Enable ECAP6"
                default n

            menuconfig BSP_USING_ECAP7
                bool "Enable ECAP7"
                default n
        endif

    menuconfig BSP_USING_ADC
        bool "Enable ADC"
        select RT_USING_ADC
        default n

    menuconfig BSP_USING_CAN
        bool "Enable CAN"
        select RT_USING_CAN
        default n
        if BSP_USING_CAN
            config BSP_USING_CANFD1
                bool "Enable CANFD1"
                select RT_CAN_USING_CANFD
                default n

        endif

    menuconfig BSP_USING_TIM
        bool "Enable TIM (Hardware Timer)"
        select RT_USING_CLOCK_TIME
        default n
        help
            Enable hardware timer TIM driver

    if BSP_USING_TIM
        menu "TIM Timer Configuration"
            config BSP_USING_TIM1
                bool "Enable TIM1"
                default n
            config BSP_USING_TIM2
                bool "Enable TIM2"
                default n
        endmenu

    endif

    menuconfig BSP_USING_SPI
        bool "Enable SPI"
        select RT_USING_SPI
        default n
        if BSP_USING_SPI
            menuconfig BSP_USING_SPI1
                bool "Enable SPI1"
                default n

            menuconfig BSP_USING_SPI2
                bool "Enable SPI2"
                default n

            menuconfig BSP_USING_SPI3
                bool "Enable SPI3"
                default n

            menuconfig BSP_USING_SPI4
                bool "Enable SPI4"
                default n
        endif

endmenu
```

## bsp/nrf5x/libraries/templates/nrfx/board/Kconfig
```kconfig
menu "Hardware Drivers Config"

config SOC_NRF52840
    bool
    select RT_USING_COMPONENTS_INIT
    select RT_USING_USER_MAIN
    default y
    
config SOC_NORDIC
    bool 
    default y

choice
    prompt "Select BSP board "
    default BSP_BOARD_PCA_10056

    config BSP_BOARD_PCA_10056
        bool "NRF52840 pca10056 "
        
endchoice

menu "On-chip Peripheral Drivers"    
    config BSP_USING_UART
		bool "Enable UART"
        default y
        select RT_USING_SERIAL
            config BSP_USING_UART0
                bool "Enable UART0"
                default y 
                depends on BSP_USING_UART
                
                config BSP_UART0_RX_PIN
                    depends on BSP_USING_UART0
                    int "uart0 rx pin number"
                    default 8 if BSP_BOARD_PCA_10056
                    
                config BSP_UART0_TX_PIN
                    depends on BSP_USING_UART0
                    int "uart0 tx pin number"
                    default 6 if BSP_BOARD_PCA_10056

    menu "On-chip flash config"

        config MCU_FLASH_START_ADDRESS  
            hex "MCU FLASH START ADDRESS"
            default 0x00000000

        config MCU_FLASH_SIZE_KB  
            int "MCU FLASH SIZE, MAX size 1024 KB"
            default 1024

        config MCU_SRAM_START_ADDRESS 
            hex "MCU RAM START ADDRESS"
            default 0x20000000

        config MCU_SRAM_SIZE_KB  
            int "MCU RAM SIZE"
            default 256

        config MCU_FLASH_PAGE_SIZE 
            hex "MCU FLASH PAGE SIZE, please not change,nrfx default is 0x1000"
            default 0x1000
	endmenu

endmenu

if SOC_NORDIC
    config NRFX_CLOCK_ENABLED
    int 
    default 1
    config    NRFX_CLOCK_DEFAULT_CONFIG_IRQ_PRIORITY
    int 
    default 7
    config NRFX_CLOCK_CONFIG_LF_SRC
    int 
    default 1    
endif

if BSP_USING_UART
    config NRFX_USING_UART
    bool
    default y
    
    config NRFX_UART_ENABLED
    int 
    default 1
    
    config NRFX_UART0_ENABLED
    int 
    default 1
    depends on BSP_USING_UART0
endif


endmenu
```

## bsp/nrf5x/nrf51822/board/Kconfig
```kconfig
menu "Hardware Drivers Config"

config SOC_NRF52840
    bool
    select RT_USING_COMPONENTS_INIT
    select RT_USING_USER_MAIN
    default y
    config NRFX_CLOCK_ENABLED
    int 
    default 1
    config    NRFX_CLOCK_DEFAULT_CONFIG_IRQ_PRIORITY
    int 
    default 7
    config NRFX_CLOCK_CONFIG_LF_SRC
    int 
    default 1  

    
config SOC_NORDIC
    bool 
    config SOC_NORDIC
    default y

menu "On-chip Peripheral Drivers"
    config BSP_USING_GPIO
        bool "Enable GPIO"
        select RT_USING_PIN
        default y
    if BSP_USING_GPIO
        config NRFX_GPIOTE_ENABLED
        int 
        default 1  
    endif
    
    config BSP_USING_UART
		bool "Enable UART"
        default y
        select RT_USING_SERIAL
		if BSP_USING_UART
		choice
		prompt "UART or UARTE"
		default NRFX_USING_UART
		help
			Select the UART or UARTE
		config NRFX_USING_UART
			bool "UART"
		
		config NRFX_USING_UARTE
			bool "UARTE"
		endchoice
		endif
        if BSP_USING_UART&&NRFX_USING_UART
            config NRFX_UART_ENABLED
            int 
            default 1

            config BSP_USING_UART0
                bool "Enable UART0"
                default y 
                if BSP_USING_UART0
                    config NRFX_UART0_ENABLED
                    int 
                    default 1
                    config BSP_UART0_RX_PIN
                        int "uart0 rx pin number"
                        range 0 31
                        default 8
                    config BSP_UART0_TX_PIN
                        int "uart0 tx pin number"
                        range 0 31
                        default 6
                endif
        endif
        if BSP_USING_UART&&NRFX_USING_UARTE
            config NRFX_UARTE_ENABLED
            int 
            default 1

            config BSP_USING_UART0
                bool "Enable UARTE0"
                default n 
                if BSP_USING_UART0
                    config NRFX_UARTE0_ENABLED
                    int 
                    default 1
                    config BSP_UART0_RX_PIN
                        int "uarte0 rx pin number"
                        range 0 31
                        default 8
                    config BSP_UART0_TX_PIN
                        int "uarte0 tx pin number"
                        range 0 31
                        default 6
                endif
            config BSP_USING_UART1
                bool "Enable UARTE1"
                default n 
                if BSP_USING_UART1
                    config NRFX_UARTE1_ENABLED
                    int 
                    default 1
                    config BSP_UART1_RX_PIN
                        int "uarte1 rx pin number"
                        range 0 31
                        default 7
                    config BSP_UART1_TX_PIN
                        int "uarte1 tx pin number"
                        range 0 31
                        default 5
                endif
        endif
    menu "On-chip flash config"

        config MCU_FLASH_START_ADDRESS  
            hex "MCU FLASH START ADDRESS"
            default 0x00000000

        config MCU_FLASH_SIZE_KB  
            int "MCU FLASH SIZE, MAX size 1024 KB"
            range 1 1024
            default 1024		

        config MCU_SRAM_START_ADDRESS 
            hex "MCU RAM START ADDRESS"
            default 0x20000000

        config MCU_SRAM_SIZE_KB 
            int "MCU RAM SIZE, MAX size 256 KB"
            range 1 256
            default 256

        config MCU_FLASH_PAGE_SIZE 
            hex "MCU FLASH PAGE SIZE, please not change,nrfx default is 0x1000"
            range 0x1000 0x1000
            default 0x1000
	endmenu

endmenu


endmenu
```
