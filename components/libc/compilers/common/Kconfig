## components/mm/Kconfig
```kconfig
menu "Memory management"

config RT_PAGE_AFFINITY_BLOCK_SIZE
    hex "Affinity block size in bytes for page management"
    default 0x1000
    help
        Page affinity block can be used to resolve the VIPT aliasing problem.
        It should be set to `1ul << ((index + block) - page_offset)` in this case.
        You could also exploit this as a tunning for cache coloring.

config RT_USING_MEMBLOCK
    bool "Using memblock"
    default n
    help
        Using memblock to record memory infomation in init time

config RT_INIT_MEMORY_REGIONS
    int "The max number of memory block regions in init time"
    depends on RT_USING_MEMBLOCK
    range 1 1024
    default 128
    help
        During the system initialization phase, the kernel divides
        memory into different types of regions. This variable specifies
        the maximum number of regions supported by the system.

config RT_DEBUGGING_ALIASING
    bool "Using aliasing paging debugger"
    default n

endmenu
```

## components/mp/Kconfig
```kconfig
menu "Memory protection"

config RT_USING_MEM_PROTECTION
    bool "Enable memory protection"
    default n

config RT_USING_HW_STACK_GUARD
    bool "Enable hardware stack guard"
    default n
    select RT_USING_MEM_PROTECTION

endmenu
```

## components/net/KConfig
```kconfig
menu "Network stack"

menu "light weight TCP/IP stack"
config RT_USING_LWIP
	bool "Enable lwIP stack"
	default n

	if RT_USING_LWIP
		choice 
			prompt "lwIP version"
			default RT_USING_LWIP141
			help 
				Select the lwIP version

			config RT_USING_LWIP141
				bool "lwIP v1.4.1"

			config RT_USING_LWIP200
				bool "lwIP v2.0.0"

			config RT_USING_LWIP202
				bool "lwIP v2.0.2"
		endchoice

		config RT_LWIP_IGMP
			bool "IGMP protocol"
			default n

		config RT_LWIP_ICMP
			bool "ICMP protocol"
			default y

		config RT_LWIP_SNMP
			bool "SNMP protocol"
			default n

		config RT_LWIP_DNS
			bool "Enble DNS for name resolution"
			select RT_LWIP_UDP
			default y

		config RT_LWIP_DHCP
			bool "Enable alloc ip address through DHCP"
			select RT_LWIP_UDP
			default y

		config RT_LWIP_UDP
			bool "UDP protocol"
			default y

		config RT_LWIP_TCP
			bool "TCP protocol"
			default y

		config RT_LWIP_PPP
			bool "PPP protocol"
			default n

		config RT_LWIP_PPPOE
			bool "PPPoE protocol"
			default n

		config RT_LWIP_PPPOS
			bool "PPPoS protocol"
			default n

		config RT_LWIP_RAW_PCB_NUM
			int "the number of raw connection"
			default 4

		config RT_LWIP_UDP_PCB_NUM
			int "the number of UDP socket"
			default 4

		if RT_LWIP_TCP
		config RT_LWIP_TCP_PCB_NUM
			int "the number of TCP socket"
			default 4

		config RT_LWIP_TCP_SEG_NUM
			int "the number of TCP segment"
			default 4

		config RT_LWIP_TCP_SND_BUF
			int "the size of send buffer"
			default 8196

		config RT_LWIP_TCP_WND
			int "the size of TCP send window"
			default 8196
		endif

		config RT_LWIP_TCPTHREAD_PRIORITY
			int "the priority level value of lwIP thread"
			default 10

		config RT_LWIP_TCPTHREAD_MBOX_SIZE
			int "the number of mail in the lwIP thread mailbox"
			default 8

		config RT_LWIP_TCPTHREAD_STACKSIZE
			int "the stack size of lwIP thread"
			default 1024

		config RT_LWIP_REASSEMBLY_FRAG
			bool "Enable IP reassembly and frag"
			default n

		config SO_REUSE
			bool "Enable SO_REUSEADDR option"
			default n

		config LWIP_SO_RCVTIMEO
			bool "Enable receive timeout for sockets/netconns and SO_RCVTIMEO processing."
			default n

		config LWIP_SO_SNDTIMEO
			bool "Enable send timeout for sockets/netconns and SO_SNDTIMEO processing."
			default n

		config LWIP_SO_RCVBUF
			bool "Enable SO_RCVBUF processing"
			default n
	endif

endmenu

source "$RTT_DIR/components/net/freemodbus/KConfig"

endmenu
```

## components/net/at/Kconfig
```kconfig
menuconfig RT_USING_AT
    bool "Enable AT commands"
    default n
    help
        RT_USING_AT is the master switch for the "AT command framework" in the RT-Thread system.
        The AT command component provides a standardized framework for AT command parsing, registration, and response, adapting to various peripherals that support AT commands.
       
        It is disabled by default.

if RT_USING_AT

    config AT_DEBUG
        bool "Enable debug log output"
        default n
        help
            AT_DEBUG is a switch that enables debug logging output for the AT command framework.
            When enabled, it prints logs of AT commands, including "sent/received content," "parsing process," "response result," and "error reason."

            It is disabled by default.

    config AT_USING_SERVER
        bool "Enable AT commands server"
        default n
        help
            AT_USING_SERVERAT is the AT server function switch.
            Its core function is to expand the AT command framework from "local serial port interaction mode" to "network/multi-channel service mode."
            When enabled, AT commands are no longer limited to local serial port transmission and reception.
            They can also receive and respond to AT commands through network channels such as TCP/UDP/virtual serial ports, enabling "remote AT debugging/control."

            It is disabled by default.

    if AT_USING_SERVER

        config AT_SERVER_DEVICE
            string "Server device name"
            default "uart3"
            help
                The core function of AT_SERVER_DEVICE is to specify the "underlying data transceiver device name" of the AT server.
                The command interaction of the AT server ultimately needs to be bound to a physical/virtual device as a data channel (such as a serial port or network device).

                By default, it is "uart3".

        config AT_SERVER_RECV_BUFF_LEN
            int "The maximum length of server data accepted"
            default 256
            help    
                The core function of AT_SERVER_RECV_BUFF_LEN is to define the "maximum buffer length" for the AT server to receive a single AT command.
                When receiving remote/serial AT commands, the AT server first stores the data in this buffer, and then parses it after the command is fully received.

                The default value is 256.

        config AT_SERVER_SEND_BUFF_LEN
            int "The maximum length of server commands buffer"
            default 256
            help
                The core function of AT_SERVER_SEND_BUFF_LEN is to define the "maximum buffer length" for the AT server to send AT command responses/issue commands.
                When the AT server returns command responses to a remote terminal/serial port or issues AT commands to a module, it first stores the data in this buffer before sending it in batches.

                The default value is 256.

    endif

    config AT_USING_CLIENT
        bool "Enable AT commands client"
        default n
        help
            The core function of AT_USING_CLIENT is to switch the AT framework from a "passive command response mode" to an "active command initiation mode."
            When enabled, the AT framework can act as an "AT client," actively sending AT commands to external AT devices and waiting for/parsing responses.

            It is disabled by default.

    if AT_USING_CLIENT

        config AT_CLIENT_NUM_MAX
            int "The maximum number of supported clients"
            default 1
            range 1 65535
            help
                The core function of AT_CLIENT_NUM_MAX is to define the maximum number of AT client instances that can be created simultaneously within the AT framework.

                By default, the value range is 1-65535.

        config AT_USING_SOCKET
            bool "Enable BSD Socket API support by AT commnads"
            select RT_USING_SAL
            select SAL_USING_AT
            default n
            help


        if AT_USING_SOCKET

            config AT_USING_SOCKET_SERVER
                bool "Enable BSD Socket API support about AT server"
                default n
                help    
                    AT_USING_SOCKET is an AT socket adaptation switch within the AT command framework. Its core function is to enable the AT framework to provide a "BSD Socket standard API wrapper."
                    When enabled, network modules adapted to AT commands can directly call the standard BSD Socket API without needing to concern themselves with the underlying AT command details.

                    It is disabled by default; enabling it will also enable RT_USING_SAL and SAL_USING_AT.

        endif

    endif

    if AT_USING_SERVER || AT_USING_CLIENT

        config AT_USING_CLI
            bool "Enable CLI(Command-Line Interface) for AT commands"
            default y
            depends on RT_USING_FINSH
            help    
                AT_USING_CLI is the AT command-line interaction switch within the AT framework.
                Its core function is to integrate AT commands into the RT-Thread FinSH command-line console.
                When enabled, AT commands can be entered directly in the FinSH terminal without requiring an additional serial port/network channel.

                It is enabled by default, but RT_USING_FINSH must be enabled.

       config AT_PRINT_RAW_CMD
            bool "Enable print RAW format AT command communication data"
            default n
            help    
                AT_PRINT_RAW_CMD is a switch for printing raw AT data within the AT command framework.
                Its core function is to print the raw binary/character data during AT command interaction.
                When enabled, it outputs unfiltered, unformatted AT transmit and receive data.

                It is disabled by default.

    endif

    config AT_SW_VERSION_NUM
        hex
        default 0x10301
        help
            software module version number

endif
```

## components/net/freemodbus/KConfig
```kconfig
menu "Modbus master and slave stack"

config RT_USING_MODBUS
	bool "Enable Modbus stack"
	default n

	if RT_USING_MODBUS
		config RT_MODBUS_MASTER_RTU
			bool "RTU master mode"
			default n

		config RT_MODBUS_SLAVE_RTU
			bool "RTU slave mode"
			default n
	endif

endmenu
```

## components/net/freemodbus/Kconfig
```kconfig
menu "Modbus master and slave stack"

config RT_USING_MODBUS
    bool "Enable Modbus stack"
    default n

    if RT_USING_MODBUS
        config RT_MODBUS_MASTER_RTU
            bool "RTU master mode"
            default n

        config RT_MODBUS_SLAVE_RTU
            bool "RTU slave mode"
            default n
            if RT_MODBUS_SLAVE_RTU
                config RT_MODBUS_SLAVE_USE_CONTROL_PIN
                    bool "Use Contorl Pin"
                    default n
                    if RT_MODBUS_SLAVE_USE_CONTROL_PIN
                        config MODBUS_SLAVE_RT_CONTROL_PIN_INDEX
                            int "pin index for RS485 TX/RX select"
                            default 10
                    endif
            endif
    endif

endmenu
```
