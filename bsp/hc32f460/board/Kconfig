## bsp/ht32/ht32f12366/board/Kconfig
```kconfig
menu "Hardware Drivers Config"

menu "Chip Configuration"
    config SOC_KERNEL
        bool
        select SOC_SERIES_HT32F5 if CORTEX_M0
        select SOC_SERIES_HT32F1 if CORTEX_M3
        select RT_USING_COMPONENTS_INIT
        select RT_USING_USER_MAIN
        default y
        choice
            prompt "Select the kernel"
            default CORTEX_M0
            config CORTEX_M0
                bool "CORTEX_M0"
            config CORTEX_M3
                bool "CORTEX_M3" 
        endchoice

    choice
        prompt "Select the chip you are using"
        depends on CORTEX_M0
        default HT32F52352
            config SOC_HT32F0006
                bool "HT32F0006"
            config SOC_HT32F0008
                bool "HT32F0008"
            config SOC_HT32F50241
                bool "HT32F50241"
            config SOC_HT32F50343
                bool "HT32F50343"
            config SOC_HT32F50441
                bool "HT32F50441"
            config SOC_HT32F50452
                bool "HT32F50452"
            config SOC_HT32F52241
                bool "HT32F52241"
            config SOC_HT32F52244
                bool "HT32F52244"
            config SOC_HT32F52253
                bool "HT32F52253"
            config SOC_HT32F52341
                bool "HT32F52341"
            config SOC_HT32F52352
                bool "HT32F52352"
            config SOC_HT32F52354
                bool "HT32F52354"
            config SOC_HT32F52367
                bool "HT32F52367"
            config SOC_HT32F53241
                bool "HT32F53241"
            config SOC_HT32F53252
                bool "HT32F53252"
            config SOC_HT32F54241
                bool "HT32F54241"
            config SOC_HT32F54253
                bool "HT32F54253"
            config SOC_HT32F57341
                bool "HT32F57341"
            config SOC_HT32F57352
                bool "HT32F57352"
            config SOC_HT32F5828
                bool "HT32F5828"
            config SOC_HT32F59041
                bool "HT32F59041"
            config SOC_HT32F59741
                bool "HT32F59741"
            config SOC_HT32F61141
                bool "HT32F61141"
            config SOC_HT32F61245
                bool "HT32F61245"
            config SOC_HT32F61355
                bool "HT32F61355"
            config SOC_HT32F61356
                bool "HT32F61356"
            config SOC_HT32F61357
                bool "HT32F61357"
            config SOC_HT32F61641
                bool "HT32F61641"
            config SOC_HT32F65240
                bool "HT32F65240"
            config SOC_HT32F67051
                bool "HT32F67051"
            config SOC_HT32F67741
                bool "HT32F67741"
    endchoice
    
    choice
        prompt "Select the chip you are using"
        depends on CORTEX_M3
        default HT32F52352
        config SOC_HT32F1654
            bool "HT32F1654"
        config SOC_HT32F1656
            bool "HT32F1656"
        config SOC_HT32F12345
            bool "HT32F12345"
        config SOC_HT32F12364
            bool "HT32F12364"
        config SOC_HT32F12366
            bool "HT32F12366"
    endchoice
endmenu

menu "Onboard Peripheral Drivers"

    config BSP_USING_TEST
        bool "Enable test"
        default n

    if RT_USING_CONSOLE
		config RT_CONSOLE_DEVICE_NAME
		string "the device name for console"
		default "usart0"
	endif

endmenu

menu "On-chip Peripheral Drivers"

    config BSP_USING_GPIO
        bool "Enable GPIO"
        select RT_USING_PIN if BSP_USING_GPIO
        default n

    menuconfig BSP_USING_UART
        bool "Enable UART"
        default n
        select RT_USING_SERIAL
        if BSP_USING_UART
            config BSP_USING_USART0
                bool "Enable USART0"
                default n
                config BSP_USING_USART0_NAME
                depends on BSP_USING_USART0
                string "usart0 bus name"
                default "usart0"

            config BSP_USING_USART1
                bool "Enable USART1"
                default n
                config BSP_USING_USART1_NAME
                depends on BSP_USING_USART1
                string "usart1 bus name"
                default "usart1"

            config BSP_USING_UART0
                bool "Enable UART0"
                default n
                config BSP_USING_UART0_NAME
                depends on BSP_USING_UART0
                string "uart0 bus name"
                default "uart0"

            config BSP_USING_UART1
                bool "Enable UART1"
                default n
                config BSP_USING_UART1_NAME
                depends on BSP_USING_UART1
                string "uart1 bus name"
                default "uart1"
        endif

    menuconfig BSP_USING_SPI
        bool "Enable SPI Bus"
        default n
        select RT_USING_SPI if BSP_USING_SPI
        if BSP_USING_SPI
            config BSP_USING_SPI0
                bool "Enable SPI0 Bus"
                default n
                config BSP_USING_SPI0_NAME
                depends on BSP_USING_SPI0
                string "spi0 bus name"
                default "spi0"

            config BSP_USING_SPI1
                bool "Enable SPI1 Bus"
                default n
                config BSP_USING_SPI1_NAME
                depends on BSP_USING_SPI1
                string "spi1 bus name"
                default "spi1"
        endif

    menuconfig BSP_USING_I2C
        bool "Enable I2C Bus"
        default n
        if BSP_USING_I2C
            menuconfig BSP_USING_I2C_HW
                bool "Enable I2C Bus(hardware)"
                default n
                select RT_USING_I2C if BSP_USING_I2C_HW
                if BSP_USING_I2C_HW
                    config BSP_USING_I2C0_HW
                    bool "Enable Hardware I2C0 Bus"
                    default n
                    config BSP_USING_I2C0_HW_NAME
                    depends on BSP_USING_I2C0_HW
                    string "hardware i2c0 name"
                    default "hw_i2c0"

                    config BSP_USING_I2C1_HW
                    bool "Enable Hardware I2C1 Bus"
                    default n
                    config BSP_USING_I2C1_HW_NAME
                    depends on BSP_USING_I2C1_HW
                    string "hardware i2c1 name"
                    default "hw_i2c1"
                endif

            menuconfig BSP_USING_I2C_SW
                bool "Enable I2C Bus(software)"
                default n
                select BSP_USING_GPIO if BSP_USING_I2C_SW
                select RT_USING_I2C if BSP_USING_I2C_SW
                
                if BSP_USING_I2C_SW
                    config BSP_USING_I2C0_SW
                    bool "Enable Software I2C0 Bus"
                    default n
                    config BSP_USING_I2C0_SW_NAME
                    depends on BSP_USING_I2C0_SW
                    string "software i2c0 name"
                    default "sw_i2c0"
                    if BSP_USING_I2C0_SW
                            config BSP_I2C0_SLC_PIN
                            int "i2c0 slc pin number"
                            range 0 51
                            default 22

                            config BSP_I2C0_SDA_PIN
                            int "i2c0 sda pin number"
                            range 0 51
                            default 23
                    endif
                    
                    config BSP_USING_I2C1_SW
                    bool "Enable Software I2C1 Bus"
                    default n
                    config BSP_USING_I2C1_SW_NAME
                    depends on BSP_USING_I2C1_SW
                    string "software i2c1 name"
                    default "sw_i2c1"
                    if BSP_USING_I2C1_SW
                            config BSP_I2C1_SLC_PIN
                            int "i2c1 slc pin number"
                            range 0 51
                            default 24

                            config BSP_I2C1_SDA_PIN
                            int "i2c1 sda pin number"
                            range 0 51
                            default 25
                    endif
                    
                    config BSP_USING_I2C2_SW
                    bool "Enable Software I2C2 Bus"
                    default n
                    config BSP_USING_I2C2_SW_NAME
                    depends on BSP_USING_I2C2_SW
                    string "software i2c2 name"
                    default "sw_i2c2"
                    if BSP_USING_I2C2_SW
                            config BSP_I2C2_SLC_PIN
                            int "i2c2 slc pin number"
                            range 0 51
                            default 26

                            config BSP_I2C2_SDA_PIN
                            int "i2c2 sda pin number"
                            range 0 51
                            default 27
                    endif
                endif
        endif

    menuconfig BSP_USING_ADC
        bool "Enable ADC"
        default n
        select RT_USING_ADC if BSP_USING_ADC
        if BSP_USING_ADC
            config BSP_USING_ADC0
            bool "Enable ADC0"
            default n
            config BSP_USING_ADC0_NAME
            depends on BSP_USING_ADC0
            string "adc0 device name"
            default "adc0"

            config BSP_USING_ADC1
            bool "Enable ADC1"
            depends on SOC_HT32F65240
            default n
            config BSP_USING_ADC1_NAME
            depends on BSP_USING_ADC1
            string "adc1 device name"
            default "adc1"
        endif

    menuconfig BSP_USING_WDT
        bool "Enable WDT"
        default n
        select RT_USING_WDT if BSP_USING_WDT
        config BSP_USING_WDT_NAME
        depends on BSP_USING_WDT
        string "wdt device name"
        default "wdt"
endmenu

menu "Board extended module Drivers"

endmenu

endmenu
```

## bsp/ht32/ht32f52352/board/Kconfig
```kconfig
menu "Hardware Drivers Config"

config SOC_HT32F52352
	bool
	select SOC_SERIES_HT32F5
	select RT_USING_COMPONENTS_INIT
	select RT_USING_USER_MAIN
	default y

menu "Onboard Peripheral Drivers"

endmenu

menu "On-chip Peripheral Drivers"

	config BSP_USING_GPIO
        bool "Enable GPIO"
        select RT_USING_PIN
        default n

   	menuconfig BSP_USING_UART
        bool "Enable UART"
        default n
        select RT_USING_SERIAL
        if BSP_USING_UART
			config BSP_USING_USART0
			bool "Enable USART0"
			default n

			config BSP_USING_USART1
			bool "Enable USART1"
			default n

			config BSP_USING_UART0
			bool "Enable UART0"
			default n

			config BSP_USING_UART1
			bool "Enable UART1"
			default n
        endif

	menuconfig BSP_USING_SPI
		bool "Enable SPI Bus"
		default n
		select RT_USING_SPI
		if BSP_USING_SPI
			config BSP_USING_SPI0
			bool "Enable SPI0 Bus"
			default n

			config BSP_USING_SPI1
			bool "Enable SPI1 Bus"
			default n
		endif

	menuconfig BSP_USING_I2C
		bool "Enable I2C Bus"
		default n
		select RT_USING_I2C
		if BSP_USING_I2C
			config BSP_USING_I2C0
			bool "Enable I2C0 Bus"
			default n

			config BSP_USING_I2C1
			bool "Enable I2C1 Bus"
			default n
		endif

endmenu

menu "Board extended module Drivers"

endmenu

endmenu
```

## bsp/ht32/libraries/Kconfig
```kconfig
config SOC_FAMILY_HT32
    bool

config SOC_SERIES_HT32F5
    bool
    select ARCH_ARM_CORTEX_M0
    select SOC_FAMILY_HT32

config SOC_SERIES_HT32F1
    bool
    select ARCH_ARM_CORTEX_M3
    select SOC_FAMILY_HT32
```

## bsp/imx/imx6ull-smart/Kconfig
```kconfig
mainmenu "RT-Thread Project Configuration"

config BSP_DIR
    string
    option env="BSP_ROOT"
    default "."

config RTT_DIR
    string
    option env="RTT_ROOT"
    default "../../.."

config PKGS_DIR
    string
    option env="PKGS_ROOT"
    default "packages"

source "$RTT_DIR/Kconfig"
source "$PKGS_DIR/Kconfig"

config SOC_IMX6ULL
    bool
    select ARCH_ARM_CORTEX_A7
    select RT_USING_CACHE
    select ARCH_ARM_MMU
    select RT_USING_COMPONENTS_INIT
    select RT_USING_USER_MAIN
    select RT_USING_FPU
    select RT_USING_GIC_V2
    default y

    if SOC_IMX6ULL
        config CPU_MCIMX6Y2CVM05
            bool
            default y
        config FSL_SDK_ENABLE_DRIVER_CACHE_CONTROL
            depends on RT_USING_CACHE
            int
            default 1
        config FSL_SDK_DISABLE_DRIVER_CLOCK_CONTROL
            int "Disable Clock control in fsl files"
            default 1
    endif

source "$BSP_DIR/drivers/Kconfig"
```

## bsp/imx6ul/Kconfig
```kconfig
mainmenu "RT-Thread Configuration"

config BSP_DIR
    string
    option env="BSP_ROOT"
    default "."

config RTT_DIR
    string
    option env="RTT_ROOT"
    default "../.."

config PKGS_DIR
    string
    option env="PKGS_ROOT"
    default "packages"

config BOARD_IMX6UL
    bool 
    select ARCH_ARM_CORTEX_A7
    default y

source "$RTT_DIR/Kconfig"
source "$PKGS_DIR/Kconfig"

source "$BSP_DIR/drivers/Kconfig"

config SOC_MCIMX6X4
    bool 
    select RT_USING_COMPONENTS_INIT
    #select RT_USING_USER_MAIN
    default y
```

## bsp/imx6ull-100ask-smart/drivers/Kconfig
```kconfig
config RT_USING_UART0
    bool "Enable UART0"
    default n

config RT_USING_UART1
    bool "Enable UART1"
    default y

config BSP_DRV_EMAC
    bool "EMAC driver"
    default y
```
