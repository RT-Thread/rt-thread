## bsp/nuvoton/numaker-iot-ma35d1/board/Kconfig
```kconfig
menu "Hardware Drivers Config"

    menu "On-chip Peripheral Drivers"
        source "$(BSP_DIR)/../libraries/ma35/rtt_port/Kconfig"
    endmenu

    menu "On-board Peripheral Drivers"

        config BSP_USING_CONSOLE
            bool "Enable UART0 for RTT Console(uart0)"
            select BSP_USING_UART
            select BSP_USING_UART0
            default y

        config BOARD_USING_NAU8822
            bool "NAU8822 Audio Codec supporting(over i2s0, i2c1)"
            select NU_PKG_USING_NAU8822
            select BSP_USING_I2C1
            select BSP_USING_I2S
            select BSP_USING_I2S0
            default n

        config BOARD_USING_GMAC0
            bool "Enable RGMII0 port(over e0)"
            select BSP_USING_GMAC0
            select BSP_USING_GMAC
            default y

        config BOARD_USING_GMAC1
            bool "Enable RMII1 port(over e1)"
            select BSP_USING_GMAC1
            select BSP_USING_GMAC
            default y

        config BOARD_USING_STORAGE_SDCARD
            bool "SDCARD supporting(over sdh1)"
            select BSP_USING_SDH
            select BSP_USING_SDH1
            default y

        config BOARD_USING_STORAGE_RAWNAND
            bool "Raw NAND supporting(over nfi)"
            select BSP_USING_NFI
            select RT_USING_MTD_NAND
            default y

        config BOARD_USING_STORAGE_SPIFLASH
            bool "SPI NOR FLASH supporting(over qspi0)"
            select BSP_USING_QSPI
            select BSP_USING_QSPI0
            default n

        config BOARD_USING_STORAGE_SPINAND
            bool "SPI NAND FLASH supporting(over qspi0)"
            select BSP_USING_QSPI
            select BSP_USING_QSPI0
            select NU_PKG_USING_SPINAND
            default y

        config BOARD_USING_USBHOST
            bool "USB HOST function"
            select BSP_USING_USBH
            default y

    endmenu

    menu "Board extended module drivers"

    config BOARD_USING_SENSOR0
        bool "CCAP-SENSOR PORT0(over i2c2/PM1/PC12)"
        select BSP_USING_I2C
        select BSP_USING_I2C2
        select BSP_USING_CCAP
        select BSP_USING_CCAP0
        default n

    if BOARD_USING_SENSOR0
        config BOARD_USING_SENSON0_ID
            int "Specify Sensor0 ID"
            default 0  if BOARD_USING_SENSOR0
            range 0 2
            help
                HM1055=0
                ADV728X=1
    endif
    endmenu

    source "$(BSP_DIR)/../libraries/nu_packages/Kconfig"

endmenu
```

## bsp/nuvoton/numaker-m032ki/board/Kconfig
```kconfig
menu "Hardware Drivers Config"

    menu "On-chip Peripheral Drivers"
        source "$(BSP_DIR)/../libraries/m031/rtt_port/Kconfig"
    endmenu

    menu "On-board Peripheral Drivers"

        config BSP_USING_NULINKME
            bool "Enable UART0 for RTT Console.(uart0)"
            select BSP_USING_UART
            select BSP_USING_UART0
            default y

    endmenu

    menu "Board extended module drivers"

        config BOARD_USING_STORAGE_SPIFLASH
            bool "SPIFLASH supporting(over qspi0)"
            select BSP_USING_QSPI
            select BSP_USING_QSPI0
            default n

        config BOARD_USING_LCD_ILI9341
            bool "LCD ILI9341 (over uspi0)"
            select RT_USING_TOUCH
            select BSP_USING_USCI0
            select BSP_USING_USPI0
            select BSP_USING_EADC
            select BSP_USING_EADC0
            select NU_PKG_USING_ADC_TOUCH
            select NU_PKG_USING_ADC_TOUCH_SW
            select NU_PKG_USING_ILI9341
            select NU_PKG_USING_ILI9341_SPI
            select NU_PKG_ILI9341_WITH_OFFSCREEN_FRAMEBUFFER
            select NU_PKG_ILI9341_HORIZONTAL
            default n

        if BOARD_USING_LCD_ILI9341

            config BOARD_USING_ILI9341_PIN_BACKLIGHT
            int "Specify the pin index of backlight pin index"
                range 0 127
                default 6

            config BOARD_USING_ILI9341_PIN_RESET
            int "Specify the pin index of reset pin index"
                range 0 127
                default 19

            config BOARD_USING_ILI9341_PIN_DC
            int "Specify the pin index of data&command switching"
                range 0 127
                default 18

        endif

    endmenu

    source "$(BSP_DIR)/../libraries/nu_packages/Kconfig"
endmenu
```

## bsp/nuvoton/numaker-m2354/Kconfig
```kconfig
mainmenu "RT-Thread Configuration"

config BSP_DIR
    string
    option env="BSP_ROOT"
    default "."

config RTT_DIR
    string
    option env="RTT_ROOT"
    default "../../.."

# you can change the RTT_ROOT default "../../.." to your rtthread_root,
# example : default "F:/git_repositories/rt-thread"

config PKGS_DIR
    string
    option env="PKGS_ROOT"
    default "packages"

config NU_PKGS_DIR
    string
    option env="NU_PKGS_ROOT"
    default "../libraries/nu_packages"

source "$RTT_DIR/Kconfig"
source "$PKGS_DIR/Kconfig"
source "$NU_PKGS_DIR/Kconfig"
source "$BSP_DIR/board/Kconfig"
```

## bsp/nuvoton/numaker-m2354/board/Kconfig
```kconfig
menu "Hardware Drivers Config"

    menu "On-chip Peripheral Drivers"
        source "$(BSP_DIR)/../libraries/m2354/rtt_port/Kconfig"
    endmenu

    menu "On-board Peripheral Drivers"

        config BSP_USING_NULINKME
            bool "Enable UART0 for RTT Console.(uart0)"
            select BSP_USING_UART
            select BSP_USING_UART0
            default y
        config BOARD_USING_ESP8266
            bool "ESP8266 Wi-Fi module supporting(over uart4)"
            select BSP_USING_UART
            select BSP_USING_UART4
            select BSP_USING_UART4_RX_DMA
            select BSP_USING_UART4_TX_DMA
            select PKG_USING_AT_DEVICE
            select AT_DEVICE_USING_ESP8266
            select AT_DEVICE_ESP8266_INIT_ASYN
            default n

        config BOARD_USING_STORAGE_SDCARD
            bool "SDCARD supporting.(over sdh0)"
            select BSP_USING_SDH
            select BSP_USING_SDH0
            default n

        choice
            prompt "Select FS USB Ports"

            config BOARD_USING_USBD
                select BSP_USING_USBD
                bool "Enable USBD(over USB1.1)"
                help
                    Choose this option if you need USBD function mode.

            config BOARD_USING_USBH
                select BSP_USING_USBH
                bool "Enable USBH(over USB1.1)"
                help
                    Choose this option if you need USBH function mode.

            config BOARD_USING_OTG
                select BSP_USING_OTG
                bool "Enable OTG(over USB1.1)"
                help
                    Choose this option if you need OTG function mode.

            config BOARD_USING_USB_NONE
                select BSP_USING_USB_NONE
                bool "Disable USB1.1 port"
                help
                    Choose this option if you need not USB function.

        endchoice


    endmenu

    menu "Board extended module drivers"
        config BOARD_USING_LCD_ILI9341
            bool "LCD ILI9341 (over spi1)"
            select RT_USING_TOUCH
            select BSP_USING_SPI1
            select BSP_USING_EADC
            select BSP_USING_EADC0
            select NU_PKG_USING_ADC_TOUCH
            select NU_PKG_USING_ADC_TOUCH_SW
            select NU_PKG_USING_ILI9341
            select NU_PKG_USING_ILI9341_SPI
            select NU_PKG_ILI9341_WITH_OFFSCREEN_FRAMEBUFFER
            select NU_PKG_ILI9341_HORIZONTAL
            default n

        if BOARD_USING_LCD_ILI9341

            config BOARD_USING_ILI9341_PIN_BACKLIGHT
            int "Specify the pin index of backlight pin index"
                range 0 127
                default 43

            config BOARD_USING_ILI9341_PIN_RESET
            int "Specify the pin index of reset pin index"
                range 0 127
                default 9

            config BOARD_USING_ILI9341_PIN_DC
            int "Specify the pin index of data&command switching"
                range 0 127
                default 8

        endif

        config BOARD_USING_SEGMENT_LCD
            bool "Segment LCD supporting.(over lcd)"
            select BSP_USING_SLCD
            default n

    endmenu

    source "$(BSP_DIR)/../libraries/nu_packages/Kconfig"

endmenu
```

## bsp/nuvoton/numaker-m3334ki/Kconfig
```kconfig
mainmenu "RT-Thread Configuration"

BSP_DIR := .

RTT_DIR := ../../..

# you can change the RTT_ROOT default "../../.." to your rtthread_root,
# example : default "F:/git_repositories/rt-thread"

PKGS_DIR := packages

source "$(RTT_DIR)/Kconfig"
osource "$PKGS_DIR/Kconfig"
source "$(BSP_DIR)/board/Kconfig"
```

## bsp/nuvoton/numaker-m3334ki/board/Kconfig
```kconfig
menu "Hardware Drivers Config"

    menu "On-chip Peripheral Drivers"
        source "$BSP_DIR/../libraries/m3331/rtt_port/Kconfig"
    endmenu

    menu "On-board Peripheral Drivers"

        config BOARD_USING_NULINKME
            bool "Enable UART0 for RTT Console.(uart0)"
            select BSP_USING_UART
            select BSP_USING_UART0
            default y

        config BSP_USING_CUSTOM_LOADER
            bool "Enable Custom Loader for Swapping Flash Bank."
            select BSP_USING_RMC

        choice
            prompt "Select HSUSB Ports"

            config BOARD_USING_HSUSBD
                select BSP_USING_HSUSBD
                bool "Enable HSUSBD"
                help
                    Choose this option if you need HSUSBD function mode.

            config BOARD_USING_HSUSBH
                select BSP_USING_HSUSBH
                bool "Enable HSUSBH"
                help
                    Choose this option if you need HSUSBH function mode.

            config BOARD_USING_USB_OTG
                select BSP_USING_OTG
                bool "Enable HSUSB OTG"
                help
                    Choose this option if you need HSUSB Device, Host and H/W OTG function.

            config BOARD_USING_USB_SWOTG
                select BSP_USING_HSUSBH
                select BSP_USING_HSUSBD
                select RT_USING_PIN
                select RT_USING_ADC
                select BSP_USING_EADC0
                bool "Enable HSUSB S/W OTG"
                help
                    Choose this option if you need HSUSB Device, Host and S/W OTG function.

            config BOARD_USING_USB_NONE
                select BSP_USING_USB_NONE
                bool "Disable HSUSB port"
                help
                    Choose this option if you need not USB function.
        endchoice


    endmenu

    menu "Board extended module drivers"
    choice
        prompt "Select On-board Module"
        config BOARD_USING_NONE
            bool "None"
        config BOARD_USING_NUFUN
            bool "NuFUN V2.0"
        config BOARD_USING_NUTFT
            bool "NuTFT V1.3"
    endchoice

    if BOARD_USING_NUFUN
        source "$BSP_DIR/board/Kconfig_Board_NUFUN"
    endif

    if BOARD_USING_NUTFT
        source "$BSP_DIR/board/Kconfig_Board_NUTFT"
    endif
    endmenu

    source "$BSP_DIR/../libraries/nu_packages/Kconfig"

endmenu
```
