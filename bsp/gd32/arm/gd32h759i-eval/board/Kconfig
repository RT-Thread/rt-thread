## bsp/hc32/ev_hc32f460_lqfp100_v2/board/Kconfig
```kconfig
menu "Hardware Drivers Config"

config SOC_HC32F460PE
    bool 
    select SOC_SERIES_HC32F4
    select RT_USING_COMPONENTS_INIT
    select RT_USING_USER_MAIN
    default y

menu "Onboard Peripheral Drivers"

endmenu

menu "On-chip Peripheral Drivers"
    config BSP_USING_GPIO
        bool "Enable GPIO"
        select RT_USING_PIN
        default y

    menuconfig BSP_USING_UART
        bool "Enable UART"
        default y
        select RT_USING_SERIAL
        if BSP_USING_UART
            config BSP_USING_UART1
                bool "Enable UART1"
                default y

            config BSP_UART1_RX_USING_DMA
                bool "Enable UART1 RX DMA"
                depends on BSP_USING_UART1 && RT_SERIAL_USING_DMA
                default n

            config BSP_UART1_TX_USING_DMA
                bool "Enable UART1 TX DMA"
                depends on BSP_USING_UART1 && RT_SERIAL_USING_DMA
                default n

            config BSP_USING_UART2
                bool "Enable UART2"
                default n

            config BSP_UART2_RX_USING_DMA
                bool "Enable UART2 RX DMA"
                depends on BSP_USING_UART2 && RT_SERIAL_USING_DMA
                default n

            config BSP_UART2_TX_USING_DMA
                bool "Enable UART2 TX DMA"
                depends on BSP_USING_UART2 && RT_SERIAL_USING_DMA
                default n
            
            config BSP_USING_UART3
                bool "Enable UART3"
                default n

            config BSP_UART3_RX_USING_DMA
                bool "Enable UART3 RX DMA"
                depends on BSP_USING_UART3 && RT_SERIAL_USING_DMA
                default n

            config BSP_UART3_TX_USING_DMA
                bool "Enable UART3 TX DMA"
                depends on BSP_USING_UART3 && RT_SERIAL_USING_DMA
                default n

            config BSP_USING_UART4
                bool "Enable UART4"
                default n
            
            config BSP_UART4_RX_USING_DMA
                bool "Enable UART4 RX DMA"
                depends on BSP_USING_UART4 && RT_SERIAL_USING_DMA
                default n

            config BSP_UART4_TX_USING_DMA
                bool "Enable UART4 TX DMA"
                depends on BSP_USING_UART4 && RT_SERIAL_USING_DMA
                default n
        endif
		
	menuconfig BSP_USING_CAN
        bool "Enable CAN"
        default n
        select RT_USING_CAN
        if BSP_USING_CAN
            config BSP_USING_CAN1
                bool "using can1"
                default n
        endif
		
	menuconfig BSP_USING_ADC
        bool "Enable ADC"
        default n
        select RT_USING_ADC
        if BSP_USING_ADC
            config BSP_USING_ADC1
                bool "using adc1"
                default n

            config BSP_USING_ADC1_IN0
                bool "using adc1_in0"
                depends on BSP_USING_ADC1
                default n
            config BSP_USING_ADC1_IN1
                bool "using adc1_in1"
                depends on BSP_USING_ADC1
                default n
            config BSP_USING_ADC1_IN2
                bool "using adc1_in2"
                depends on BSP_USING_ADC1
                default n
            config BSP_USING_ADC1_IN3
                bool "using adc1_in3"
                depends on BSP_USING_ADC1
                default n
            config BSP_USING_ADC1_IN12
                bool "using adc1_in12"
                depends on BSP_USING_ADC1
                default n
            config BSP_USING_ADC1_IN13
                bool "using adc1_in13"
                depends on BSP_USING_ADC1
                default n
            config BSP_USING_ADC1_IN14
                bool "using adc1_in14"
                depends on BSP_USING_ADC1
                default n
            config BSP_USING_ADC1_IN15
                bool "using adc1_in15"
                depends on BSP_USING_ADC1
                default n
            
            config BSP_USING_ADC2
                bool "using adc2"
                default n
            
            config BSP_USING_ADC12_IN4
                bool "using adc12_in4"
                depends on BSP_USING_ADC1 || BSP_USING_ADC2
                default n
            config BSP_USING_ADC12_IN5
                bool "using adc12_in5"
                depends on BSP_USING_ADC1 || BSP_USING_ADC2
                default n
            config BSP_USING_ADC12_IN6
                bool "using adc12_in6"
                depends on BSP_USING_ADC1 || BSP_USING_ADC2
                default n
            config BSP_USING_ADC12_IN7
                bool "using adc12_in7"
                depends on BSP_USING_ADC1 || BSP_USING_ADC2
                default n
            config BSP_USING_ADC12_IN8
                bool "using adc12_in8"
                depends on BSP_USING_ADC1 || BSP_USING_ADC2
                default n
            config BSP_USING_ADC12_IN9
                bool "using adc12_in9"
                depends on BSP_USING_ADC1 || BSP_USING_ADC2
                default n
            config BSP_USING_ADC12_IN10
                bool "using adc12_in10"
                depends on BSP_USING_ADC1 || BSP_USING_ADC2
                default n
            config BSP_USING_ADC12_IN11
                bool "using adc12_in11"
                depends on BSP_USING_ADC1 || BSP_USING_ADC2
                default n
        endif

    menuconfig BSP_USING_RTC
        bool "Enable RTC"
        select RT_USING_RTC
        default n
        if BSP_USING_RTC
            choice
                prompt "Select clock source"
                default BSP_RTC_USING_LRC

                config BSP_RTC_USING_XTAL32
                    bool "RTC USING XTAL32"

                config BSP_RTC_USING_LRC
                    bool "RTC USING LRC"
            endchoice
        endif
		
    menuconfig BSP_USING_I2C2
        bool "Enable I2C2 BUS (software simulation)"
        default n
        select RT_USING_I2C
        select RT_USING_I2C_BITOPS
        select RT_USING_PIN 
        if BSP_USING_I2C2
            config BSP_I2C2_SCL_PIN
                int "i2c2 scl pin number"
                range 1 100
                default 48
            config BSP_I2C2_SDA_PIN
                int "I2C2 sda pin number"
                range 1 100
                default 49
        endif 
		
endmenu

menu "Board extended module Drivers"

endmenu
 
endmenu
```

## bsp/hc32/ev_hc32f4a0_lqfp176/board/Kconfig
```kconfig
menu "Hardware Drivers Config"

config SOC_HC32F4A0SI
    bool
    select SOC_SERIES_HC32F4
    select RT_USING_COMPONENTS_INIT
    select RT_USING_USER_MAIN
    default y

menu "Onboard Peripheral Drivers"

    config PHY_USING_RTL8201F
        bool

    menuconfig BSP_USING_ETH
        bool "Enable Ethernet"
        default n
        select BSP_USING_I2C1
        select RT_USING_LWIP
        select PHY_USING_RTL8201F
        select RT_LWIP_USING_HW_CHECKSUM
        select BSP_USING_TCA9539
        if BSP_USING_ETH
            config ETH_USING_INTERFACE_RMII
                bool "select RMII interface"
                default n

            config PHY_USING_INTERRUPT_MODE
                bool "enable phy interrupt mode"
                select ETH_PHY_INT_PIN
                default n

            config ETH_PHY_INT_PIN
                int
                default 16
        endif

    config BSP_USING_TCA9539
        bool "Enable TCA9539"
        select BSP_USING_I2C1
        default n

endmenu

menu "On-chip Peripheral Drivers"
    config BSP_USING_GPIO
        bool "Enable GPIO"
        select RT_USING_PIN
        default y

    menuconfig BSP_USING_UART
        bool "Enable UART"
        default y
        select RT_USING_SERIAL
        if BSP_USING_UART
            config BSP_USING_UART1
                bool "Enable UART1"
                default y

            config BSP_UART1_RX_USING_DMA
                bool "Enable UART1 RX DMA"
                depends on BSP_USING_UART1
                select RT_SERIAL_USING_DMA
                default n

            config BSP_UART1_TX_USING_DMA
                bool "Enable UART1 TX DMA"
                depends on BSP_USING_UART1
                select RT_SERIAL_USING_DMA
                default n

            config BSP_USING_UART2
                bool "Enable UART2"
                default n

            config BSP_UART2_RX_USING_DMA
                bool "Enable UART2 RX DMA"
                depends on BSP_USING_UART2
                select RT_SERIAL_USING_DMA
                default n

            config BSP_UART2_TX_USING_DMA
                bool "Enable UART2 TX DMA"
                depends on BSP_USING_UART2
                select RT_SERIAL_USING_DMA
                default n

            config BSP_USING_UART3
                bool "Enable UART3"
                default n

            config BSP_USING_UART4
                bool "Enable UART4"
                default n

            config BSP_USING_UART5
                bool "Enable UART5"
                default n

            config BSP_USING_UART6
                bool "Enable UART6"
                default n

            config BSP_UART6_RX_USING_DMA
                bool "Enable UART6 RX DMA"
                depends on BSP_USING_UART6
                select RT_SERIAL_USING_DMA
                default n

            config BSP_UART6_TX_USING_DMA
                bool "Enable UART6 TX DMA"
                depends on BSP_USING_UART6
                select RT_SERIAL_USING_DMA
                default n

            config BSP_USING_UART7
                bool "Enable UART7"
                default n

            config BSP_UART7_RX_USING_DMA
                bool "Enable UART7 RX DMA"
                depends on BSP_USING_UART7
                select RT_SERIAL_USING_DMA
                default n

            config BSP_UART7_TX_USING_DMA
                bool "Enable UART7 TX DMA"
                depends on BSP_USING_UART7
                select RT_SERIAL_USING_DMA
                default n

            config BSP_USING_UART8
                bool "Enable UART8"
                default n

            config BSP_USING_UART9
                bool "Enable UART9"
                default n

            config BSP_USING_UART10
                bool "Enable UART10"
                default n
        endif

    menuconfig BSP_USING_I2C1
        bool "Enable I2C1 BUS (software simulation)"
        default y
        select RT_USING_I2C
        select RT_USING_I2C_BITOPS
        select RT_USING_PIN
        if BSP_USING_I2C1
            config BSP_I2C1_SCL_PIN
                int "i2c1 scl pin number"
                range 1 176
                default 51
            config BSP_I2C1_SDA_PIN
                int "I2C1 sda pin number"
                range 1 176
                default 90
        endif

    menuconfig BSP_USING_SPI
        bool "Enable SPI BUS"
        default n
        select RT_USING_SPI
        if BSP_USING_SPI
            config BSP_USING_SPI1
                bool "Enable SPI1 BUS"
                default n

            config BSP_SPI1_TX_USING_DMA
                bool "Enable SPI1 TX DMA"
                depends on BSP_USING_SPI1
                default n

            config BSP_SPI1_RX_USING_DMA
                bool "Enable SPI1 RX DMA"
                depends on BSP_USING_SPI1
                select BSP_SPI1_TX_USING_DMA
                default n

            config BSP_USING_SPI2
                bool "Enable SPI2 BUS"
                default n

            config BSP_SPI2_TX_USING_DMA
                bool "Enable SPI2 TX DMA"
                depends on BSP_USING_SPI2
                default n

            config BSP_SPI2_RX_USING_DMA
                bool "Enable SPI2 RX DMA"
                depends on BSP_USING_SPI2
                select BSP_SPI2_TX_USING_DMA
                default n

            config BSP_USING_SPI3
                bool "Enable SPI3 BUS"
                default n

            config BSP_SPI3_TX_USING_DMA
                bool "Enable SPI3 TX DMA"
                depends on BSP_USING_SPI3
                default n

            config BSP_SPI3_RX_USING_DMA
                bool "Enable SPI3 RX DMA"
                depends on BSP_USING_SPI3
                select BSP_SPI3_TX_USING_DMA
                default n

            config BSP_USING_SPI4
                bool "Enable SPI4 BUS"
                default n

            config BSP_SPI4_TX_USING_DMA
                bool "Enable SPI4 TX DMA"
                depends on BSP_USING_SPI4
                default n

            config BSP_SPI4_RX_USING_DMA
                bool "Enable SPI4 RX DMA"
                depends on BSP_USING_SPI4
                select BSP_SPI4_TX_USING_DMA
                default n
        endif

    menuconfig BSP_USING_ADC
        bool "Enable ADC"
        default n
        select RT_USING_ADC
        if BSP_USING_ADC
            config BSP_USING_ADC1
                bool "using adc1"
                default n
            config BSP_USING_ADC2
                bool "using adc2"
                default n
            config BSP_USING_ADC3
                bool "using adc3"
                default n
        endif

    menuconfig BSP_USING_CAN
        bool "Enable CAN"
        default n
        select RT_USING_CAN
        select RT_CAN_USING_HDR
        if BSP_USING_CAN
            config BSP_USING_CAN1
                bool "using can1"
                default n
            config BSP_USING_CAN2
                bool "using can2"
                default n
        endif

endmenu

menu "Board extended module Drivers"

endmenu

endmenu
```
