## bsp/stm32/stm32h7r7-atk/board/Kconfig
```kconfig
menu "Hardware Drivers Config"
config SOC_STM32H7RS
    bool
    select SOC_SERIES_STM32H7RS
    select RT_USING_COMPONENTS_INIT
    default y

config SOC_SERIES_STM32H7RS
    bool
    select ARCH_ARM_CORTEX_M7
    select SOC_FAMILY_STM32
    default y

menuconfig RT_USING_INDEPENDENT_INTERRUPT_MANAGEMENT
    bool "Enable independent interrupt management"
    default n

    if RT_USING_INDEPENDENT_INTERRUPT_MANAGEMENT
        config RT_MAX_SYSCALL_INTERRUPT_PRIORITY
            int "Set max syscall interrupt priority"
            range 0 7
            default 6
    endif

menu "Onboard Peripheral Drivers"

    config BSP_SCB_ENABLE_I_CACHE
        bool "Enable ICACHE"
        default y

    config BSP_SCB_ENABLE_D_CACHE
        bool "Enable DCACHE"
        default y

    config BSP_USING_USB_TO_USART
        bool "Enable Debuger USART (uart4)"
        select BSP_USING_UART
        select BSP_USING_UART4
        default n

    config BSP_USING_XSPI_NORFLASH
        bool "Enable XSPI octal norFLASH (w35t1nw) no-xip method"
        select RT_USING_FAL
        default n

    config BSP_USING_WIFI
        bool "Enable wifi (CYWL6208 or AP6212)"
        select ART_PI_USING_WIFI_6212_LIB
        select ART_PI_USING_OTA_LIB
        select BSP_USING_SPI_FLASH
        select RT_USING_WIFI
        select RT_USING_SAL
        default n

    menuconfig BSP_USING_LVGL
        bool "Enable LVGL for LCD"
        select PKG_USING_LVGL
        default n
        if BSP_USING_LVGL
            config BSP_USING_LCD_RGB
                bool "Enable LVGL for LCD_RGB565"
                select BSP_USING_LCD
                select RT_TOUCH_PIN_IRQ
                default n
            if BSP_USING_LCD_RGB
                config BSP_USING_TOUCH
                    bool "Enable Touch control"
                    select BSP_USING_I2C
                    select BSP_USING_I2C2
                    select RT_USING_TOUCH
                    default n
                if BSP_USING_TOUCH
                    choice
                        prompt "Choose Touch Driver"
                        default BSP_USING_GT9147
                                config BSP_USING_GT9147
                                    select PKG_USING_GT9147
                                    bool "USING Touch IC GT9147"

                                config BSP_USING_GT911
                                    select PKG_USING_GT911
                                    bool "USING Touch IC GT1151 GT1158"
                            default n
                    endchoice
                endif
            endif
        endif

    menuconfig BSP_USING_LVGL_DEMO
        bool "Enable LVGL demo for LCD"
        if BSP_USING_LVGL_DEMO     
            config BSP_USING_LVGL_MUSIC_DEMO
                bool "Enable LVGL music demo"
                default n
            config BSP_USING_LVGL_BENCHMARK_DEMO
                select BSP_USING_LVGL_WIDGETS_DEMO
                bool "Enable LVGL benchmark demo"
                default n
            config BSP_USING_LVGL_WIDGETS_DEMO
                bool "Enable LVGL widgets demo"
                default n
            config BSP_USING_LVGL_STRESS_DEMO
                bool "Enable LVGL stress demo"
                default n
            config BSP_USING_LVGL_RENDER_DEMO
                bool "Enable LVGL render demo"
                default n
        endif

    menuconfig BSP_USING_FS
        bool "Enable filesystem"
        select RT_USING_DFS
        select RT_USING_DFS_ROMFS
        select RT_USING_POSIX_FS
        default n
        if BSP_USING_FS
            config BSP_USING_SDCARD_FS
                bool "Enable SDCARD filesystem"
                select BSP_USING_SDIO
                select BSP_USING_SDIO1
                select RT_USING_DFS_ELMFAT
                default n
            config BSP_USING_SPI_FLASH_FS
                bool "Enable SPI FLASH filesystem"
                select BSP_USING_SPI_FLASH
                select RT_USING_MTD_NOR
                select PKG_USING_LITTLEFS
                default n
        endif

endmenu

menu "On-chip Peripheral"

    config BSP_USING_GPIO
        bool "Enable GPIO"
        select RT_USING_PIN
        default y

    menuconfig BSP_USING_UART
        bool "Enable UART"
        default n
        select RT_USING_SERIAL
        if BSP_USING_UART
        	menuconfig BSP_USING_UART1
                bool "Enable UART1"
                default n
                if BSP_USING_UART1
                    config BSP_UART1_RX_USING_DMA
                        bool "Enable UART1 RX DMA"
                        select RT_SERIAL_USING_DMA
                        default n

                    config BSP_UART1_TX_USING_DMA
                        bool "Enable UART1 TX DMA"
                        select RT_SERIAL_USING_DMA
                        default n

                    config BSP_UART1_RX_BUFSIZE
                        int "Set UART1 RX buffer size"
                        range 64 65535
                        depends on BSP_USING_UART1
                        default 256

                    config BSP_UART1_TX_BUFSIZE
                        int "Set UART1 TX buffer size"
                        range 0 65535
                        depends on BSP_USING_UART1
                        default 0
                endif
                
            config BSP_USING_UART3
                bool "Enable UART3"
                default n
                
            menuconfig BSP_USING_UART7
                bool "Enable UART7"
                default n
                if BSP_USING_UART7
                    config BSP_UART7_RX_USING_DMA
                        bool "Enable UART7 RX DMA"
                        select RT_SERIAL_USING_DMA
                        default n

                    config BSP_UART7_TX_USING_DMA
                        bool "Enable UART7 TX DMA"
                        select RT_SERIAL_USING_DMA
                        default n

                    config BSP_UART7_RX_BUFSIZE
                        int "Set UART7 RX buffer size"
                        range 64 65535
                        depends on BSP_USING_UART7
                        default 256

                    config BSP_UART7_TX_BUFSIZE
                        int "Set UART7 TX buffer size"
                        range 0 65535
                        depends on BSP_USING_UART7
                        default 0
                endif
                
            config BSP_USING_UART6
                bool "Enable UART6"
                default n
        endif

    menuconfig BSP_USING_SPI
        bool "Enable SPI"
        default n
        select RT_USING_SPI
        if BSP_USING_SPI
            config BSP_USING_SPI1
                bool "Enable SPI1"
                default n
            config BSP_USING_SPI2
                bool "Enable SPI2"
                default n
            config BSP_USING_SPI4
                bool "Enable SPI4"
                default n
            config BSP_USING_SPI5
                bool "Enable SPI5 on raspberrypi 40P port."
                default n
        endif

    menuconfig BSP_USING_I2C
        bool "Enable I2C BUS (software simulation)"
        select RT_USING_I2C
        select RT_USING_I2C_BITOPS
        select RT_USING_PIN
        default n
        if BSP_USING_I2C
            menuconfig BSP_USING_I2C1
                bool "Enable I2C1 BUS (software simulation)"
                default n
                select RT_USING_I2C
                select RT_USING_I2C_BITOPS
                select RT_USING_PIN
                if BSP_USING_I2C1
                    comment "Notice: PB8 --> 24; PB9 --> 25" 
                    config BSP_I2C1_SCL_PIN
                        int "I2C1 scl pin number"
                        range 0 175
                        default 24
                    config BSP_I2C1_SDA_PIN
                        int "I2C1 sda pin number"
                        range 0 175
                        default 25
                endif
            menuconfig BSP_USING_I2C2
                bool "Enable I2C2 BUS (software simulation)"
                default n
                if BSP_USING_I2C2
                    comment "Notice: PF0 --> 80; PF1 --> 81"
                    config BSP_I2C2_SCL_PIN
                        int "i2c2 scl pin number"
                        range 1 176
                        default 81
                    config BSP_I2C2_SDA_PIN
                        int "I2C2 sda pin number"
                        range 0 175
                        default 80
                endif
            menuconfig BSP_USING_I2C3
                bool "Enable I2C3 BUS (software simulation)"
                default n
                if BSP_USING_I2C3
                    comment "Notice: PA4 --> 4; PA7 --> 7"
                    config BSP_I2C3_SCL_PIN
                        int "i2c3 scl pin number"
                        range 0 175
                        default 7
                    config BSP_I2C3_SDA_PIN
                        int "I2C3 sda pin number"
                        range 0 175
                        default 4
                endif
        endif
		
    menuconfig BSP_USING_SDIO
        bool "Enable SDIO"
        default n
        select RT_USING_SDIO
        if BSP_USING_SDIO
            config BSP_USING_SDIO1
                bool "Enable SDIO1"
                default n
            config BSP_USING_SDIO2
                bool "Enable SDIO2"
                default n
        endif

    menuconfig BSP_USING_PSRAM
        bool "Enable PSRAM"
        default n
        if BSP_USING_PSRAM
        	config BSP_USING_PSRAM_TEST
                bool "Use psram test sample"
                default n
        endif

    menuconfig BSP_USING_ETH
        bool "Enable Ethernet"
        default n        
        select RT_USING_LWIP
        if BSP_USING_ETH
            config ETH_RESET_PIN
                string "ETH RESET PIN"
                default "PA.3"
        endif
        if BSP_USING_ETH
            choice
                prompt "Choose ETH PHY"
                default PHY_USING_LAN8720A
                config PHY_USING_LAN8720A
                    bool "USING LAN8720A"
                config PHY_USING_DM9161CEP
                    bool "USING DM9161CEP"
                config PHY_USING_DP83848C
                    bool "USING DP83848C"
                config PHY_USING_YT8512C
                    bool "USING YT8512C"
            endchoice
        endif

    config BSP_USING_LCD
        bool "Enable LCD"
        select BSP_USING_GPIO
        select BSP_USING_PSRAM
        select RT_USING_MEMHEAP
        default n

        if BSP_USING_LCD
            choice
                prompt "Choose LCD Type to config screen parameters and clock timing"
                default BSP_USING_LCD_800_RGB
                        config BSP_USING_OLED_454_MIPI
                        bool "RT-Thread AMOLED 1.44 inch screen, 454*454 bridged by SSD2828"
                        config BSP_USING_LCD_800_RGB
                        bool "RT-Thread or atk 4.3 inch screen, 800*480 "
                        config BSP_USING_LCD_360_REDUCED
                        bool "RT-Thread or atk 4.3 inch screen, 800*480 , window to 360*360"
                        config BSP_USING_LCD_454_REDUCED
                        bool "RT-Thread or atk 4.3 inch screen, 800*480 , window to 454*454"
            endchoice
        endif
    config BSP_USING_DCMI
        bool "Enable DCMI"
        default n
        
    menuconfig BSP_USING_FDCAN
        bool "Enable FDCAN"
        default n
        select RT_USING_CAN
        select RT_CAN_USING_CANFD
        if BSP_USING_FDCAN
        	config BSP_USING_FDCAN1
        	bool "Using FDCAN1"
        	default n
        	if BSP_USING_FDCAN1
	            choice
		            prompt "Choice FDCAN1 Frame Format"
		            default BSP_FDCAN1_FRAME_FD_BRS
		            config BSP_FDCAN1_FRAME_CLASSIC
		                bool "Classic mode"
		            config BSP_FDCAN1_FRAME_FD
		                bool "FD mode without BitRate Switching"
		            config BSP_FDCAN1_FRAME_FD_BRS
		                bool "FD mode with BitRate Switching"
	        	endchoice
	        endif
	        
	        config BSP_USING_FDCAN2
        	bool "Using FDCAN2"
        	default n
        	if BSP_USING_FDCAN2
	            choice
		            prompt "Choice FDCAN2 Frame Format"
		            default BSP_FDCAN2_FRAME_FD_BRS
		            config BSP_FDCAN2_FRAME_CLASSIC
		                bool "Classic mode"
		            config BSP_FDCAN2_FRAME_FD
		                bool "FD mode without BitRate Switching"
		            config BSP_FDCAN2_FRAME_FD_BRS
		                bool "FD mode with BitRate Switching"
	        	endchoice
        	endif
        endif
        
    config BSP_USING_USBD
        bool "Enable USB Device"
        select RT_USING_USB_DEVICE
        default n
        
    menuconfig BSP_USING_USBH
        bool "Enable USB Host"
        select RT_USING_USB_HOST
        default n
        if BSP_USING_USBH
            menuconfig RT_USBH_MSTORAGE
                bool "Enable Udisk Drivers"
                select RT_USING_DFS
                select RT_USING_DFS_ELMFAT
                default n
                if RT_USBH_MSTORAGE
                    config UDISK_MOUNTPOINT
                        string "Udisk mount dir"
                        default "/"
                endif
        endif
        
    menuconfig BSP_USING_TIM
        bool "Enable timer"
        default n
        select RT_USING_HWTIMER
        if BSP_USING_TIM
            config BSP_USING_TIM13
                bool "Enable TIM13"
                default n
        endif

    menuconfig BSP_USING_PWM
        bool "Enable PWM"
        default n
        select RT_USING_PWM
        if BSP_USING_PWM
        menuconfig BSP_USING_PWM5
            bool "Enable Timer5 output pwm"
            default n
            if BSP_USING_PWM5
                config BSP_USING_PWM5_CH1
                    bool "Enable PWM5 channel1"
                    default n
            endif
        config SAMPLES_USING_PWM
            bool "SAMPLE PWM5 channel1"
            default n
        endif

    config BSP_USING_ONCHIP_RTC
        bool "Enable Onchip RTC"
        select RT_USING_RTC
        default n
endmenu

endmenu

menu "External Libraries"

    config ART_PI_USING_WIFI_6212_LIB
        bool "Using Wifi(AP6212) Library"
        select BSP_USING_SDIO
        select BSP_USING_SDIO2
        select RT_USING_LWIP
        select RT_USING_WIFI
        default n

    config ART_PI_TouchGFX_LIB
        bool "Using TouchGFX Library"
        select RT_USING_CPLUSPLUS
        select RT_USING_MEMHEAP
        select RT_USING_TOUCH
        select RT_TOUCH_PIN_IRQ
        select BSP_USING_PSRAM
        select BSP_USING_I2C
        select BSP_USING_I2C2
        select PKG_USING_GT911
        default n
endmenu

choice
    prompt "The target of download and execute firmware"
    default FIRMWARE_EXEC_USING_OSPI_FLASH

    config FIRMWARE_EXEC_USING_OSPI_FLASH
        bool "OSPI Flash"

endchoice
```

## bsp/stm32/stm32h7s7-st-disco/Kconfig
```kconfig
mainmenu "RT-Thread Configuration"

config BSP_DIR
    string
    option env="BSP_ROOT"
    default "."

config RTT_DIR
    string
    option env="RTT_ROOT"
    default "../../.."

config PKGS_DIR
    string
    option env="PKGS_ROOT"
    default "packages"

config SOC_STM32H7RS
    bool
    select SOC_SERIES_STM32H7RS
    select RT_USING_COMPONENTS_INIT
    select RT_USING_USER_MAIN
    select RT_USING_CACHE
    default y

config SOC_SERIES_STM32H7RS
    bool
    select ARCH_ARM_CORTEX_M7
    select SOC_FAMILY_STM32
    default y

source "$RTT_DIR/Kconfig"
source "$PKGS_DIR/Kconfig"
source "../libraries/Kconfig"

if !RT_USING_NANO
source "board/Kconfig"
endif
```
