## bsp/allwinner/h616/Kconfig
```kconfig
mainmenu "RT-Thread H616 Configuration"

BSP_DIR := .
RTT_DIR := ../../..
PKGS_DIR := packages
SOC_DM_DIR := $(BSP_DIR)/../dm

source "$(SOC_DM_DIR)/Kconfig"
# H616 uses the generic ARM GIC and DesignWare UART drivers.
SOC_DM_PIC_DIR := $(RTT_DIR)/libcpu/aarch64/common/pic
SOC_DM_SERIAL_DIR := $(RTT_DIR)/libcpu/aarch64/common/serial

source "$(RTT_DIR)/Kconfig"
osource "$(PKGS_DIR)/Kconfig"

config SOC_H616
    bool
    default y
    select ARCH_ARMV8
    select ARCH_ARM_MMU
    select ARCH_CPU_64BIT
    select RT_USING_CACHE
    select RT_USING_COMPONENTS_INIT
    select RT_USING_USER_MAIN
    select RT_USING_STDC_ATOMIC
    help
        Boot through U-Boot and TF-A, using the device tree supplied in x0
        by U-Boot. Memory size and board wiring come from that device tree.
        No board DTB is built or embedded by this BSP.
```

## bsp/artinchip/d213ecv-demo-v4-0/Kconfig
```kconfig
mainmenu "RT-Thread Project Configuration"

BSP_DIR := .
RTT_DIR := ../../..
PKGS_DIR := packages

source "$(RTT_DIR)/Kconfig"
osource "$(PKGS_DIR)/Kconfig"
orsource "libraries/Kconfig"
orsource "../libraries/Kconfig"
rsource "board/Kconfig"
```

## bsp/artinchip/d213ecv-demo-v4-0/board/Kconfig
```kconfig
config SOC_D213
    bool
    default y
    select AIC_SOC_D21X
    select ARCH_CPU_64BIT
    select ARCH_RISCV
    select ARCH_RISCV64
    select ARCH_RISCV_FPU
    select ARCH_RISCV_FPU_D
    select ARCH_RISCV_M_MODE
    select RT_USING_RISCV_NEW_COMMON
    select RT_USING_ADT
    select RT_USING_ADT_BITMAP
    select RT_USING_COMPONENTS_INIT
    select RT_USING_USER_MAIN

menu "Board options"

config BSP_USING_UART0
    bool "Enable UART0 console"
    depends on RT_USING_SERIAL_V1
    default y
    help
        UART0 on PA.0/PA.1. Transmit is polled; a polling thread supplies
        the serial-v1 receive FIFO. UART hardware interrupts and DMA are
        not supported in this initial BSP.

config BSP_UART_CLK_FREQ
    int "Bootloader-configured UART0 input clock (Hz)"
    range 1843200 200000000
    default 48000000

config BSP_CLINT_FREQ
    int "Bootloader-configured CLINT timebase (Hz)"
    range 1000000 100000000
    default 4000000

endmenu
```

## bsp/artinchip/libraries/Kconfig
```kconfig
config AIC_SOC_D21X
    bool
    default n
    help
        Selects the ArtInChip D21x SoC layer. This initial port supports
        D213 only; other family members require separate validation.
```

## bsp/fm33lg026/libraries/Kconfig
```kconfig
config SOC_FAMILY_FM33
    bool

config SOC_SERIES_FM33LG0XX
    bool
    select ARCH_ARM_CORTEX_M0
    select SOC_FAMILY_FM33
```

## bsp/gd32/arm/gd32h77d-ginopi/applications/Kconfig
```kconfig
menu "Applications"

    config BSP_USING_USB_CDC_EXAMPLE
        bool "Enable USB CDC heartbeat in main"
        depends on BSP_USB_USING_DEVICE && RT_USB_DEVICE_CDC
        default n
        help
            Send one heartbeat per second on vcom from the LED loop.

    config BSP_USING_SDRAM_HEAP_TEST
        bool "Enable SDRAM heap test command"
        depends on BSP_USING_SDRAM && RT_USING_HEAP && RT_USING_FINSH
        depends on RT_USING_MEMHEAP_AS_HEAP && RT_USING_MEMHEAP_AUTO_BINDING
        default n
        help
            Register sdram_heap_test to verify an allocated SDRAM buffer.
            Use memheap objects as the system heap with automatic binding
            so allocations can use the external SDRAM heap.

    config BSP_USING_FILESYSTEM_TEST
        bool "Enable filesystem read/write benchmark commands"
        depends on RT_USING_DFS && RT_USING_HEAP && RT_USING_FINSH
        default n
        help
            Register readspeed and writespeed commands.

    config BSP_USING_PWM_DUAL_TEST
        bool "Enable PWM2/PWM30 test command"
        depends on BSP_USING_PWM2 && BSP_USING_PWM30 && RT_USING_FINSH
        default n
        help
            Register pwm_dual_test to control the two PWM outputs.

    config BSP_USING_RTC_ALARM_EXAMPLE
        bool "Enable RTC alarm example command"
        depends on BSP_USING_ALARM && RT_USING_FINSH
        default n
        help
            Register rtc_alarm to configure and inspect a one-shot alarm.

    config BSP_USING_OV7670_PREVIEW
        bool "Enable OV7670 LVGL preview"
        depends on PKG_LVGL_USING_LATEST && BSP_USING_LCD_MIPI && BSP_USING_OV7670
        default n
        help
            Add the camera preview UI and its optional MSH control command.

    config BSP_USING_GD32VW553_MQTT_DEMO
        bool "Enable GD32VW553 MQTT demo"
        depends on BSP_USING_GD32VW553_AT
        select PKG_USING_KAWAII_MQTT
        select KAWAII_MQTT_NETSOCKET_USE_SAL
        default n
        help
            Enable a GD32VW553 MQTT demo based on the RT-Thread
            kawaii-mqtt package. The MQTT network path is
            kawaii-mqtt, SAL socket, at_device, and GD32VW553 AT.

    if BSP_USING_GD32VW553_MQTT_DEMO

        config BSP_GD32VW553_MQTT_HOST
            string "MQTT broker address"
            default "broker.emqx.io"
            help
                Use a numeric IPv4 address when the module firmware
                does not support AT+CIPDOMAIN.

        config BSP_GD32VW553_MQTT_PORT
            int "MQTT broker port"
            range 1 65535
            default 1883

        config BSP_GD32VW553_MQTT_SUB_TOPIC
            string "MQTT subscribe topic"
            default "rtt/gd32vw553/sub"

        config BSP_GD32VW553_MQTT_PUB_TOPIC
            string "MQTT publish topic"
            default "rtt/gd32vw553/pub"

        config BSP_GD32VW553_MQTT_MESSAGE
            string "MQTT publish message"
            default "hello from GD32VW553"

        config BSP_GD32VW553_MQTT_CLIENT_ID
            string "MQTT client id"
            default "gd32vw553"

        config BSP_GD32VW553_MQTT_USERNAME
            string "MQTT username"
            default ""

        config BSP_GD32VW553_MQTT_PASSWORD
            string "MQTT password"
            default ""

    endif

endmenu
```
