## components/drivers/ipc/Kconfig
```kconfig
menuconfig RT_USING_DEVICE_IPC
    bool "Using device drivers IPC"
    default y
    select RT_USING_MUTEX
    select RT_USING_SEMAPHORE
    help
      Enable the device-layer IPC helpers (pipes, message queues, workqueues)
      that many drivers rely on for buffering and deferred processing. Disable
      only on extremely small systems that do not load drivers needing mutex or
      semaphore-based IPC primitives.

if RT_USING_DEVICE_IPC
    config RT_UNAMED_PIPE_NUMBER
        int "The number of unamed pipe"
        default 64
        help
          Maximum number of anonymous pipes that can be created at runtime.
          Reduce this to save memory if your application uses few pipes.

    config RT_USING_SYSTEM_WORKQUEUE
        bool "Using system default workqueue"
        default n
        help
          Create a global system workqueue thread so drivers can defer work out
          of interrupt context without allocating their own threads.

    if RT_USING_SYSTEM_WORKQUEUE
        config RT_SYSTEM_WORKQUEUE_STACKSIZE
            int "The stack size for system workqueue thread"
            default 2048
            help
              Stack size in bytes for the common workqueue thread; increase when
              queued jobs perform complex tasks or call into heavy subsystems.

        config RT_SYSTEM_WORKQUEUE_PRIORITY
            int "The priority level of system workqueue thread"
            default 23
            help
              Scheduler priority assigned to the workqueue thread. Lower numbers
              mean higher priority; adjust relative to other timing-sensitive
              threads in your system.
    endif
endif
```

## components/drivers/ipc/utest/Kconfig
```kconfig
menu "IPC Test"
    depends on RT_USING_DEVICE_IPC

config RT_UTEST_COMPLETION
    bool "IPC Completion Test"
    default n

config RT_UTEST_WORKQUEUE
    bool "IPC Workqueue Test"
    default n

endmenu
```

## components/drivers/ktime/Kconfig
```kconfig
menuconfig RT_USING_KTIME
    bool "Ktime: kernel time (DEPRECATED - use RT_USING_CLOCK_TIME)"
    default n
    depends on !RT_USING_CLOCK_TIME
    help
        DEPRECATED: This option is maintained for backward compatibility only.
        New projects should use RT_USING_CLOCK_TIME instead.
```

## components/drivers/led/Kconfig
```kconfig
menuconfig RT_USING_LED
    bool "Using Light Emitting Diode (LED) device drivers"
    depends on RT_USING_DM
    default n

config RT_LED_GPIO
    bool "GPIO connected LEDs Support"
    depends on RT_USING_LED
    depends on RT_USING_PINCTRL
    depends on RT_USING_OFW
    default n

config RT_LED_PWM
    bool "PWM driven LEDs Support"
    depends on RT_USING_LED
    depends on RT_USING_PWM
    depends on RT_USING_OFW
    default n

config RT_LED_SYSCON
    bool "System controllers connected LEDs Support"
    depends on RT_USING_LED
    depends on RT_MFD_SYSCON
    default n

if RT_USING_LED
    osource "$(SOC_DM_LED_DIR)/Kconfig"
endif
```

## components/drivers/mailbox/Kconfig
```kconfig
menuconfig RT_USING_MBOX
    bool "Using Hardware Mailbox device drivers"
    depends on RT_USING_DM
    depends on RT_USING_OFW
    default n
    help
      Enable the mailbox framework so multi-core SoCs or remote processors can
      exchange messages via hardware mailbox/FIFO IP. The core registers mailbox
      controllers described in device tree, manages channel timeouts, and
      exposes asynchronous send/receive callbacks to drivers such as RPMsg or
      audio DSP clients. Disable it only when the SoC lacks mailbox hardware.

config RT_MBOX_PIC
    bool "RT-Thread PIC Mailbox"
    depends on RT_USING_MBOX
    default y
    help
      Build the PIC mailbox controller driver which exposes RT-Thread's
      platform interrupt controller mailboxes through the common API. Select it
      when the firmware runs on platforms where the PIC provides mailbox
      registers (for example Sophgo SG2042); turning it off prevents those DTS
      nodes from binding.

if RT_USING_MBOX
    osource "$(SOC_DM_MBOX_DIR)/Kconfig"
endif
```

## components/drivers/mfd/Kconfig
```kconfig
menuconfig RT_USING_MFD
    bool "Using Multifunction device drivers (MFD)"
    depends on RT_USING_DM
    default n
    help
      Enable the MFD framework so composite chips (PMICs, southbridges, etc.)
      described in device tree can expose multiple child devices (GPIO, RTC,
      regulator…) through the driver model. Required when your board uses such
      multifunction ICs; disable to save code if every device is standalone.

config RT_MFD_EDU
    bool "Educational device driver"
    depends on RT_USING_MFD
    depends on RT_USING_PCI
    depends on RT_USING_DMA
    default n

config RT_MFD_SYSCON
    bool "System Controller Register R/W"
    depends on RT_USING_MFD
    depends on RT_USING_OFW
    default y
    help
      Provide the syscon helper that maps register banks described by
      `syscon`/`simple-mfd` nodes and allows other drivers to read/write them.
      Keep enabled on SoCs whose reset/clock/PHY drivers access syscon regions.

if RT_USING_MFD
    osource "$(SOC_DM_MFD_DIR)/Kconfig"
endif
```

## components/drivers/mtd/Kconfig
```kconfig
config RT_USING_MTD_NOR
    bool "Using MTD Nor Flash device drivers"
    default n
    help
      Enable the Memory Technology Device (MTD) NOR layer so SPI/QSPI or
      parallel NOR flashes can be registered and exposed to the filesystem or
      FAL. Select this when your design stores code/data in NOR.

config RT_USING_MTD_NAND
    bool "Using MTD Nand Flash device drivers"
    default n
    help
      Enable NAND flash management (bad-block handling, ECC hooks, partitions).
      Requires platform-specific ECC support and is needed for raw NAND storage.

    if RT_USING_MTD_NAND
    config RT_MTD_NAND_DEBUG
        bool "Enable MTD Nand operations debug information"
        default n
        help
          Print verbose details for each NAND read/write/erase operation to aid
          bring-up. Disable in production to avoid large log output.
    endif
```

## components/drivers/nvme/Kconfig
```kconfig
menuconfig RT_USING_NVME
    bool "Using Non-Volatile Memory Express (NVME) device drivers"
    depends on RT_USING_DM
    depends on RT_USING_BLK
    depends on RT_USING_DMA
    default n
    help
      Enable the NVMe driver stack so PCIe-connected SSDs can be discovered,
      command queues created, and block devices exported through the block
      layer. Requires DMA and the driver model; disable if your platform lacks
      NVMe hardware.

config RT_USING_NVME_IO_QUEUE
    int "Number of I/O Command queue"
    depends on RT_USING_NVME
    default 2 if RT_THREAD_PRIORITY_8
    default 4 if RT_THREAD_PRIORITY_32
    default 8 if RT_THREAD_PRIORITY_256
    help
      Set how many submission/completion queue pairs to create for NVMe I/O.
      More queues improve parallelism on multicore systems but consume more DMA
      memory and interrupts.

config RT_NVME_PCI
    bool "NVME support on PCI bus"
    depends on RT_USING_NVME
    depends on RT_USING_PCI
    default y
    help
      Allow the driver to bind to NVMe controllers discovered via PCI/PCIe.
      Disable only for non-PCI environments (for example, custom interconnects).

if RT_USING_NVME
    osource "$(SOC_DM_NVME_DIR)/Kconfig"
endif
```

## components/drivers/nvmem/Kconfig
```kconfig
menuconfig RT_USING_NVMEM
    bool "Using Non Volatile Memory (NVMEM) device drivers"
    depends on RT_USING_DM
    depends on RT_USING_OFW
    depends on RT_USING_PIN
    select RT_USING_ADT
    select RT_USING_ADT_REF
    default n

if RT_USING_NVMEM
    osource "$(SOC_DM_NVMEM_DIR)/Kconfig"
endif
```
