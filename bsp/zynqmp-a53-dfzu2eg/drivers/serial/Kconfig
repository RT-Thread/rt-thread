## components/drivers/KConfig
```kconfig
menu "Device Drivers"

config RT_USING_DEVICE_IPC
    bool "Using device drivers IPC"
    default y

config RT_USING_SERIAL
    bool "Using serial device drivers"
    default y

config RT_USING_CAN
    bool "Using CAN device drivers"
    default n

config RT_USING_HWTIMER
    bool "Using hardware timer device drivers"
    default n

config RT_USING_I2C
    bool "Using I2C device drivers"
    default n

if RT_USING_I2C
    config RT_USING_I2C_BITOPS
        bool "Use GPIO to simulate I2C"
        default y
endif

config RT_USING_PIN
    bool "Using generic GPIO device drivers"
    default y

config RT_USING_MTD_NOR
    bool "Using MTD Nor Flash device drivers"
    default n

config RT_USING_MTD_NAND
    bool "Using MTD Nand Flash device drivers"
    default n

    if RT_USING_MTD_NAND
    config RT_MTD_NAND_DEBUG
        bool "Enable MTD Nand operations debug information"
        default n
    endif

config RT_USING_RTC
    bool "Using RTC device drivers"
    default n

config RT_USING_SDIO
    bool "Using SD/MMC device drivers"
    default n

config RT_USING_SPI
    bool "Using SPI Bus/Device device drivers"
    default n

    if RT_USING_SPI
        config RT_USING_SFUD
            bool "Using Serial Flash Universal Driver"
            default n
            if RT_USING_SFUD            
                config RT_SFUD_USING_SFDP
                bool "Using auto probe flash JEDEC SFDP parameter"
                default y
                
                config RT_SFUD_USING_FLASH_INFO_TABLE
                bool "Using defined supported flash chip information table"
                default y
                
                config RT_SFUD_DEBUG
                bool "Show more SFUD debug information"
                default n
            endif
    
        config RT_USING_W25QXX
            bool "Using W25QXX SPI NorFlash"
            default n

        config RT_USING_GD
            bool "Using GD SPI NorFlash"
            default n

        config RT_USING_ENC28J60
            bool "Using ENC28J60 SPI Ethernet network interface"
            select RT_USING_LWIP
            default n

        config RT_USING_SPI_WIFI
            bool "Using RW009/007 SPI Wi-Fi wireless interface"
            select RT_USING_LWIP
            default n
    endif

config RT_USING_WDT
    bool "Using Watch Dog device drivers"
    default n

config RT_USING_USB_HOST
    bool "Using USB host"
    default n

    if RT_USING_USB_HOST
        config RT_USBH_ADK
            bool "Enable connected with Android by ADK USB"
            default n
    endif

config RT_USING_USB_DEVICE
    bool "Using USB device"
    default n

    if RT_USING_USB_DEVICE
        config RT_USB_DEVICE_CDC
            bool "Enable to use device as CDC device"
            default n

        config RT_USB_DEVICE_MSTORAGE
            bool "Enable to use device as Mass Storage device"
            default n
        config RT_USB_DEVICE_HID
            bool "Enable to use device as HID device"
            default n
    endif
endmenu
```

## components/drivers/Kconfig
```kconfig
menu "Device Drivers"

rsource "core/Kconfig"
rsource "ipc/Kconfig"

rsource "serial/Kconfig"
rsource "can/Kconfig"
rsource "cputime/Kconfig"
rsource "i2c/Kconfig"
rsource "phy/Kconfig"
rsource "misc/Kconfig"
rsource "mtd/Kconfig"
rsource "pm/Kconfig"
rsource "rtc/Kconfig"
rsource "sdio/Kconfig"
rsource "spi/Kconfig"
rsource "watchdog/Kconfig"
rsource "audio/Kconfig"
rsource "sensor/Kconfig"
rsource "touch/Kconfig"
rsource "graphic/Kconfig"
rsource "hwcrypto/Kconfig"
rsource "wlan/Kconfig"
rsource "led/Kconfig"
rsource "mailbox/Kconfig"
rsource "phye/Kconfig"
rsource "ata/Kconfig"
rsource "nvme/Kconfig"
rsource "block/Kconfig"
rsource "scsi/Kconfig"
rsource "regulator/Kconfig"
rsource "reset/Kconfig"
rsource "thermal/Kconfig"
rsource "virtio/Kconfig"
rsource "dma/Kconfig"
rsource "mfd/Kconfig"
rsource "ofw/Kconfig"
rsource "pci/Kconfig"
rsource "pic/Kconfig"
rsource "pin/Kconfig"
rsource "pinctrl/Kconfig"
rsource "ktime/Kconfig"
rsource "clk/Kconfig"
rsource "hwtimer/Kconfig"
rsource "usb/Kconfig"

endmenu
```

## components/drivers/adc/Kconfig
```kconfig
menuconfig RT_USING_ADC
    bool "Using ADC device drivers"
    default n

if RT_USING_ADC
    config RT_USING_ADC_V2
        bool "Using ADC V2 device drivers"
        default n
        help
            Enable the standalone ADC V2 framework. ADC V2 uses the legacy ADC
            public namespace, so it cannot be enabled together with ADC V1.

    config RT_USING_ADC_V1
        bool
        default y if !RT_USING_ADC_V2

if RT_USING_DM && RT_USING_ADC_V1
    osource "$(SOC_DM_ADC_DIR)/Kconfig"
endif

if RT_USING_ADC_V2


config RT_ADC_USING_TRIGGER
    bool "Enable ADC trigger framework"
    default n
    help
        Enable device-level ADC trigger requests, framework validation, caching,
        and stream lifecycle coordination. Timer trigger frequency and TRGO
        start/stop are delegated to the timer trigger backend.

config RT_ADC_TRIGGER_USING_TIMER
    bool "Enable ADC timer trigger selector support"
    depends on RT_ADC_USING_TRIGGER
    default n
    help
        Enable timer update/TRGO and timer compare events as ADC stream
        trigger sources.

config RT_ADC_TRIGGER_USING_COMPARE
    bool "Enable ADC analog comparator trigger selector support"
    depends on RT_ADC_USING_TRIGGER
    default n
    help
        Enable analog comparator output events as ADC stream trigger sources.


config RT_ADC_USING_STREAM
    bool "Enable ADC stream framework"
    default n
    help
        Enable long-running ADC stream sessions.

        Disable this option to remove ADC stream runtime state, stream APIs,
        and stream backend hooks from the ADC V2 framework.

if RT_ADC_USING_STREAM

menu "ADC stream buffering policies"

config RT_ADC_STREAM_USING_LATEST
    bool "Enable ADC stream latest-frame policy"
    default y
    help
        Enable the latest-frame ADC stream policy.

        This mode is intended for slow-changing or status-like ADC values, such
        as battery voltage, temperature, potentiometer input, resistor-divider
        voltage, or board health monitoring.

        The DMA buffer stores exactly one complete ADC scan frame. Old values
        may be overwritten. This mode does not require DMA half-transfer or
        transfer-complete data interrupts, and it does not allocate a framework
        FIFO.

        This option may be enabled together with RT_ADC_STREAM_USING_FIFO. The
        active policy is selected per stream at runtime.

config RT_ADC_STREAM_USING_FIFO
    bool "Enable ADC stream FIFO policy"
    default n
    help
        Enable the FIFO ADC stream policy.

        This mode is intended for continuous and loss-sensitive sampling. The
        DMA buffer is used as a staging buffer, and completed DMA data events
        are copied into a ringbuffer for ordered blocking reads.

        FIFO mode requires DMA data events. The default DMA event mode uses both
        half-transfer and transfer-complete events to reduce read latency. A
        stream configuration may select full-only events to reduce interrupt
        frequency, at the cost of higher latency and larger data bursts.

        This option may be enabled together with RT_ADC_STREAM_USING_LATEST. The
        active policy is selected per stream at runtime.

comment "At least one ADC stream buffering policy should be enabled"
    depends on !RT_ADC_STREAM_USING_LATEST && !RT_ADC_STREAM_USING_FIFO

endmenu

endif

config RT_ADC_V2_USING_MSH
    bool "Enable ADC V2 MSH command"
    depends on RT_USING_FINSH
    default y
    help
        Enable the ADC V2 MSH command.

        This option exports the "adc" shell command for probing ADC devices,
        configuring channels, reading raw samples, reading voltage values, and
        reading one ADC sequence. When RT_ADC_USING_STREAM is enabled, stream
        subcommands are also available.

        Disable this option to remove the ADC V2 shell command while keeping
        the ADC V2 framework and driver APIs available.

endif

endif
```

## components/drivers/ata/Kconfig
```kconfig
menuconfig RT_USING_ATA
    bool "Using Advanced Technology Attachment (ATA) device drivers"
    depends on RT_USING_DM
    depends on RT_USING_BLK
    depends on RT_USING_DMA
    default n
    help
      Enable the ATA core so AHCI/legacy controllers can register themselves in
      the driver model, allocate DMA resources, and expose block devices to the
      RT-Thread block layer. Select this only on SoCs/boards that actually wire
      SATA ports because it pulls in the SCSI translation layer and requires DMA
      support. When disabled, no SATA disks will be enumerated.

config RT_ATA_AHCI
    bool "Advanced Host Controller Interface (AHCI)"
    depends on RT_USING_ATA
    depends on RT_USING_SCSI
    default y
    help
      Build the generic AHCI driver that maps HBA registers (ports, command list,
      FIS receive, etc.), handles NCQ, and bridges each detected SATA device to
      the RT-SCSI mid-layer so filesystems can treat them like disks. Enable it
      whenever your SoC implements a standards-compliant AHCI core; disable if
      you rely on a vendor-specific ATA engine.

config RT_ATA_AHCI_PCI
    bool "AHCI support on PCI bus"
    depends on RT_ATA_AHCI
    depends on RT_USING_PCI
    default n
    help
      Allow the AHCI driver to bind to PCI devices and fetch resources via PCI
      config space. Required on PC-class hardware where the AHCI HBA is behind
      PCI/PCIe; boards with platform AHCI (non-PCI) can leave this off to save a
      little code.

if RT_USING_ATA
    osource "$(SOC_DM_ATA_DIR)/Kconfig"
endif
```

## components/drivers/audio/Kconfig
```kconfig
menuconfig RT_USING_AUDIO
    bool "Using Audio device drivers"
    default n

    if RT_USING_AUDIO
        config RT_AUDIO_REPLAY_MP_BLOCK_SIZE
            int "Replay memory pool block size"
            default 4096

        config RT_AUDIO_REPLAY_MP_BLOCK_COUNT
            int "Replay memory pool block count"
            default 2

        config RT_AUDIO_RECORD_PIPE_SIZE
            int "Record pipe size"
            default 2048

    endif

config RT_AUDIO_INTEL_HDA
    bool "Enable Intel High Definition Audio"
    depends on RT_USING_DM
    depends on RT_USING_AUDIO
    depends on RT_USING_PCI
    default n

if RT_USING_DM && RT_USING_AUDIO
    osource "$(SOC_DM_AUDIO_DIR)/Kconfig"
endif
```

## components/drivers/audio/utest/Kconfig
```kconfig
if RT_USING_AUDIO
    config RT_UTEST_USING_AUDIO_DRIVER
        bool "Audio Test"
        default n
endif
```

## components/drivers/block/Kconfig
```kconfig
menuconfig RT_USING_BLK
    bool "Using Block device drivers"
    default n
    help
      Enable the generic block-device infrastructure so storage controllers can
      register disks/partitions and the RT-Thread DFS layer can mount them.
      Almost every filesystem, SDIO, SATA or NAND driver depends on this. Turn
      it off only on firmware builds that never interact with block media.

if RT_USING_BLK
    rsource "partitions/Kconfig"
endif
```

## components/drivers/block/partitions/Kconfig
```kconfig
menu "Partition Types"

config RT_BLK_PARTITION_DFS
    bool "DFS Partition support"
    depends on RT_USING_DFS
    default y
    help
      Parse the RT-Thread DFS partition table (vfs_part) so a single block
      device can be split into multiple named logical volumes. Enable this when
      you use the DFS tooling or `mkpart` scripts to carve flash storage; it is
      harmless to keep on because it only activates when the table signature is
      present.

config RT_BLK_PARTITION_EFI
    bool "EFI Globally Unique Identifier (GUID) Partition support"
    default y
    help
      Add GUID Partition Table (GPT) support, allowing disks formatted on
      modern PCs to be recognized. Required for SATA/NVMe/USB disks that use
      GPT; you may disable it on very small targets that only boot from DFS
      partitions to save a few kilobytes.

endmenu
```

## components/drivers/clk/Kconfig
```kconfig
menuconfig RT_USING_CLK
    bool "Using Common Clock Framework (CLK)"
    depends on RT_USING_DM
    select RT_USING_ADT_REF
    default y

config RT_CLK_SCMI
    bool "Clock driver controlled via SCMI interface"
    depends on RT_USING_CLK
    depends on RT_FIRMWARE_ARM_SCMI
    default n

if RT_USING_CLK
    osource "$(SOC_DM_CLK_DIR)/Kconfig"
endif
```

## components/drivers/clk/rockchip/Kconfig
```kconfig
menuconfig RT_CLK_ROCKCHIP
    bool "Rockchip clock controller common"
    depends on RT_USING_CLK
    select RT_USING_OFW
    select RT_USING_RESET
    default n

config RT_CLK_ROCKCHIP_RK3308
    bool "Rockchip RK3308 clock controller support"
    depends on RT_CLK_ROCKCHIP
    default n

config RT_CLK_ROCKCHIP_RK3568
    bool "Rockchip RK3568 clock controller support"
    depends on RT_CLK_ROCKCHIP
    default n
```

## components/drivers/clock_time/Kconfig
```kconfig
menuconfig RT_USING_CLOCK_TIME
    bool "Clock time subsystem"
    default n

config RT_USING_CLOCK_TIMER_TRIGGER
    bool "Enable clock timer hardware trigger output"
    depends on RT_USING_CLOCK_TIME
    default n
    help
        Enable clock timer hardware trigger output controls. Timer backends
        may use this to expose update/TRGO trigger events to ADC drivers. The
        selected timer must be dedicated to trigger output; the framework does
        not arbitrate shared use with clock-time timeouts, PWM, or other timer
        consumers.

if RT_USING_CLOCK_TIME
    config CLOCK_TIMER_FREQ
        int "Clock time timer freq"
        default 0
        depends on ARCH_RISCV64
        help
            Base frequency (Hz) for clock time counter on RISC-V.

    config RT_CLOCK_TIME_ARM_ARCH
        bool "ARM ARCH Timer"
        depends on RT_USING_DM
        depends on ARCH_ARM_CORTEX_A || ARCH_ARMV8
        default n

if RT_USING_DM
    osource "$(SOC_DM_CLOCK_TIME_DIR)/Kconfig"
endif
endif
```
