## bsp/nuclei/gd32vf103/board/Kconfig
```kconfig
menu "Hardware Drivers Config"

config SOC_GD32VF103V
    bool
    select SOC_SERIES_GD32VF103V
    default y

menu "Onboard Peripheral Drivers"

    config BSP_USING_USART
        bool "Enable USART (uart4)"
        select BSP_USING_UART
        select BSP_USING_UART4
        default y
endmenu

menu "On-chip Peripheral Drivers"

    menuconfig BSP_USING_UART
        bool "Enable UART"
        default y
        select RT_USING_SERIAL
        if BSP_USING_UART
            config BSP_USING_UART4
                bool "Enable UART4"
                default y
        endif
endmenu

menu "Board extended module Drivers"

endmenu

endmenu
```

## bsp/nuclei/gd32vf103_rvstar/Kconfig
```kconfig
mainmenu "RT-Thread Configuration"

BSP_DIR := .

RTT_DIR := ../../..

PKGS_DIR := packages

source "$(RTT_DIR)/Kconfig"
osource "$PKGS_DIR/Kconfig"
rsource "board/Kconfig"

config SOC_GD32VF103
    bool
    select ARCH_RISCV32
    select PKG_USING_NUCLEI_SDK
    select RT_USING_COMPONENTS_INIT
    select RT_USING_USER_MAIN
    default y
```

## bsp/nuclei/gd32vf103_rvstar/board/Kconfig
```kconfig
menu "Hardware Drivers Config"

config SOC_GD32VF103V
    bool
    select SOC_SERIES_GD32VF103V
    default y

menu "Onboard Peripheral Drivers"

    config BSP_USING_UART_CONSOLE
        bool "Enable UART CONSOLE"
        select BSP_USING_UART
        select BSP_USING_UART4
        default y
endmenu

menu "On-chip Peripheral Drivers"

    menuconfig BSP_USING_UART
        bool "Enable UART"
        default y
        select RT_USING_SERIAL
        if BSP_USING_UART
            config BSP_USING_UART0
                bool "Enable UART0"
                default n
            config BSP_USING_UART1
                bool "Enable UART1"
                default n
            config BSP_USING_UART2
                bool "Enable UART2"
                default n
            config BSP_USING_UART3
                bool "Enable UART3"
                default n
            config BSP_USING_UART4
                bool "Enable UART4"
                default n
        endif

    menuconfig BSP_USING_I2C
        bool "Enable I2C"
        default n
        select RT_USING_I2C
        if BSP_USING_I2C
            config BSP_USING_I2C0
                bool "Enable I2C0"
                default n
            config BSP_USING_I2C1
                bool "Enable I2C1"
                default n
        endif

    menuconfig BSP_USING_SPI
        bool "Enable SPI"
        default n
        select RT_USING_SPI
        if BSP_USING_SPI
            config BSP_USING_SPI0
                bool "Enable SPI0"
                default n
            config BSP_USING_SPI1
                bool "Enable SPI1"
                default n
            config BSP_USING_SPI2
                bool "Enable SPI2"
                default n
        endif

    menuconfig BSP_USING_HWTIMER
        bool "Enable TIMER"
        default n
        select RT_USING_HWTIMER
        if BSP_USING_HWTIMER
            config BSP_USING_HWTIMER0
                bool "Enable TIMER0"
                default n
            config BSP_USING_HWTIMER1
                bool "Enable TIMER1"
                default n
            config BSP_USING_HWTIMER2
                bool "Enable TIMER2"
                default n
            config BSP_USING_HWTIMER3
                bool "Enable TIMER3"
                default n
            config BSP_USING_HWTIMER4
                bool "Enable TIMER4"
                default n
            config BSP_USING_HWTIMER5
                bool "Enable TIMER5"
                default n
            config BSP_USING_HWTIMER6
                bool "Enable TIMER6"
                default n
        endif

    menuconfig BSP_USING_ADC
        bool "Enable ADC"
        default n
        select RT_USING_ADC
        if BSP_USING_ADC
            config BSP_USING_ADC0
                bool "Enable ADC0"
                default n
            config BSP_USING_ADC1
                bool "Enable ADC1"
                default n
        endif

    menuconfig BSP_USING_WDT
        bool "Enable WDT"
        default n
        select RT_USING_WDT

    menuconfig BSP_USING_RTC
        bool "Enable RTC"
        default n
        select RT_USING_RTC

    menuconfig BSP_USING_PWM
        bool "Enable PWM"
        default n
        select RT_USING_PWM
        if BSP_USING_PWM
            config BSP_USING_PWM0
                bool "Enable PWM0"
                default n
            config BSP_USING_PWM1
                bool "Enable PWM1"
                default n
            config BSP_USING_PWM2
                bool "Enable PWM2"
                default n
            config BSP_USING_PWM3
                bool "Enable PWM3"
                default n
            config BSP_USING_PWM4
                bool "Enable PWM4"
                default n
        endif

endmenu

menu "Board extended module Drivers"

endmenu

endmenu
```

## bsp/nuclei/hbird_eval/Kconfig
```kconfig
mainmenu "RT-Thread Configuration"

config BSP_DIR
    string
    option env="BSP_ROOT"
    default "."

config RTT_DIR
    string
    option env="RTT_ROOT"
    default "../../.."

config PKGS_DIR
    string
    option env="PKGS_ROOT"
    default "packages"
 
source "$RTT_DIR/Kconfig"
source "$PKGS_DIR/Kconfig"
source "board/Kconfig"

config SOC_HUMMINGBIRD
    bool
    select ARCH_RISCV
    select PKG_USING_NUCLEI_SDK
    select RT_USING_COMPONENTS_INIT
    select RT_USING_USER_MAIN
    default y
```

## bsp/nuclei/nuclei_fpga_eval/Kconfig
```kconfig
mainmenu "RT-Thread Configuration"

BSP_DIR := .

RTT_DIR := ../../..

PKGS_DIR := packages

source "$(RTT_DIR)/Kconfig"
osource "$PKGS_DIR/Kconfig"
rsource "board/Kconfig"

config SOC_DEMOSOC
    bool
    select ARCH_RISCV
    select PKG_USING_NUCLEI_SDK
    select RT_USING_COMPONENTS_INIT
    select RT_USING_USER_MAIN
    default y
```

## bsp/nuclei/nuclei_fpga_eval/board/Kconfig
```kconfig
menu "Hardware Drivers Config"

config SOC_HUMMINGBIRD
    bool
    select SOC_SERIES_HUMMINGBIRD
    select RT_USING_HW_ATOMIC
    default y

menu "Onboard Peripheral Drivers"

    config BSP_USING_UART_CONSOLE
        bool "Enable UART CONSOLE"
        select BSP_USING_UART
        select BSP_USING_UART0
        default y
endmenu

menu "On-chip Peripheral Drivers"

    menuconfig BSP_USING_UART
        bool "Enable UART"
        default y
        select RT_USING_SERIAL
        if BSP_USING_UART
            config BSP_USING_UART0
                bool "Enable UART0"
                default n
            config BSP_USING_UART1
                bool "Enable UART1"
                default n
        endif

endmenu

menu "Board extended module Drivers"

endmenu

endmenu
```
