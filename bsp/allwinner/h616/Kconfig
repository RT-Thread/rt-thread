## bsp/nxp/mcx/mcxc/frdm-mcxc162/board/Kconfig
```kconfig
menu "Hardware Drivers Config"

config SOC_MCXC162
    bool
    select RT_USING_COMPONENTS_INIT
    select RT_USING_USER_MAIN
    default y

menu "On-chip Peripheral Drivers"

config BSP_USING_PIN
    bool "Enable GPIO"
    select RT_USING_PIN
    default y

menuconfig BSP_USING_UART
    bool "Enable LPUART"
    select RT_USING_SERIAL
    default y

if BSP_USING_UART
    config BSP_USING_UART0
        bool "Enable LPUART0 as uart0"
        default y

    config BSP_USING_UART1
        bool "Enable LPUART1 as uart1"
        default n

    config BSP_USING_UART2
        bool "Enable LPUART2 as uart2"
        default n
endif

menuconfig BSP_USING_I2C
    bool "Enable LPI2C"
    select RT_USING_I2C
    default n

if BSP_USING_I2C
    config BSP_USING_I2C0
        bool "Enable LPI2C0 as i2c0"
        default y
endif

menuconfig BSP_USING_SPI
    bool "Enable LPSPI"
    select BSP_USING_PIN
    select RT_USING_SPI
    default n

if BSP_USING_SPI
    config BSP_USING_SPI0
        bool "Enable LPSPI0 as spi0"
        default y
endif

config BSP_USING_RTC
    bool "Enable RTC0 as rtc"
    select RT_USING_RTC
    default n

config BSP_USING_WDT
    bool "Enable WWDT0 as wdt"
    select RT_USING_WDT
    default n

menuconfig BSP_USING_CLOCK_TIMER
    bool "Enable CTIMER hardware timers"
    select RT_USING_CLOCK_TIME
    default n

if BSP_USING_CLOCK_TIMER
    config BSP_USING_CTIMER0
        bool "Enable CTIMER0 as timer0"
        default y

    config BSP_USING_CTIMER1
        bool "Enable CTIMER1 as timer1"
        depends on BSP_USING_CTIMER0
        default n
endif

menuconfig BSP_USING_PWM
    bool "Enable FLEXPWM"
    select RT_USING_PWM
    default n

if BSP_USING_PWM
    config BSP_USING_PWM0
        bool "Enable FLEXPWM0 SM0 as pwm0"
        default y
endif

endmenu
endmenu
```

## bsp/nxp/mcx/mcxc/libraries/Kconfig
```kconfig
config SOC_MCX
    bool
    select PKG_USING_NXP_MCX_CMSIS_DRIVER
    select PKG_USING_NXP_MCX_SERIES_DRIVER
```

## bsp/qemu-virt64-riscv/Kconfig
```kconfig
mainmenu "RT-Thread Project Configuration"

BSP_DIR := .

RTT_DIR := ../../

PKGS_DIR := packages

SOC_DM_PIC_DIR      := $(RTT_DIR)/libcpu/risc-v/common/pic
SOC_DM_SERIAL_DIR   := $(RTT_DIR)/libcpu/risc-v/common/serial
SOC_DM_HWCACHE_DIR  := $(RTT_DIR)/libcpu/risc-v/common/hwcache
SOC_DM_SOC_DIR      := $(BSP_DIR)/driver

choice
    prompt "RISC-V XLEN"
    default BSP_QEMU_RISCV64

    config BSP_QEMU_RISCV32
        bool "RV32"

    config BSP_QEMU_RISCV64
        bool "RV64"
endchoice

config ARCH_TEXT_OFFSET
    range 0x400000 0x400000 if BSP_QEMU_RISCV32
    range 0x200000 0x200000 if BSP_QEMU_RISCV64
    default 0x400000 if BSP_QEMU_RISCV32
    default 0x200000 if BSP_QEMU_RISCV64

config ARCH_RAM_OFFSET
    range 0x80000000 0x80000000
    default 0x80000000

source "$(RTT_DIR)/Kconfig"
osource "$PKGS_DIR/Kconfig"

config BSP_USING_QEMU_RISCV_VIRT
    bool
    select ARCH_RISCV32 if BSP_QEMU_RISCV32
    select ARCH_RISCV64 if BSP_QEMU_RISCV64
    select RT_USING_RISCV_NEW_COMMON
    select RT_USING_COMPONENTS_INIT
    select RT_USING_USER_MAIN
    select RT_USING_CACHE
    select ARCH_MM_MMU
    select ARCH_REMAP_KERNEL if RT_USING_SMART
    select ARCH_RISCV_FPU_D if BSP_QEMU_RISCV64
    select RT_KLIBC_USING_VSNPRINTF_LONGLONG
    select RT_USING_HW_ATOMIC
    select RT_USING_STDC_ATOMIC
    default y
```

## bsp/qemu-virt64-riscv/driver/Kconfig
```kconfig
config RT_GRAPHIC_ROMFB_WIDTH
    int "ROM FB width"
    depends on RT_GRAPHIC_FB
    default 800

config RT_GRAPHIC_ROMFB_HEIGHT
    int "ROM FB height"
    depends on RT_GRAPHIC_FB
    default 600
```

## bsp/raspberry-pi/dm/adc/Kconfig
```kconfig
config RT_ADC_RP1
    bool "RP1 ADC and temperature sensor driver"
    depends on RT_USING_DM
    depends on RT_USING_ADC
    depends on RT_USING_REGULATOR
    default n
```

## bsp/raspberry-pi/dm/audio/Kconfig
```kconfig
config RT_AUDIO_BCM2835_I2S
    bool "Broadcom BCM2835 I2S"
    depends on RT_USING_DMA
    default n
```

## bsp/raspberry-pi/dm/clk/Kconfig
```kconfig
config RT_CLK_BCM2711_DVP
    bool "Broadcom BCM2711 DVP support"
    depends on RT_USING_OFW
    default n

config RT_CLK_BCM2835
    bool "Broadcom BCM2835 clock support"
    depends on RT_USING_OFW
    default n

config RT_CLK_RASPBERRYPI
    bool "Raspberry Pi firmware based clock support"
    depends on RT_USING_OFW
    default n

config RT_CLK_RP1
    bool "RP1 clock support"
    depends on RT_USING_OFW
    default n
```

## bsp/raspberry-pi/dm/dvfs/Kconfig
```kconfig
config RT_DVFS_RASPBERRY_CPUFREQ
    bool "Raspberry firmware CPUfreq driver"
    depends on RT_USING_DVFS
    default n
```
