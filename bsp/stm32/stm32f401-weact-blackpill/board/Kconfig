## bsp/stm32/stm32f407-rt-spark/applications/Kconfig.demo
```kconfig
menu "Onboard Peripheral Drivers"

    config BSP_USING_ARDUINO
        bool "Compatible with Arduino Ecosystem (RTduino)"
        select PKG_USING_RTDUINO
        select BSP_USING_STLINK_TO_USART
        select BSP_USING_UART1
        select BSP_USING_UART2
        select BSP_USING_GPIO
        select BSP_USING_ADC
        select BSP_USING_ADC3
        select BSP_USING_DAC
        select BSP_USING_DAC1
        select BSP_USING_PWM
        select BSP_USING_PWM1
        select BSP_USING_PWM1_CH2
        select BSP_USING_PWM1_CH3
        select BSP_USING_PWM2
        select BSP_USING_PWM2_CH3
        select BSP_USING_PWM2_CH4
        select BSP_USING_PWM4
        select BSP_USING_PWM4_CH1
        select BSP_USING_I2C
        select BSP_USING_I2C4
        select BSP_USING_I2C5
        select BSP_USING_SPI
        select BSP_USING_SPI1
        imply RTDUINO_USING_SERVO
        imply RTDUINO_USING_WIRE
        imply RTDUINO_USING_SPI
        default n

endmenu

menu "On-chip Peripheral Drivers"

    menuconfig BSP_USING_UART
        bool "Enable UART"
        default y
        select RT_USING_SERIAL
        if BSP_USING_UART
            config BSP_USING_UART1
                bool "Enable UART1"
                default n
            config BSP_USING_UART2
                bool "Enable UART2"
                default n
        endif

    config BSP_USING_GPIO
        bool "Enable GPIO"
        select RT_USING_PIN
        default y

    menuconfig BSP_USING_ADC
        bool "Enable ADC"
        default n
        select RT_USING_ADC
        if BSP_USING_ADC
            config BSP_USING_ADC3
                bool "Enable ADC3"
                default n
        endif

    menuconfig BSP_USING_DAC
        bool "Enable DAC"
        default n
        select RT_USING_DAC
        if BSP_USING_DAC
            config BSP_USING_DAC1"
                bool "Enable DAC1"
                default n
        endif

    menuconfig BSP_USING_PWM
        bool "Enable PWM"
        default n
        select RT_USING_PWM
        if BSP_USING_PWM
        menuconfig BSP_USING_PWM1
            bool "Enable timer1 output PWM"
            default n
            if BSP_USING_PWM1
                config BSP_USING_PWM1_CH2
                    bool "Enable PWM1 channel2"
                    default n
                config BSP_USING_PWM1_CH3
                    bool "Enable PWM1 channel3"
                    default n
            endif

        menuconfig BSP_USING_PWM2
            bool "Enable timer2 output PWM"
            default n
            if BSP_USING_PWM2
                config BSP_USING_PWM2_CH3
                    bool "Enable PWM2 channel3"
                    default n
                config BSP_USING_PWM2_CH4
                    bool "Enable PWM2 channel4"
                    default n
            endif

        menuconfig BSP_USING_PWM4
            bool "Enable timer4 output PWM"
            default n
            if BSP_USING_PWM4
                config BSP_USING_PWM4_CH1
                    bool "Enable PWM4 channel1"
                    default n
            endif

        endif

    menuconfig BSP_USING_SPI
        bool "Enable SPI BUS"
        default n
        select RT_USING_SPI
        if BSP_USING_SPI
            config BSP_USING_SPI1
                bool "Enable SPI1 BUS"
                default n
        endif

    menuconfig BSP_USING_I2C1
        bool "Enable I2C1 BUS (software simulation)"
        default n
        select RT_USING_I2C
        select RT_USING_I2C_BITOPS
        select RT_USING_PIN
        if BSP_USING_I2C1
            config BSP_I2C1_SCL_PIN
                int "i2c1 scl pin number (PG.7)"
                default 103
            config BSP_I2C1_SDA_PIN
                int "i2c1 sda pin number (PD.7)"
                default 55
            config BSP_I2C2_SCL_PIN
                int "i2c2 scl pin number (PB.6)"
                default 22
            config BSP_I2C2_SDA_PIN
                int "i2c2 sda pin number (PB.7)"
                default 23
        endif

endmenu
```
