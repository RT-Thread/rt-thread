## components/vbus/Kconfig
```kconfig
menuconfig RT_USING_VBUS
    bool "VBus: virtual software bus"
    default n

if RT_USING_VBUS
    config RT_USING_VBUS_RFS
        bool "Enable Remote File System on VBus"
        default n
        help
            When enable remote file system, the application can visit the remote file system
            through VBus with POSIX file I/O.

    config RT_USING_VBUS_RSHELL
        bool "Enable Remote Shell on VBus"
        default n
        help
            When enable remote shell, the finsh/msh of RT-Thread can be operated from another
            Operating System.

    config RT_VBUS_USING_TESTS
        bool "Enable tests on VBus "
        default n

    config _RT_VBUS_RING_BASE
        hex "VBus address"
        help
            VBus ring buffer physical address.

    config _RT_VBUS_RING_SZ
        int "VBus ring size"
        help
            VBus size of the ring buffer.

    config RT_VBUS_GUEST_VIRQ
        int "RT_VBUS_GUEST_VIRQ"
        help
            RT_VBUS_GUEST_VIRQ
        help
            The interrupt number used to notify the client on a particular system.

    config RT_VBUS_HOST_VIRQ
        int "RT_VBUS_HOST_VIRQ"
        help
            The interrupt be triggered on a particular system when the client notify the host.

    config RT_VBUS_SHELL_DEV_NAME
        string "RT_VBUS_SHELL_DEV_NAME"
        default "vbser0"
        help
            The name of the UBUS shell device.

    config RT_VBUS_RFS_DEV_NAME
        string "RT_VBUS_RFS_DEV_NAME"
        default "rfs"
        help
            The name of the UBUS rfs device.

endif
```

## env/packages/packages/iot/nrf24l01_network/Kconfig
```kconfig
# Kconfig file for package nrf24l01_network
menuconfig PKG_USING_NRF24L01_NETWORK
    bool "NRF24L01 Network: a nrf24l01 network package for rt-thread"
    default n
	select PKG_USING_TINYCRYPT if PKG_USING_NRF24L01_NETWORK
	select TINY_CRYPT_MD5 if PKG_USING_TINYCRYPT

if PKG_USING_NRF24L01_NETWORK
    config PKG_NRF24L01_NETWORK_PATH
        string
        default "/packages/iot/nrf24l01_network"

    choice
        prompt "Version"
        default PKG_USING_NRF24L01_NETWORK_LATEST_VERSION
        help
            Select the package version

        config PKG_USING_NRF24L01_NETWORK_V101
            bool "v1.0.1"

        config PKG_USING_NRF24L01_NETWORK_LATEST_VERSION
            bool "latest"
    endchoice
          
    config PKG_NRF24L01_NETWORK_VER
       string
       default "v1.0.1"    if PKG_USING_NRF24L01_NETWORK_V101
       default "latest"    if PKG_USING_NRF24L01_NETWORK_LATEST_VERSION

	config NRF_SPI_BUS_NAME
		string "NRF_SPI_BUS_NAME"
		default "spi1"
	config NRF_SPI_DEV_NAME
		string "NRF_SPI_DEV_NAME"
		default "spi11"
	config NRF_SPI_CS_PIN
		int "NRF_SPI_CS_PIN"
		default 92
	config NRF_CE_PIN
		int "NRF_CE_PIN"
		default 91
	config NRF_IRQ_PIN
		int "NRF_IRQ_PIN"
		default 93
	choice
		prompt "Gateway or Node"
		default NRF24L01_USING_GATEWAY			
		config NRF24L01_USING_GATEWAY
			bool "Enable NRF24L01_GATEWAY"
		config NRF24L01_USING_NODE
			bool "Enable NRF24L01_NODE"
	endchoice
	config NRF24L01_USING_EXAMPLE
		bool "Enable NRF24L01 EXAMPLE"
		default y
		select PKG_USING_MULTIBUTTON if NRF24L01_USING_EXAMPLE
	config NRF24L01_USING_NRF_LOG
		bool "Enable NRF24L01 LOG"
		default n
endif
```

## examples/utest/testcases/Kconfig
```kconfig
menu "RT-Thread Utestcases"

config RT_USING_UTESTCASES
    bool "RT-Thread Utestcases"
    default n
    select RT_USING_UTEST

if RT_USING_UTESTCASES

rsource "utest/Kconfig"
rsource "kernel/Kconfig"
rsource "cpp11/Kconfig"
rsource "drivers/serial_v2/Kconfig"
rsource "drivers/ipc/Kconfig"
rsource "posix/Kconfig"
rsource "mm/Kconfig"
rsource "tmpfs/Kconfig"
rsource "smp_call/Kconfig"
endif

endmenu
```

## examples/utest/testcases/components/Kconfig
```kconfig
menu "Kernel Testcase"

config UTEST_CPLUPLUS11_TC
    bool "cpluplus11 test"
    default y
    depends on RT_USING_CPLUSPLUS11

endmenu
```

## examples/utest/testcases/cpp11/Kconfig
```kconfig
menu "CPP11 Testcase"

config RT_UTEST_CPP11_THREAD
    bool "Cpp11 thread test"
    select RT_USING_CPLUSPLUS
    select RT_USING_CPLUSPLUS11
    default n

endmenu
```

## examples/utest/testcases/drivers/audio/Kconfig
```kconfig
menu "Utest Driver Framewaork API Testcase"

config UTEST_AUDIO_TC
    bool "rt_audio_api testcase"
    default n

endmenu
```

## examples/utest/testcases/drivers/ipc/Kconfig
```kconfig
menu "Utest IPC Testcase"

config UTEST_COMPLETION_TC
    bool "rt_completion testcase"
    default n

config UTEST_WORKQUEUE_TC
    bool "rt_workqueue testcase"
    default n

endmenu
```

## examples/utest/testcases/drivers/serial_bypass/Kconfig
```kconfig
menu "Serial-Bypass Testcase"

config UTEST_SERIAL_BYPASS
    bool "Serial testcase"
    default n
    depends on RT_USING_SERIAL_BYPASS

endmenu
```

## examples/utest/testcases/drivers/serial_v2/Kconfig
```kconfig
menu "Utest Serial Testcase"

    config UTEST_SERIAL_TC
        bool "Serial testcase"
        default n

    if UTEST_SERIAL_TC

        config RT_SERIAL_TC_DEVICE_NAME
            string "the device name for serial test"
            default "uart2"

        config RT_SERIAL_TC_RXBUF_SIZE
            int "the rx buffer size for serial test"
            default 128

        config RT_SERIAL_TC_TXBUF_SIZE
            int "the tx buffer size for serial test"
            default 128

        config RT_SERIAL_TC_SEND_ITERATIONS
            int "the number of iterations for the test routine."
            default 100

        config UTEST_SERIAL_QEMU_TC
            bool "qemu dedicated tests"
            default n

        config UTEST_SERIAL_POSIX_TC
            bool "Serial posix testcase"
            default n
            select RT_USING_DFS
            select RT_USING_POSIX_FS
            select RT_USING_POSIX_TERMIOS

        if UTEST_SERIAL_POSIX_TC

            config RT_SERIAL_POSIX_TC_DEVICE_NAME
            string "the device name for serial posix test"
            default "dev/uart2"

            config RT_SERIAL_POSIX_TC_SEND_ITERATIONS
                int "the number of iterations for the posix test routine."
                default 100

        endif

    endif

endmenu
```

## examples/utest/testcases/kernel/Kconfig
```kconfig
menu "Kernel Testcase"

config UTEST_MEMHEAP_TC
    bool "memheap stability test"
    default y
    depends on RT_USING_MEMHEAP

config UTEST_SMALL_MEM_TC
    bool "mem test"
    default y
    depends on RT_USING_SMALL_MEM

config UTEST_SLAB_TC
    bool "slab test"
    default n
    depends on RT_USING_SLAB

config UTEST_IRQ_TC
    bool "IRQ test"
    default n

config UTEST_SEMAPHORE_TC
    bool "semaphore test"
    default n
    depends on RT_USING_SEMAPHORE

config UTEST_EVENT_TC
    bool "event test"
    default n
    depends on RT_USING_EVENT

config UTEST_TIMER_TC
    bool "timer test"
    default n

config UTEST_MESSAGEQUEUE_TC
    bool "message queue test"
    default n

config UTEST_SIGNAL_TC
    bool "signal test"
    select RT_USING_SIGNALS
    default n

config UTEST_MUTEX_TC
    bool "mutex test"
    default n

config UTEST_MAILBOX_TC
    bool "mailbox test"
    default n

config UTEST_THREAD_TC
    bool "thread test"
    default n
    select RT_USING_TIMER_SOFT
    select RT_USING_THREAD

config UTEST_ATOMIC_TC
    bool "atomic test"
    default n
    
endmenu
```

## examples/utest/testcases/kernel/smp/Kconfig
```kconfig
menu "Kernel SMP Testcase"

config UTEST_SMP_AFFFINITY_TC
    bool "smp affinity and thread priority test1"
    default n

config UTEST_SMP_ASSIGNED_IDLE_CORE_TC
    bool "smp threads auto assign to idle cores for test"
    default n

config UTEST_SMP_INTERRUPT_PRI_TC
    bool "smp interrupt priority test"
    default n

config UTEST_SMP_SPINLOCK_TC
    bool "smp spinlock test"
    default n

config UTEST_SMP_THREAD_PREEMPTION_TC
    bool "smp threads preemption test"
    default n

endmenu
```

## examples/utest/testcases/mm/Kconfig
```kconfig
menu "Memory Management Subsytem Testcase"

    config RT_UTEST_MM_API
    bool "Enable Utest for MM API"
    default n
    help
        The test covers the Memory Management APIs under the
        `components/mm` and `libcpu/[mmu.*|tlb.*|cache.*]`

    config RT_UTEST_MM_LWP
    bool "Enable Utest for MM API in lwp"
    default n
    help
        The test covers the Memory Management APIs under the
        `components/lwp`.

endmenu
```

## examples/utest/testcases/perf/Kconfig
```kconfig
menu "SyStem Performance Testcase"

config UTEST_SYS_PERF_TC
    bool "SyStem Performance test"
    default n

config UTEST_SYS_PERF_TC_COUNT
    int "Test the number of cycles"
    default 1000
    depends on UTEST_SYS_PERF_TC

config UTEST_HWTIMER_DEV_NAME
    string "Hardware timer device name"
    default "timer0"
    depends on RT_USING_HWTIMER && UTEST_SYS_PERF_TC
    help
        Specify the hardware timer device name used for context switch testing (e.g., timer0).

config UTEST_SYS_IRQ_LATENCY
    bool "SyStem IRQ LATENCY test"
    default n
    depends on RT_USING_HWTIMER && UTEST_SYS_PERF_TC

endmenu
```

## examples/utest/testcases/posix/Kconfig
```kconfig
menu "RTT Posix Testcase"

    config RTT_POSIX_TESTCASE
        select RT_USING_UTEST
        bool "RTT Posix Testcase"
        default n

    if RTT_POSIX_TESTCASE
        # rsource "aio_h/Kconfig"        # reserve
        # rsource "arpa/Kconfig"         # reserve
        # rsource "ctype_h/Kconfig"      # reserve
        rsource "dirent_h/Kconfig"
        # rsource "errno_h/Kconfig"      # reserve
        # rsource "fcntl_h/Kconfig"      # reserve
        # rsource "fenv_h/Kconfig"       # reserve
        # rsource "inttypes_h/Kconfig"   # reserve
        # rsource "libgen_h/Kconfig"     # reserve
        # rsource "locale_h/Kconfig"     # reserve
        # rsource "mqueue_h/Kconfig"     # reserve
        # rsource "net/Kconfig"          # reserve
        # rsource "netdb_h/Kconfig"      # reserve
        rsource "pthread_h/Kconfig"
        # rsource "sched_h/Kconfig"      # reserve
        # rsource "semaphore_h/Kconfig"  # reserve
        # rsource "setjmp_h/Kconfig"     # reserve
        # rsource "signal_h/Kconfig"     # reserve
        # rsource "stdarg_h/Kconfig"     # reserve
        rsource "stdio_h/Kconfig"
        rsource "stdlib_h/Kconfig"
        # rsource "string_h/Kconfig"     # reserve
        # rsource "stropts_h/Kconfig"    # reserve
        # rsource "sys/Kconfig"          # reserve
        # rsource "time_h/Kconfig"       # reserve
        rsource "unistd_h/Kconfig"
    endif

endmenu
```

## examples/utest/testcases/posix/arpa/inet_h/Kconfig
```kconfig
menuconfig RTT_POSIX_TESTCASE_ARPA_INET_H
    bool "<arpa/inet.h>"
    default n

if RTT_POSIX_TESTCASE_ARPA_INET_H

    config ARPA_INET_H_INTERFACE
    bool "<arpa/inet.h> -> htonl, htons, ntohl, ntohs, inet_addr, inet_ntoa, inet_ntop, inet_pton"
    default n

endif
```

## examples/utest/testcases/posix/ctype_h/Kconfig
```kconfig
menuconfig RTT_POSIX_TESTCASE_CTYPE_H
    bool "<ctype.h>"
    default n

if RTT_POSIX_TESTCASE_CTYPE_H

    # functions, TODO

endif
```

## examples/utest/testcases/posix/fcntl_h/Kconfig
```kconfig
menuconfig RTT_POSIX_TESTCASE_FCNTL_H
    bool "<fcntl.h>"
    default n

if RTT_POSIX_TESTCASE_FCNTL_H

# function, TODO

endif
```

## examples/utest/testcases/posix/inttypes_h/Kconfig
```kconfig
menuconfig RTT_POSIX_TESTCASE_INTTYPES_H
    bool "<inttypes.h>"
    default n

if RTT_POSIX_TESTCASE_INTTYPES_H

# function, TODO

endif
```

## examples/utest/testcases/posix/mqueue_h/Kconfig
```kconfig
menuconfig RTT_POSIX_TESTCASE_MQUEUE_H
    bool "<mqueue.h>"
    default n

if RTT_POSIX_TESTCASE_MQUEUE_H

    # functions, TODO

endif
```

## examples/utest/testcases/posix/net/if_h/Kconfig
```kconfig
menuconfig RTT_POSIX_TESTCASE_NET_IF_H
    bool "<net/if.h>"
    default n

if RTT_POSIX_TESTCASE_NET_IF_H

    config NET_IF_H_NAMEINDEX
        bool "<net/if.h> -> if_freenameindex, if_indextoname, if_nameindex, if_nametoindex"
        default n

endif
```

## examples/utest/testcases/posix/pthread_h/Kconfig
```kconfig
menuconfig RTT_POSIX_TESTCASE_PTHREAD_H
    bool "<pthread.h>"
    default n

if RTT_POSIX_TESTCASE_PTHREAD_H

    config PTHREAD_H_PTHREAD_CREATE
        bool "<pthread.h> -> pthread_create"
        default n

    config PTHREAD_H_PTHREAD_JOIN
        bool "<pthread.h> -> pthread_join"
        default n

    config PTHREAD_H_PTHREAD_EXIT
        bool "<pthread.h> -> pthread_exit"
        default n

    config PTHREAD_H_PTHREAD_COND_INIT
        bool "<pthread.h> -> pthread_cond_init"
        default n

    config PTHREAD_H_PTHREAD_COND_DESTROY
        bool "<pthread.h> -> pthread_cond_destroy"
        default n

    config PTHREAD_H_PTHREAD_COND_BROADCAST
        bool "<pthread.h> -> pthread_cond_broadcast"
        default n

    config PTHREAD_H_PTHREAD_COND_SIGNAL
        bool "<pthread.h> -> pthread_cond_signal"
        default n

    config PTHREAD_H_PTHREAD_COND_TIMEWAIT
        bool "<pthread.h> -> pthread_cond_timedwait"
        default n

    config PTHREAD_H_PTHREAD_DETACH
        bool "<pthread.h> -> pthread_detach"
        default n

endif
```
