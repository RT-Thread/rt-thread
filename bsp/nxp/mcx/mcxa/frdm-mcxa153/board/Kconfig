## bsp/nxp/mcx/mcxa/frdm-mcxa153/board/Kconfig
```kconfig
menu "Hardware Drivers Config"

config SOC_MCXN947
    bool
    select SOC_MCXN947_SERIES
    select RT_USING_COMPONENTS_INIT
    select RT_USING_USER_MAIN
    default y

menu "On-chip Peripheral Drivers"

    config BSP_USING_DMA
        bool "Enable DMA"
        select RT_USING_DMA
        default n

    config BSP_USING_PIN
        bool "Enable GPIO"
        select RT_USING_PIN
        default y

    menuconfig BSP_USING_UART
        config BSP_USING_UART
            bool "Enable UART"
            select RT_USING_UART
            default y

            if BSP_USING_UART
                config BSP_USING_UART0
                    bool "Enable LPUART as UART0"
                    default y
                config BSP_USING_UART1
                    bool "Enable LPUART as UART1"
                    default n
                config BSP_USING_UART2
                    bool "Enable LPUART as UART2"
                    default n
            endif

    menuconfig BSP_USING_I2C
        config BSP_USING_I2C
            bool "Enable I2C"
            select RT_USING_I2C
            default n

            if BSP_USING_I2C
                config BSP_USING_I2C0
                    bool "Enable I2C0"
                    default n
            endif

    menuconfig BSP_USING_SPI
        config BSP_USING_SPI
            bool "Enable SPI"
            select RT_USING_SPI
            select BSP_USING_PIN
            default n

            if BSP_USING_SPI
                config BSP_USING_SPI0
                    bool "Enable SPI0"
                    default n
					
                config BSP_USING_SPI1
                    bool "Enable SPI1"
                    default n
            endif

    menuconfig BSP_USING_ADC
        config BSP_USING_ADC
            bool "Enable ADC Channel"
            select RT_USING_ADC
            default y

            if BSP_USING_ADC
                config BSP_USING_ADC0
                    bool "Enable ADC0"
                    default y
            endif

    config BSP_USING_FLASH
        bool "Enable onchip driver"
        select RT_USING_MTD_NOR
        default n

    menuconfig BSP_USING_FS
        bool "Enable File System"
        select RT_USING_DFS
        default n

        if BSP_USING_FS
            config BSP_USING_FLASH_LITTLEFS
                bool "Enable ONCHIP FLASH(littlefs)"
                select BSP_USING_FLASH
                select PKG_USING_LITTLEFS
                default y
        endif

    config BSP_USING_WDT
        bool "Enable WatchDog"
        select RT_USING_WDT
        default n

    menuconfig BSP_USING_HWTIMER
        config BSP_USING_HWTIMER
            bool "Enable Hardware Timer"
            select RT_USING_HWTIMER
            default y

            if BSP_USING_HWTIMER
                config BSP_USING_CTIMER0
                    bool "Enable CIMER0"
                    default y

                config BSP_USING_CTIMER1
                    bool "Enable CIMER1"
                    default n

                config BSP_USING_CTIMER2
                    bool "Enable CIMER2"
                    default n
            endif

    menuconfig BSP_USING_PWM
        config BSP_USING_PWM
            bool "Enable PWM"
            select RT_USING_PWM
            default N

            if BSP_USING_PWM
                config BSP_USING_PWM0
                    bool "Enable PWM0"
                    default N
            endif
endmenu

menu "Board extended module Drivers"

endmenu

endmenu
```

## bsp/nxp/mcx/mcxa/frdm-mcxa156/board/Kconfig
```kconfig
menu "Hardware Drivers Config"

config SOC_MCXA156
    bool
    select SOC_MCXA156_SERIES
    select RT_USING_COMPONENTS_INIT
    select RT_USING_USER_MAIN
    default y

menu "On-chip Peripheral Drivers"

    config BSP_USING_DMA
        bool "Enable DMA"
        select RT_USING_DMA
        default n

    config BSP_USING_PIN
        bool "Enable GPIO"
        select RT_USING_PIN
        default y

    menuconfig BSP_USING_UART
        config BSP_USING_UART
            bool "Enable UART"
            select RT_USING_UART
            default y

            if BSP_USING_UART
                config BSP_USING_UART0
                    bool "Enable LPUART as UART"
                    default y

            endif


    menuconfig BSP_USING_I2C
        config BSP_USING_I2C
            bool "Enable I2C"
            select RT_USING_I2C
            default y

            if BSP_USING_I2C
                config BSP_USING_I2C0
                    bool "Enable Flexcomm0 I2C"
                    default y
                config BSP_USING_I2C1
                    bool "Enable Flexcomm1 I2C"
                    default y
            endif

    menuconfig BSP_USING_SPI
        config BSP_USING_SPI
            bool "Enable SPI"
            select RT_USING_SPI
            default y

            if BSP_USING_SPI
                config BSP_USING_SPI1
                    bool "Enable LPSPI1"
                    default n
            endif

    menuconfig BSP_USING_ADC
        config BSP_USING_ADC
            bool "Enable ADC Channel"
            select RT_USING_ADC
            default y

            if BSP_USING_ADC
                config BSP_USING_ADC0_CH0
                    bool "Enable ADC0 Channel0"
                    default y

                config BSP_USING_ADC0_CH1
                    bool "Enable ADC0 Channel1"
                    default n

                config BSP_USING_ADC0_CH8
                    bool "Enable ADC0 Channel8"
                    default n

        
                config BSP_USING_ADC0_CH13
                    bool "Enable ADC0 Channel13"
                    default n


                config BSP_USING_ADC0_CH26
                    bool "Enable ADC0 Channel26"
                    default n

            endif

    config BSP_USING_SDIO
        bool "Enable SDIO SD Card Interface"
        select RT_USING_SDIO
        select RT_USING_DFS
        select RT_USING_DFS_ELMFAT
        default y

    config BSP_USING_RTC
        bool "Enable RTC"
        select RT_USING_RTC
        default y

    config BSP_USING_WDT
        bool "Enable WatchDog"
        select RT_USING_WDT
        default n

    menuconfig BSP_USING_HWTIMER
        config BSP_USING_HWTIMER
            bool "Enable Timer"
            select RT_USING_HWTIMER
            default y

            if BSP_USING_HWTIMER
                config BSP_USING_CTIMER0
                    bool "Enable CIMER0"
                    default y

                config BSP_USING_CTIMER1
                    bool "Enable CIMER1"
                    default n

                config BSP_USING_CTIMER3
                    bool "Enable CIMER3"
                    default n

                config BSP_USING_CTIMER4
                    bool "Enable CIMER4"
                    default n
            endif

        menuconfig BSP_USING_PWM
            config BSP_USING_PWM
                bool "Enable PWM"
                select RT_USING_PWM
                default n
    
                if BSP_USING_PWM
                    config BSP_USING_PWM0
                        bool "Enable eFlex PWM0"
                        default n
                    config BSP_USING_PWM1
                        bool "Enable eFlex PWM1"
                        default n
                    config BSP_USING_PWM2
                        bool "Enable eFlex PWM2"
                        default n
                endif
endmenu


menu "Board extended module Drivers"
    menuconfig BSP_USING_RW007
        bool "Enable RW007"
        default n
        select BSP_USING_SPI
        select BSP_USING_SPI1
        select PKG_USING_RW007
        select RT_USING_MEMPOOL
        select RW007_NOT_USE_EXAMPLE_DRIVERS

    if BSP_USING_RW007
        config BOARD_RW007_SPI_BUS_NAME
            string "RW007 BUS NAME"
            default "spi1"

        config BOARD_RW007_CS_PIN
            hex "CS pin index"
            default 0x46

        config BOARD_RW007_INT_BUSY_PIN
            hex "INT/BUSY pin index"
            default 0x71

        config BOARD_RW007_RST_PIN
            hex "RESET pin index"
            default 0x2F
    endif

    menuconfig BSP_USING_P3T1755
        bool "Enable P3T1755"
        default n
        select BSP_USING_I2C
        select BSP_USING_I2C0
        select PKG_USING_P3T1755
        
    if BSP_USING_P3T1755
        config P3T1755_I2C_BUS_NAME
            string "P3T1755 BUS NAME"
            default "i2c0"
    endif
endmenu

endmenu
```

## bsp/nxp/mcx/mcxa/frdm-mcxa346/board/Kconfig
```kconfig
menu "Hardware Drivers Config"

config SOC_MCXA346
    bool
    select SOC_MCXA346_SERIES
    select RT_USING_COMPONENTS_INIT
    select RT_USING_USER_MAIN
    default y

menu "On-chip Peripheral Drivers"

    config BSP_USING_DMA
        bool "Enable DMA"
        select RT_USING_DMA
        default n

    config BSP_USING_PIN
        bool "Enable GPIO"
        select RT_USING_PIN
        default y

    menuconfig BSP_USING_UART
        config BSP_USING_UART
            bool "Enable UART"
            select RT_USING_UART
            default y

            if BSP_USING_UART
                config BSP_USING_UART2
                    bool "Enable LPUART2 as defalt UART"
                    default y

            endif


    menuconfig BSP_USING_I2C
        config BSP_USING_I2C
            bool "Enable I2C"
            select RT_USING_I2C
            default y

            if BSP_USING_I2C
                config BSP_USING_I2C3
                    bool "Enable Flexcomm3 I2C"
                    default y
            endif

    menuconfig BSP_USING_SPI
        config BSP_USING_SPI
            bool "Enable SPI"
            select RT_USING_SPI
            default y

            if BSP_USING_SPI
                config BSP_USING_SPI1
                    bool "Enable LPSPI1"
                    default n
            endif

    menuconfig BSP_USING_ADC
        config BSP_USING_ADC
            bool "Enable ADC Channel"
            select RT_USING_ADC
            default y

            if BSP_USING_ADC
                config BSP_USING_ADC0_CH22
                    bool "Enable ADC0 Channel22"
                    default n

            endif

    config BSP_USING_RTC
        bool "Enable RTC"
        select RT_USING_RTC
        default y

    config BSP_USING_WDT
        bool "Enable WatchDog"
        select RT_USING_WDT
        default n

    menuconfig BSP_USING_HWTIMER
        config BSP_USING_HWTIMER
            bool "Enable Timer"
            select RT_USING_HWTIMER
            default y

            if BSP_USING_HWTIMER
                config BSP_USING_CTIMER0
                    bool "Enable CIMER0"
                    default y

                config BSP_USING_CTIMER1
                    bool "Enable CIMER1"
                    default n

                config BSP_USING_CTIMER3
                    bool "Enable CIMER3"
                    default n

                config BSP_USING_CTIMER4
                    bool "Enable CIMER4"
                    default n
            endif

        menuconfig BSP_USING_PWM
            config BSP_USING_PWM
                bool "Enable PWM"
                select RT_USING_PWM
                default n
    
                if BSP_USING_PWM
                    config BSP_USING_PWM0
                        bool "Enable eFlex PWM0"
                        default n
                    config BSP_USING_PWM1
                        bool "Enable eFlex PWM1"
                        default n
                    config BSP_USING_PWM2
                        bool "Enable eFlex PWM2"
                        default n
                endif
endmenu


menu "Board extended module Drivers"
    menuconfig BSP_USING_RW007
        bool "Enable RW007"
        default n
        select BSP_USING_SPI
        select BSP_USING_SPI1
        select PKG_USING_RW007
        select RT_USING_MEMPOOL
        select RW007_NOT_USE_EXAMPLE_DRIVERS

    if BSP_USING_RW007
        config BOARD_RW007_SPI_BUS_NAME
            string "RW007 BUS NAME"
            default "spi1"

        config BOARD_RW007_CS_PIN
            hex "CS pin index"
            default 107

        config BOARD_RW007_INT_BUSY_PIN
            hex "INT/BUSY pin index"
            default 109

        config BOARD_RW007_RST_PIN
            hex "RESET pin index"
            default 131
    endif

        
endmenu

endmenu
```

## bsp/nxp/mcx/mcxa/libraries/Kconfig
```kconfig
config SOC_MCX
    bool
    select ARCH_ARM_CORTEX_M33
    select ARCH_ARM_CORTEX_FPU
    select PKG_USING_NXP_MCX_CMSIS_DRIVER
    select PKG_USING_NXP_MCX_SERIES_DRIVER
```

## bsp/nxp/mcx/mcxc/Libraries/Kconfig
```kconfig
config SOC_MCX
    bool
    select ARCH_ARM_CORTEX_M0
    select PKG_USING_NXP_MCX_CMSIS_DRIVER
    select PKG_USING_NXP_MCX_SERIES_DRIVER
```

## bsp/nxp/mcx/mcxc/frdm-mcxc444/Kconfig
```kconfig
mainmenu "RT-Thread Configuration"

BSP_DIR := .

RTT_DIR := ../../../../..

PKGS_DIR := packages

config SOC_MCX
    bool
    select ARCH_ARM_CORTEX_M0
    default y

source "$(RTT_DIR)/Kconfig"
osource "$PKGS_DIR/Kconfig"
rsource "../Libraries/Kconfig"
rsource "board/Kconfig"
```

## bsp/nxp/mcx/mcxc/frdm-mcxc444/board/Kconfig
```kconfig
menu "Hardware Drivers Config"

config SOC_MCXC444
    bool
    select RT_USING_COMPONENTS_INIT
    select RT_USING_USER_MAIN
    default y

menu "On-chip Peripheral Drivers"

    config BSP_USING_DMA
        bool "Enable DMA"
        select RT_USING_DMA
        default n

    config BSP_USING_PIN
        bool "Enable GPIO"
        select RT_USING_PIN
        default y

    menuconfig BSP_USING_UART
        bool "Enable UART"
        default y
        select RT_USING_SERIAL
        if BSP_USING_UART
            config BSP_USING_UART0
                bool "Enable UART0"
                default y
            config BSP_USING_UART1
                bool "Enable UART1"
                default y
        endif

    menuconfig BSP_USING_I2C
        config BSP_USING_I2C
            bool "Enable I2C"
            select RT_USING_I2C
            default y

            if BSP_USING_I2C
                config BSP_USING_I2C0
                    bool "Enable I2C0"
                    default y
                config BSP_USING_I2C1
                    bool "Enable I2C1"
                    default y
            endif

    menuconfig BSP_USING_SPI
        config BSP_USING_SPI
            bool "Enable SPI"
            select RT_USING_SPI
            select BSP_USING_PIN
            default y

            if BSP_USING_SPI
                config BSP_USING_SPI0
                    bool "Enable SPI0"
                    default n
            endif

            if BSP_USING_SPI
                config BSP_USING_SPI1
                    bool "Enable SPI1"
                    default n
            endif
        
    config BSP_USING_RTC
        bool "Enable RTC"
        select RT_USING_RTC
        default y

    config BSP_USING_WDT
        bool "Enable WatchDog"
        select RT_USING_WDT
        default n

    menuconfig BSP_USING_HWTIMER
        config BSP_USING_HWTIMER
            bool "Enable Timer"
            select RT_USING_HWTIMER
            default y

    menuconfig BSP_USING_PWM
        config BSP_USING_PWM
            bool "Enable PWM"
            select RT_USING_PWM
            default y

            if BSP_USING_PWM
                config BSP_USING_LEDG_PWM
                    bool "Enable on-board green LED as PWM output (pwm0, channel 3)"
                    default y
            endif

endmenu


endmenu
```
