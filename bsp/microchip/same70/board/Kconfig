## bsp/n32/n32g43xcl-stb/board/Kconfig
```kconfig
menu "Hardware Drivers Config"

config SOC_SERIES_N32G43X
    bool
    default y

config SOC_N32G43X
    bool
    select SOC_SERIES_N32G43X
    select RT_USING_COMPONENTS_INIT
    select RT_USING_USER_MAIN
    default y

menu "Onboard Peripheral Drivers"

endmenu

menu "On-chip Peripheral Drivers"

    config BSP_USING_GPIO
        bool "Enable GPIO"
        select RT_USING_PIN
        default y

    menuconfig BSP_USING_UART
        bool "Enable UART"
        default y
        select RT_USING_SERIAL
        if BSP_USING_UART
            config BSP_USING_USART1
                bool "Enable USART1"
                default y

            config BSP_USING_USART2
                bool "Enable USART2"
                default n

            config BSP_USING_USART3
                bool "Enable USART3"
                default n

            config BSP_USING_UART4
                bool "Enable UART4"
                default n

            config BSP_USING_UART5
                bool "Enable UART5"
                default n

        endif

    menuconfig BSP_USING_SPI
        bool "Enable SPI BUS"
        default n
        select RT_USING_SPI
        if BSP_USING_SPI
            config BSP_USING_SPI1
                bool "Enable SPI1 BUS"
                default n

            config BSP_USING_SPI2
                bool "Enable SPI2 BUS"
                default n

        endif

    menuconfig BSP_USING_I2C1
        bool "Enable I2C1 BUS (software simulation)"
        default n
        select RT_USING_I2C
        select RT_USING_I2C_BITOPS
        select RT_USING_PIN
        if BSP_USING_I2C1
            config BSP_I2C1_SCL_PIN
                int "i2c1 scl pin number"
                range 0 64
                default 22

            config BSP_I2C1_SDA_PIN
                int "I2C1 sda pin number"
                range 0 64
                default 23
        endif

    menuconfig BSP_USING_RTC
        bool "Enable RTC"
        select RT_USING_RTC
        default n
        if BSP_USING_RTC
            choice
                prompt "Select clock source"
                default BSP_RTC_USING_LSE

                config BSP_RTC_USING_LSE
                    bool "RTC USING LSE"

                config BSP_RTC_USING_HSE
                    bool "RTC USING HSE"

                config BSP_RTC_USING_LSI
                    bool "RTC USING LSI"
            endchoice
        endif

    config BSP_USING_WDT
        bool "Enable Watchdog Timer"
        select RT_USING_WDT
        default n

    menuconfig BSP_USING_HWTIMER
        bool "Enable hwtimer"
        default n
        select RT_USING_HWTIMER
        if BSP_USING_HWTIMER
            config BSP_USING_HWTIMER1
                bool "using hwtimer1"
                default n

            config BSP_USING_HWTIMER2
                bool "using hwtimer2"
                default n

            config BSP_USING_HWTIMER3
                bool "using hwtimer3"
                default n

            config BSP_USING_HWTIMER4
                bool "using hwtimer4"
                default n

            config BSP_USING_HWTIMER5
                bool "using hwtimer5"
                default n

            config BSP_USING_HWTIMER6
                bool "using hwtimer6"
                default n

            config BSP_USING_HWTIMER7
                bool "using hwtimer7"
                default n

            config BSP_USING_HWTIMER8
                bool "using hwtimer8"
                default n

            config BSP_USING_HWTIMER9
                bool "using hwtimer9"
                default n
        endif

    config BSP_USING_ADC
        bool "Enable ADC"
        select RT_USING_ADC
        default n

    config BSP_USING_DAC
        bool "Enable DAC"
        select RT_USING_DAC
        default n

    config BSP_USING_CAN
        bool "Enable CAN"
        select RT_USING_CAN
        default n

    source "../libraries/n32_drivers/Kconfig"

endmenu

menu "Board extended module Drivers"

endmenu

endmenu
```
