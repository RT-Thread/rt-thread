## bsp/nuvoton/numaker-hmi-ma35d1/board/Kconfig
```kconfig
menu "Hardware Drivers Config"

    menu "On-chip Peripheral Drivers"
        source "$BSP_DIR/../libraries/ma35/rtt_port/Kconfig"
    endmenu

    menu "On-board Peripheral Drivers"

        config BSP_USING_CONSOLE
            bool "Enable UART0 for RTT Console(uart0)"
            select BSP_USING_UART
            select BSP_USING_UART0
            default y

        config BOARD_USING_NAU8822
            bool "NAU8822 Audio Codec supporting(over i2s0, i2c2)"
            select NU_PKG_USING_NAU8822
            select BSP_USING_I2C2
            select BSP_USING_I2S
            select BSP_USING_I2S0
            default n

        config BOARD_USING_STORAGE_SDCARD
            bool "SDCARD supporting(over sdh0)"
            select BSP_USING_SDH
            select BSP_USING_SDH0
            default y

        config BOARD_USING_STORAGE_EMMC
            bool "EMMC supporting(over sdh1)"
            select BSP_USING_SDH
            select BSP_USING_SDH1
            default y

        config BOARD_USING_STORAGE_RAWNAND
            bool "Raw NAND supporting(over nfi)"
            select BSP_USING_NFI
            select RT_USING_MTD_NAND
            default y

        config BOARD_USING_STORAGE_SPIFLASH
            bool "SPI NOR FLASH supporting(over qspi0)"
            select BSP_USING_QSPI
            select BSP_USING_QSPI0
            default n

        config BOARD_USING_STORAGE_SPINAND
            bool "SPI NAND FLASH supporting(over qspi0)"
            select BSP_USING_QSPI
            select BSP_USING_QSPI0
            select NU_PKG_USING_SPINAND
            default y

        config BOARD_USING_BUZZER
            bool "BUZZER function(over epwm1_ch5)"
            select BSP_USING_EPWM
            select BSP_USING_EPWM1
            select BSP_USING_EPWM1_PWM
            default y

        config BOARD_USING_MPU6500
            bool "MPU6500 6-axis MotionTracking Sensor(over i2c1)"
            select RT_USING_SENSOR
            select PKG_USING_MPU6XXX
            select PKG_USING_MPU6XXX_LATEST_VERSION
            select PKG_USING_MPU6XXX_ACCE
            select PKG_USING_MPU6XXX_GYRO
            select BSP_USING_I2C
            select BSP_USING_I2C1
            default y

        config BOARD_USING_USBHOST
            bool "USB HOST function"
            select BSP_USING_USBH
            default y

    endmenu

    menu "Board extended module drivers"

        config BOARD_USING_LCM
            bool "Use LCD panel."
            default y

        if BOARD_USING_LCM

            choice
                prompt "Select LCD panel devices.(Over DISP)"
                    default BOARD_USING_LCM_FW070TFT_WSVGA

                config BOARD_USING_LCM_FW070TFT_WVGA
                    bool "NuDesign TFT-LCD7-WVGA"
                    select BSP_USING_DISP
                    select LCM_USING_FW070TFT
                    help
                        Choose this option if you use 7" 800x480x32b LCD panel.

                config BOARD_USING_LCM_FW070TFT_WSVGA
                    bool "NuDesign TFT-LCD7-WSVGA"
                    select BSP_USING_DISP
                    select LCM_USING_FW070TFT_WSVGA
                    help
                        Choose this option if you use 7" 1024x600x32b LCD panel.
            endchoice

            choice
                prompt "Select Touch devices."
                    default BOARD_USING_GT911

                config BOARD_USING_GT911
                    bool "GT911 TPC"
                    select BSP_USING_I2C
                    select BSP_USING_I2C0
                    select NU_PKG_USING_TPC_GT911
                    help
                        Choose this option if you use GT911 external TSC touching function.

                config BOARD_USING_ADCTOUCH
                    bool "ADC touching"
                    select BSP_USING_ADC_TOUCH
                    select NU_PKG_USING_ADC_TOUCH
                    help
                        Choose this option if you use internal ADC touching function.

            endchoice
        endif



    config BOARD_USING_SENSOR0
        bool "CCAP-SENSOR PORT0(over i2c3/PM1/PK8)"
        select BSP_USING_I2C
        select BSP_USING_I2C3
        select BSP_USING_CCAP
        select BSP_USING_CCAP0
        default n

    if BOARD_USING_SENSOR0
        config BOARD_USING_SENSON0_ID
            int "Specify Sensor0 ID"
            default 0  if BOARD_USING_SENSOR0
            range 0 2
            help
                HM1055=0
                ADV728X=1
    endif

    config BOARD_USING_SENSOR1
        bool "CCAP-SENSOR PORT1(over i2c4/PN14/PD15)"
        select BSP_USING_I2C
        select BSP_USING_I2C4
        select BSP_USING_CCAP
        select BSP_USING_CCAP1
        default n

    if BOARD_USING_SENSOR1
        config BOARD_USING_SENSON1_ID
            int "Specify Sensor1 ID"
            default 0
            range 0 2
            help
                HM1055=0
                ADV728X=1
    endif


    endmenu

    source "$BSP_DIR/../libraries/nu_packages/Kconfig"

endmenu
```

## bsp/nuvoton/numaker-iot-m467/board/Kconfig
```kconfig
menu "Hardware Drivers Config"

    menu "On-chip Peripheral Drivers"
        source "$(BSP_DIR)/../libraries/m460/rtt_port/Kconfig"
    endmenu

    menu "On-board Peripheral Drivers"

        config BSP_USING_NULINKME
            bool "Enable UART0 for RTT Console(uart0)"
            select BSP_USING_UART
            select BSP_USING_UART0
            default y

        config BOARD_USING_RTL8201FI
            bool "Enable Ethernet phy supporting(over emac/mdio)"
            select BSP_USING_EMAC
            default n

        config BOARD_USING_ESP8266
            bool "ESP8266 Wi-Fi module supporting(over uart2)"
            select BSP_USING_UART
            select BSP_USING_UART2
            select BSP_USING_UART2_RX_DMA
            select BSP_USING_UART2_TX_DMA
            select PKG_USING_AT_DEVICE
            select AT_DEVICE_USING_ESP8266
            select AT_DEVICE_ESP8266_INIT_ASYN
            default y
        config BOARD_USING_STORAGE_SDCARD
            bool "SDCARD supporting(over sdh0)"
            select BSP_USING_SDH
            select BSP_USING_SDH0
            default y

        config BOARD_USING_STORAGE_SPIFLASH
            bool "SPIFLASH supporting(over qspi0)"
            select BSP_USING_QSPI
            select BSP_USING_QSPI0
            default y

        config BOARD_USING_CANFD0
            bool "CAN-FD supporting(over canfd0)"
            select BSP_USING_CANFD
            select BSP_USING_CANFD0
            default y

        config BOARD_USING_NCT7717U
            bool "Thermal Sensor(over i2c2)"
            select NU_PKG_USING_NCT7717U
            select BSP_USING_I2C
            select BSP_USING_I2C2
            default y

        config BOARD_USING_MPU6500
            bool "MPU6500 6-axis MotionTracking Sensor(over i2c2)"
            select PKG_USING_MPU6XXX
            select PKG_USING_MPU6XXX_LATEST_VERSION
            select PKG_USING_MPU6XXX_ACCE
            select BSP_USING_I2C
            select BSP_USING_I2C2
            default y

        config BOARD_USING_USB_D_H
            bool "Enable USB Device or Host function"
            help
                Choose this option if you need USB function.

        if BOARD_USING_USB_D_H
            choice
                prompt "Select FS/HS USB Ports"

                config BOARD_USING_HSUSBD
                    select BSP_USING_HSUSBD
                    bool "Enable HSUSBD(over USB2.0)"
                    help
                        Choose this option if you need HSUSBD function mode.

                config BOARD_USING_HSUSBD_USBH
                    select BSP_USING_USBH
                    select BSP_USING_HSUSBD
                    bool "Enable HSUSBD(over USB2.0) and USBH(over USB1.1)"
                    help
                        Choose this option if you need HSUSBD and USBH function mode at the same time.

                config BOARD_USING_HSUSBH
                    select BSP_USING_HSUSBH
                    bool "Enable HSUSBH(over USB2.0)"
                    help
                        Choose this option if you need HSUSBH function mode.

                config BOARD_USING_HSUSBH_USBD
                    select BSP_USING_HSUSBH
                    select BSP_USING_USBD
                    bool "Enable HSUSBH(over USB2.0) and USBD(over USB1.1)"
                    help
                        Choose this option if you need HSUSBH and USBD function mode at the same time.

                config BOARD_USING_HSOTG
                    select BSP_USING_HSOTG
                    bool "Enable HSOTG(over USB2.0)"
                    help
                        Choose this option if you need HSOTG function mode.
            endchoice
        endif

    endmenu

    menu "Board extended module drivers"

        config BOARD_USING_LCD_ILI9341
            bool "LCD ILI9341 (over spi2)"
        select RT_USING_TOUCH
            select BSP_USING_SPI2
            select BSP_USING_EADC
            select BSP_USING_EADC0
            select NU_PKG_USING_ADC_TOUCH
            select NU_PKG_USING_ADC_TOUCH_SW
            select NU_PKG_USING_ILI9341
            select NU_PKG_USING_ILI9341_SPI
            select NU_PKG_ILI9341_WITH_OFFSCREEN_FRAMEBUFFER
            select NU_PKG_ILI9341_HORIZONTAL
            default n

        if BOARD_USING_LCD_ILI9341

            config BOARD_USING_ILI9341_PIN_BACKLIGHT
            int "Specify the pin index of backlight pin index"
                range 0 127
                default 21

            config BOARD_USING_ILI9341_PIN_RESET
            int "Specify the pin index of reset pin index"
                range 0 127
                default 19

            config BOARD_USING_ILI9341_PIN_DC
            int "Specify the pin index of data&command switching"
                range 0 127
                default 18

        endif

    endmenu

    source "$(BSP_DIR)/../libraries/nu_packages/Kconfig"

endmenu
```

## bsp/nuvoton/numaker-iot-m487/board/Kconfig
```kconfig
menu "Hardware Drivers Config"

    menu "On-chip Peripheral Drivers"
        source "$BSP_DIR/../libraries/m480/rtt_port/Kconfig"
    endmenu

    menu "On-board Peripheral Drivers"

        config BSP_USING_NULINKME
            bool "Enable UART0 for RTT Console(uart0)"
            select BSP_USING_UART
            select BSP_USING_UART0
            default y

        config BOARD_USING_IP101GR
            bool "Enable ethernet phy supporting(over emac/mdio)"
            select BSP_USING_EMAC
            default n

        config BOARD_USING_ESP8266
            bool "ESP8266 Wi-Fi module supporting(over uart1)"
            select BSP_USING_UART
            select BSP_USING_UART1
            select BSP_USING_UART1_RX_DMA
            select BSP_USING_UART1_TX_DMA
            select PKG_USING_AT_DEVICE
            select AT_DEVICE_USING_ESP8266
            select AT_DEVICE_ESP8266_INIT_ASYN
            default n

        config BOARD_USING_BMX055
            bool "BMX055 9-axis sensor(over i2c2)"
            select NU_PKG_USING_BMX055
            select BSP_USING_I2C2
            default n

        config BOARD_USING_NAU88L25
            bool "NAU88L25 Audio Codec supporting(over i2s, i2c2)"
            select NU_PKG_USING_NAU88L25
            select BSP_USING_I2C2
            select BSP_USING_I2S
            select BSP_USING_I2S0
            default n

        config BOARD_USING_STORAGE_SDCARD
            bool "SDCARD supporting(over sdh0)"
            select BSP_USING_SDH
            select BSP_USING_SDH0
            default n

        config BOARD_USING_STORAGE_SPIFLASH
            bool "SPIFLASH supporting(over qspi0)"
            select BSP_USING_QSPI
            select BSP_USING_QSPI0
            default y

        config BOARD_USING_USB_D_H
            bool "Enable USB Device or Host function"
            help
                Choose this option if you need USB function.

        if BOARD_USING_USB_D_H
            choice
                prompt "Select FS/HS USB Ports"

                config BOARD_USING_HSUSBD
                    select BSP_USING_HSUSBD
                    bool "Enable HSUSBD(over USB2.0)"
                    help
                        Choose this option if you need HSUSBD function mode.

                config BOARD_USING_HSUSBD_USBH
                    select BSP_USING_USBH
                    select BSP_USING_HSUSBD
                    bool "Enable HSUSBD(over USB2.0) and USBH(over USB1.1)"
                    help
                        Choose this option if you need HSUSBD and USBH function mode at the same time.

                config BOARD_USING_HSUSBH
                    select BSP_USING_HSUSBH
                    bool "Enable HSUSBH(over USB2.0)"
                    help
                        Choose this option if you need HSUSBH function mode.

                config BOARD_USING_HSUSBH_USBD
                    select BSP_USING_HSUSBH
                    select BSP_USING_USBD
                    bool "Enable HSUSBH(over USB2.0) and USBD(over USB1.1)"
                    help
                        Choose this option if you need HSUSBH and USBD function mode at the same time.

                config BOARD_USING_HSOTG
                    select BSP_USING_HSOTG
                    bool "Enable HSOTG(over USB2.0)"
                    help
                        Choose this option if you need HSOTG function mode.
            endchoice
        endif

    endmenu

    menu "Board extended module drivers"

        config BOARD_USING_MAX31875
            bool "MAX31875 Temperature sensor(over i2c1)"
            select NU_PKG_USING_MAX31875
            select BSP_USING_I2C1
            default n

        config BOARD_USING_LCD_ILI9341
            bool "LCD ILI9341 (over spi2)"
        select RT_USING_TOUCH
            select BSP_USING_SPI2
            select BSP_USING_EADC
            select BSP_USING_EADC0
            select NU_PKG_USING_ADC_TOUCH
            select NU_PKG_USING_ADC_TOUCH_SW
            select NU_PKG_USING_ILI9341
            select NU_PKG_USING_ILI9341_SPI
            select NU_PKG_ILI9341_WITH_OFFSCREEN_FRAMEBUFFER
            select NU_PKG_ILI9341_HORIZONTAL
            default n

        if BOARD_USING_LCD_ILI9341

            config BOARD_USING_ILI9341_PIN_BACKLIGHT
            int "Specify the pin index of backlight pin index"
                range 0 127
                default 69

            config BOARD_USING_ILI9341_PIN_RESET
            int "Specify the pin index of reset pin index"
                range 0 127
                default 19

            config BOARD_USING_ILI9341_PIN_DC
            int "Specify the pin index of data&command switching"
                range 0 127
                default 18

        endif

    endmenu

    source "$BSP_DIR/../libraries/nu_packages/Kconfig"

endmenu
```
