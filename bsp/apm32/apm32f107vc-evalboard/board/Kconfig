## bsp/at32/at32f413-start/board/Kconfig
```kconfig
menu "Hardware Drivers Config"

config SOC_AT32F413RCT7
    bool
    select SOC_SERIES_AT32F413
    select RT_USING_COMPONENTS_INIT
    select RT_USING_USER_MAIN
    default y

menu "Onboard Peripheral Drivers"

    config BSP_USING_SERIAL
        bool "Enable USART (uart1)"
        select BSP_USING_UART
        select BSP_USING_UART1
        default y

endmenu

menu "On-chip Peripheral Drivers"

    config BSP_USING_GPIO
        bool "Enable GPIO"
        select RT_USING_PIN
        default y

    config BSP_USING_ON_CHIP_FLASH
        bool "Enable on-chip FLASH"
        default n

    config BSP_USING_USBD
        bool "Enable USB BUS"
        select RT_USING_USB_DEVICE
        default n

    menuconfig BSP_USING_RTC
        bool "Enable RTC"
        select RT_USING_RTC
        default n
        if BSP_USING_RTC
            choice
                prompt "Select clock source"
                default BSP_RTC_USING_LEXT

                config BSP_RTC_USING_LEXT
                    bool "RTC USING LEXT"

                config BSP_RTC_USING_LICK
                    bool "RTC USING LICK"
            endchoice
        endif

    menuconfig BSP_USING_UART
        bool "Enable UART"
        default y
        select RT_USING_SERIAL
        if BSP_USING_UART
            menuconfig BSP_USING_UART1
                bool "Enable UART1"
                default y
                if BSP_USING_UART1
                    config BSP_UART1_RX_USING_DMA
                        bool "Enable UART1 RX DMA"
                        depends on BSP_USING_UART1 && RT_SERIAL_USING_DMA
                        default n

                    config BSP_UART1_TX_USING_DMA
                        bool "Enable UART1 TX DMA"
                        depends on BSP_USING_UART1 && RT_SERIAL_USING_DMA
                        default n

                    config BSP_UART1_RX_BUFSIZE
                        int "Set UART1 RX buffer size"
                        range 64 65535
                        depends on RT_USING_SERIAL_V2
                        default 256

                    config BSP_UART1_TX_BUFSIZE
                        int "Set UART1 TX buffer size"
                        range 0 65535
                        depends on RT_USING_SERIAL_V2
                        default 0
                endif

            menuconfig BSP_USING_UART2
                bool "Enable UART2"
                default y
                if BSP_USING_UART2
                    config BSP_UART2_RX_USING_DMA
                        bool "Enable UART2 RX DMA"
                        depends on BSP_USING_UART2 && RT_SERIAL_USING_DMA
                        default n

                    config BSP_UART2_TX_USING_DMA
                        bool "Enable UART2 TX DMA"
                        depends on BSP_USING_UART2 && RT_SERIAL_USING_DMA
                        default n

                    config BSP_UART2_RX_BUFSIZE
                        int "Set UART2 RX buffer size"
                        range 64 65535
                        depends on RT_USING_SERIAL_V2
                        default 256

                    config BSP_UART2_TX_BUFSIZE
                        int "Set UART2 TX buffer size"
                        range 0 65535
                        depends on RT_USING_SERIAL_V2
                        default 0
                endif

            menuconfig BSP_USING_UART3
                bool "Enable UART3"
                default y
                if BSP_USING_UART3
                    config BSP_UART3_RX_USING_DMA
                        bool "Enable UART3 RX DMA"
                        depends on BSP_USING_UART3 && RT_SERIAL_USING_DMA
                        default n

                    config BSP_UART3_TX_USING_DMA
                        bool "Enable UART3 TX DMA"
                        depends on BSP_USING_UART3 && RT_SERIAL_USING_DMA
                        default n

                    config BSP_UART3_RX_BUFSIZE
                        int "Set UART3 RX buffer size"
                        range 64 65535
                        depends on RT_USING_SERIAL_V2
                        default 256

                    config BSP_UART3_TX_BUFSIZE
                        int "Set UART3 TX buffer size"
                        range 0 65535
                        depends on RT_USING_SERIAL_V2
                        default 0
                endif
        endif

    menuconfig BSP_USING_PWM
        bool "Enable PWM"
        default n
        select RT_USING_PWM
        if BSP_USING_PWM
        menuconfig BSP_USING_PWM1
            bool "Enable timer1 output pwm"
            default n
            if BSP_USING_PWM1
                config BSP_USING_PWM1_CH1
                    bool "Enable PWM1 channel1"
                    default n

                config BSP_USING_PWM1_CH4
                    bool "Enable PWM1 channel4"
                    default n
            endif
        menuconfig BSP_USING_PWM2
            bool "Enable timer2 output pwm"
            default n
            if BSP_USING_PWM2
                config BSP_USING_PWM2_CH1
                    bool "Enable PWM2 channel1"
                    default n

                config BSP_USING_PWM2_CH2
                    bool "Enable PWM2 channel2"
                    default n
            endif
        endif

    menuconfig BSP_USING_HWTIMER
        bool "Enable HWTIMER"
        default n
        select RT_USING_HWTIMER
        if BSP_USING_HWTIMER
        config BSP_USING_HWTMR3
            bool "Enable hardware timer3"
            default n
        config BSP_USING_HWTMR4
            bool "Enable hardware timer4"
            default n
        config BSP_USING_HWTMR5
            bool "Enable hardware timer5"
            default n
        endif

    menuconfig BSP_USING_SPI
        bool "Enable SPI BUS"
        default n
        select RT_USING_SPI
        if BSP_USING_SPI
            config BSP_USING_SPI1
                bool "Enable SPI1 BUS"
                default n

            config BSP_SPI1_TX_USING_DMA
                bool "Enable SPI1 TX DMA"
                depends on BSP_USING_SPI1
                default n

            config BSP_SPI1_RX_USING_DMA
                bool "Enable SPI1 RX DMA"
                depends on BSP_USING_SPI1
                select BSP_SPI1_TX_USING_DMA
                default n

            config BSP_USING_SPI2
                bool "Enable SPI2 BUS"
                default n

            config BSP_SPI2_TX_USING_DMA
                bool "Enable SPI2 TX DMA"
                depends on BSP_USING_SPI2
                default n

            config BSP_SPI2_RX_USING_DMA
                bool "Enable SPI2 RX DMA"
                depends on BSP_USING_SPI2
                select BSP_SPI2_TX_USING_DMA
                default n
        endif

    menuconfig BSP_USING_I2C
        bool "Enable I2C BUS (software simulation)"
        default n
        select RT_USING_I2C
        select RT_USING_I2C_BITOPS
        select RT_USING_PIN
        if BSP_USING_I2C
            config BSP_USING_I2C1
                bool "Enable I2C1 BUS"
                if BSP_USING_I2C1
                    config BSP_I2C1_SCL_PIN
                        int "i2c1 scl pin number"
                        range 0 63
                        default 22
                    config BSP_I2C1_SDA_PIN
                        int "I2C1 sda pin number"
                        range 0 63
                        default 23
                endif
            config BSP_USING_I2C2
                bool "Enable I2C2 BUS"
                if BSP_USING_I2C2
                    config BSP_I2C2_SCL_PIN
                        int "i2c2 scl pin number"
                        range 0 63
                        default 26
                    config BSP_I2C2_SDA_PIN
                        int "I2C2 sda pin number"
                        range 0 63
                        default 27
                endif
        endif

    menuconfig BSP_USING_HARD_I2C
        bool "Enable I2C BUS (hardware driver)"
        default n
        select RT_USING_I2C
        if BSP_USING_HARD_I2C
            config BSP_USING_HARD_I2C1
                bool "Enable I2C1 BUS"
                default n

            config BSP_I2C1_TX_USING_DMA
                bool "Enable I2C1 TX DMA"
                depends on BSP_USING_HARD_I2C1
                default n

            config BSP_I2C1_RX_USING_DMA
                bool "Enable I2C1 RX DMA"
                depends on BSP_USING_HARD_I2C1
                select BSP_I2C1_TX_USING_DMA
                default n

            config BSP_USING_HARD_I2C2
                bool "Enable I2C2 BUS"
                default n

            config BSP_I2C2_TX_USING_DMA
                bool "Enable I2C2 TX DMA"
                depends on BSP_USING_HARD_I2C2
                default n

            config BSP_I2C2_RX_USING_DMA
                bool "Enable I2C2 RX DMA"
                depends on BSP_USING_HARD_I2C2
                select BSP_I2C2_TX_USING_DMA
                default n
        endif

    menuconfig BSP_USING_ADC
        bool "Enable ADC"
        default n
        select RT_USING_ADC
        if BSP_USING_ADC
            config BSP_USING_ADC1
                bool "Enable ADC1"
                default n
            config BSP_USING_ADC2
                bool "Enable ADC2"
                default n
        endif

    menuconfig BSP_USING_CAN
        bool "Enable CAN"
        default n
        select RT_USING_CAN
        if BSP_USING_CAN
            config BSP_USING_CAN1
                bool "using CAN1"
                default n
            config BSP_USING_CAN2
                bool "using CAN2"
                default n
        endif

    menuconfig BSP_USING_SDIO
        bool "Enable SDIO"
        default n
        select RT_USING_SDIO
        if BSP_USING_SDIO
            config BSP_USING_SDIO1
                bool "Enable SDIO1"
                default n
        endif
endmenu

endmenu
```

## bsp/at32/libraries/Kconfig
```kconfig
config SOC_FAMILY_AT32
    bool

config SOC_SERIES_AT32A403A
    bool
    select ARCH_ARM_CORTEX_M4
    select SOC_FAMILY_AT32

config SOC_SERIES_AT32A423
    bool
    select ARCH_ARM_CORTEX_M4
    select SOC_FAMILY_AT32

config SOC_SERIES_AT32F402
    bool
    select ARCH_ARM_CORTEX_M4
    select SOC_FAMILY_AT32

config SOC_SERIES_AT32F403
    bool
    select ARCH_ARM_CORTEX_M4
    select SOC_FAMILY_AT32

config SOC_SERIES_AT32F403A
    bool
    select ARCH_ARM_CORTEX_M4
    select SOC_FAMILY_AT32

config SOC_SERIES_AT32F405
    bool
    select ARCH_ARM_CORTEX_M4
    select SOC_FAMILY_AT32

config SOC_SERIES_AT32F407
    bool
    select ARCH_ARM_CORTEX_M4
    select SOC_FAMILY_AT32

config SOC_SERIES_AT32F413
    bool
    select ARCH_ARM_CORTEX_M4
    select SOC_FAMILY_AT32

config SOC_SERIES_AT32F415
    bool
    select ARCH_ARM_CORTEX_M4
    select SOC_FAMILY_AT32

config SOC_SERIES_AT32F421
    bool
    select ARCH_ARM_CORTEX_M4
    select SOC_FAMILY_AT32

config SOC_SERIES_AT32F423
    bool
    select ARCH_ARM_CORTEX_M4
    select SOC_FAMILY_AT32

config SOC_SERIES_AT32F425
    bool
    select ARCH_ARM_CORTEX_M4
    select SOC_FAMILY_AT32

config SOC_SERIES_AT32F435
    bool
    select ARCH_ARM_CORTEX_M4
    select SOC_FAMILY_AT32

config SOC_SERIES_AT32F437
    bool
    select ARCH_ARM_CORTEX_M4
    select SOC_FAMILY_AT32

config SOC_SERIES_AT32M412
    bool
    select ARCH_ARM_CORTEX_M4
    select SOC_FAMILY_AT32

config SOC_SERIES_AT32M416
    bool
    select ARCH_ARM_CORTEX_M4
    select SOC_FAMILY_AT32
```

## bsp/at91/at91sam9260/Kconfig
```kconfig
mainmenu "RT-Thread Configuration"

BSP_DIR := .

RTT_DIR := ../../..

PKGS_DIR := packages

source "$(RTT_DIR)/Kconfig"
osource "$PKGS_DIR/Kconfig"

config SOC_AT91SAM926
    bool
    select RT_USING_CACHE
    select RT_USING_COMPONENTS_INIT
    select RT_USING_USER_MAIN
    default y

config RT_USING_DBGU
    bool "Using RT_USING_DBGU"
    default y

config RT_USING_UART0
    bool "Using RT_USING_UART0"
    default n

config RT_USING_UART1
    bool "Using RT_USING_UART1"
    default n

config RT_USING_UART2
    bool "Using RT_USING_UART2"
    default n

config RT_USING_UART3
    bool "Using RT_USING_UART3"
    default n

config RT_USING_LED
    bool "Using RT_USING_LED"
    default y
    help
        led blink demo
```

## bsp/at91/at91sam9g45/Kconfig
```kconfig
mainmenu "RT-Thread Configuration"

BSP_DIR := .

RTT_DIR := ../../..

# you can change the RTT_ROOT default "../../.." to your rtthread_root,
# example : default "F:/git_repositories/rt-thread"

PKGS_DIR := packages

ENV_DIR := /

source "$(RTT_DIR)/Kconfig"
osource "$PKGS_DIR/Kconfig"

config SOC_AT91SAM9G45
    bool
    select ARCH_ARM_ARM9
    select RT_USING_CACHE
    select RT_USING_COMPONENTS_INIT
    select RT_USING_USER_MAIN
    default y

source "$(BSP_DIR)/drivers/Kconfig"
```

## bsp/at91/at91sam9g45/drivers/Kconfig
```kconfig
menu "Hardware Drivers Config"

config RT_USING_LED
    bool "Using LED"
    default n

endmenu
```
