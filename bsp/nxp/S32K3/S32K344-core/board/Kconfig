## bsp/nxp/S32K3/S32K344-core/board/Kconfig
```kconfig
menu "Hardware Drivers Config"

config CPU_S32K344
    bool
    select RT_USING_COMPONENTS_INIT
    select RT_USING_USER_MAIN
    select BSP_USING_SHELL_TO_USART
    default y

config BSP_USING_SHELL_TO_USART
        bool "Enable SHELL TO USART (uart3)"
        select BSP_USING_UART
        select BSP_USING_UART3
        default y

menu "On-chip Peripheral Drivers"
    menuconfig BSP_USING_UART
        bool "Enable UART"
        default y
        select RT_USING_SERIAL
        if BSP_USING_UART
            menuconfig BSP_USING_UART3
                bool "Enable UART3(PD2,PD3)"
                default y
        endif
endmenu

endmenu
```

## bsp/nxp/S32K3/S32K344-core/libraries/Kconfig
```kconfig
config SOC_FAMILY_S32K3
    bool

config SOC_SERIES_S32K344
    bool
    select ARCH_ARM_CORTEX_M7
    select SOC_FAMILY_S32K3
```

## bsp/nxp/S32K3/S32K344/board/Kconfig
```kconfig
menu "Hardware Drivers Config"

config CPU_S32K344
    bool
    select RT_USING_COMPONENTS_INIT
    select RT_USING_USER_MAIN
    default y

endmenu
```

## bsp/nxp/imx/imx6sx/cortex-a9/Kconfig
```kconfig
mainmenu "RT-Thread Configuration"

BSP_DIR := .

RTT_DIR := ../../../../..

PKGS_DIR := packages

ENV_DIR := /

source "$(RTT_DIR)/Kconfig"
osource "$PKGS_DIR/Kconfig"

config SOC_MCIMX6X4
    bool
    select RT_USING_COMPONENTS_INIT
    select RT_USING_USER_MAIN
    default y

config RT_USING_UART1
    bool "Using RT_USING_UART1"
    default y
```

## bsp/nxp/imx/imx6ul/Kconfig
```kconfig
mainmenu "RT-Thread Configuration"

BSP_DIR := .

RTT_DIR := ../../../..

PKGS_DIR := packages

config BOARD_IMX6UL
    bool
    select ARCH_ARM_CORTEX_A7
    select RT_USING_GIC_V2
    default y

source "$(RTT_DIR)/Kconfig"
osource "$PKGS_DIR/Kconfig"

source "$(BSP_DIR)/drivers/Kconfig"

config SOC_MCIMX6X4
    bool
    select RT_USING_COMPONENTS_INIT
    #select RT_USING_USER_MAIN
    default y
```

## bsp/nxp/imx/imx6ull-smart/Kconfig
```kconfig
mainmenu "RT-Thread Project Configuration"

BSP_DIR := .

RTT_DIR := ../../../..

PKGS_DIR := packages

source "$(RTT_DIR)/Kconfig"
osource "$PKGS_DIR/Kconfig"

config SOC_IMX6ULL
    bool
    select ARCH_ARM_CORTEX_A7
    select RT_USING_CACHE
    select ARCH_ARM_MMU
    select RT_USING_COMPONENTS_INIT
    select RT_USING_USER_MAIN
    select RT_USING_FPU
    select RT_USING_GIC_V2
    default y

    if SOC_IMX6ULL
        config CPU_MCIMX6Y2CVM05
            bool
            default y
        config FSL_SDK_ENABLE_DRIVER_CACHE_CONTROL
            depends on RT_USING_CACHE
            int
            default 1
        config FSL_SDK_DISABLE_DRIVER_CLOCK_CONTROL
            int "Disable Clock control in fsl files"
            default 1
    endif

source "$(BSP_DIR)/drivers/Kconfig"
```

## bsp/nxp/imx/imx6ull-smart/drivers/Kconfig
```kconfig
menu "Platform Driver Configuration"

menu "Select UART Driver"
    if RT_USING_SERIAL
        config BSP_USING_UART1
            bool "Enable UART1"
            default y
        config BSP_USING_UART2
            bool "Enable UART2"
            default n
        config BSP_USING_UART3
            bool "Enable UART3"
            default n
        config BSP_USING_UART4
            bool "Enable UART4"
            default n
        config BSP_USING_UART5
            bool "Enable UART5"
            default n
        config BSP_USING_UART6
            bool "Enable UART6"
            default n
        config BSP_USING_UART7
            bool "Enable UART7"
            default n
        config BSP_USING_UART8
            bool "Enable UART8"
            default n
    endif
endmenu

menu "Select SPI Driver"
    config BSP_USING_SPI
        bool "Enable SPI"
            select RT_USING_SPI
            default n

    if BSP_USING_SPI
        config BSP_USING_SPI1
            bool "Enable SPI1"
            default n
        config BSP_USING_SPI2
            bool "Enable SPI2"
            default n
        config BSP_USING_SPI3
            bool "Enable SPI3"
            default y
        config BSP_USING_SPI4
            bool "Enable SPI4"
            default n
    endif
endmenu

menu "Select I2C Driver"
    config BSP_USING_I2C
        bool "Enable I2C"
            select RT_USING_I2C
            default n

    if BSP_USING_I2C
        config BSP_USING_I2C1
            bool "Enable I2C1"
            default n
        if BSP_USING_I2C1
            config I2C1_BAUD_RATE
                int "Set i2c1 baud rate (HZ)"
                default 100000
        endif

        config BSP_USING_I2C2
            bool "Enable I2C2"
            default n
        if BSP_USING_I2C2
            config I2C2_BAUD_RATE
                int "Set i2c2 baud rate (HZ)"
                default 100000
        endif

        config BSP_USING_I2C3
            bool "Enable I2C3"
            default n
        if BSP_USING_I2C3
            config I2C3_BAUD_RATE
                int "Set i2c3 baud rate (HZ)"
                default 100000
        endif

        config BSP_USING_I2C4
            bool "Enable I2C4"
            default n
        if BSP_USING_I2C4
            config I2C4_BAUD_RATE
                int "Set i2c4 baud rate (HZ)"
                default 100000
        endif
    endif
endmenu

menu "Select LCD Driver"
config BSP_USING_LCD
    bool "Enable LCD"
    select RT_USING_LCD
    default y

    if BSP_USING_LCD
        config BSP_LCD_WIDTH
            int "Width of LCD panel"
            default 1000
        config BSP_LCD_HEIGHT
            int "Height of LCD panel"
            default 600
        config BSP_LCD_VSW
            int "value of LCD_VSW"
            default 2
        config BSP_LCD_VBP
            int "value of LCD_VBP"
            default 23        
        config BSP_LCD_VFP
            int "value of LCD_VFP"
            default 22
        config BSP_LCD_HSW
            int "value of LCD_HSW"
            default 2    
        config BSP_LCD_HBP
            int "value of LCD_HBP"
            default 46
        config BSP_LCD_HFP
            int "value of LCD_HFP"
            default 210       
        config BSP_LCD_PLL_DIV
            int "value of PLL DIV"
            default 8                                
    endif
endmenu

menu "Select SDHC Driver"
    if RT_USING_SDIO
        config RT_USING_SDIO1
            bool "Enable SDHC1"
            default n
        config RT_USING_SDIO2
            bool "Enable SDHC2"
           	default n
    endif
endmenu

menu "Select RTC Driver"
    if RT_USING_RTC
        config BSP_USING_ONCHIP_RTC
            bool "Enable On-Chip RTC"
            default y
    endif
endmenu

menu "Select PWM Driver"
     config RT_USING_PWM
        bool "Enable PWM"
        default n
    if RT_USING_PWM
        config BSP_USING_PWM1
            bool "Enable PWM1"
            default n
        config BSP_USING_PWM2
            bool "Enable PWM2"
            default n
        config BSP_USING_PWM3
            bool "Enable PWM3"
            default n
        config BSP_USING_PWM4
            bool "Enable PWM4"
            default n
    endif
endmenu

menu "Select ADC Driver"
     config RT_USING_ADC
        bool "Enable ADC"
        default n

    if RT_USING_ADC
        config BSP_USING_ADC1_1
            bool "Enable ADC1 CH1"
            default n
        config BSP_USING_ADC1_2
            bool "Enable ADC1 CH2"
            default n
		config BSP_USING_ADC1_3
            bool "Enable ADC1 CH3"
            default n
		config BSP_USING_ADC1_4
            bool "Enable ADC1 CH4"
            default n
    endif
endmenu

menu "Select WDT Driver"
    if RT_USING_WDT
        config RT_USING_WDT1
            bool "Enable WDT1"
            default n
        config RT_USING_WDT2
            bool "Enable WDT2"
           	default n
        config RT_USING_WDT3
            bool "Enable WDT3"
           	default n               
    endif
endmenu

menu "Select ENET Driver"
    config RT_USING_ENET1
        bool "Enable ENET1"
        default y
    config RT_USING_ENET2
        bool "Enable ENET2"
        default n
endmenu

menu "Select Wifi Driver"
    config RT_USING_WIFI_RW007
        bool "Enable wifi RW007"
        select BSP_USING_SPI2
        select PKG_USING_RW007
        select RT_USING_WIFI
        default n
    if RT_USING_WIFI_RW007
        config RW007_DAFAULT_SSID
            string "default ssid"
            default "rt-thread"
        config RW007_DAFAULT_PASSWARD
            string "default passward"
            default "12345678"
    endif
endmenu

menu "Select USB Driver"
    config BSP_USING_USB_DEVICE
        bool "Enable USB device"
        default y
endmenu

endmenu
```

## bsp/nxp/imx/imx91/Kconfig
```kconfig
mainmenu "RT-Thread Configuration"

BSP_DIR := .

RTT_DIR := ../../../..

PKGS_DIR := packages

source "$(RTT_DIR)/Kconfig"
osource "$PKGS_DIR/Kconfig"

config BOARD_IMX91
    bool
    select ARCH_ARM_CORTEX_A55
    select RT_USING_GIC_V2
    default y

config SOC_MIMX91X1D
    bool
    select ARCH_ARMV8
    select ARCH_CPU_64BIT
    select RT_USING_CACHE
    select RT_USING_COMPONENTS_INIT
    select RT_USING_USER_MAIN
    select ARCH_ARM_BOOTWITH_FLUSH_CACHE
    default y

source "$(BSP_DIR)/drivers/Kconfig"
```

## bsp/nxp/imx/imx91/drivers/Kconfig
```kconfig
menu "Hardware Drivers Config"

config BSP_USING_EARLY_CONSOLE
    bool "Enable early console"
    default n

config BSP_USING_UART1
    bool "Enable UART1"
    default y

config BSP_USING_GIC
    bool "Enalbe GIC"
    default y

config BSP_USING_GICV3
    bool "Enable GICv3"
    default y

config KERNEL_ASPACE_START
    hex "Kernel aspace start address"
    default 0x1000000

endmenu
```

## bsp/nxp/imx/imxrt/imxrt1061-forlinx-OK1061-S/board/Kconfig
```kconfig
menu "Hardware Drivers Config"

config SOC_IMXRT1061CVL5A
    bool
    select SOC_IMXRT1060_SERIES
    select RT_USING_COMPONENTS_INIT
    select RT_USING_USER_MAIN
    default y

menu "On-chip Peripheral Drivers"

    config BSP_USING_DMA
        bool "Enable DMA"
        default n

    config BSP_USING_GPIO
        bool "Enable GPIO"
        select RT_USING_PIN
        default y

    menuconfig BSP_USING_LPUART
        bool "Enable UART"
        select RT_USING_SERIAL
        default y

        if BSP_USING_LPUART
            config BSP_USING_LPUART1
                bool "Enable LPUART1"
                default y

                config BSP_LPUART1_RX_USING_DMA
                    bool "Enable LPUART1 RX DMA"
                    depends on BSP_USING_LPUART1
                    select BSP_USING_DMA
                    select RT_SERIAL_USING_DMA
                    default n

                    config BSP_LPUART1_RX_DMA_CHANNEL
                        depends on BSP_LPUART1_RX_USING_DMA
                        int "Set LPUART1 RX DMA channel (0-32)"
                        default 0

                config BSP_LPUART1_TX_USING_DMA
                    bool "Enable LPUART1 TX DMA"
                    depends on BSP_USING_LPUART1
                    select BSP_USING_DMA
                    select RT_SERIAL_USING_DMA
                    default n

                    config BSP_LPUART1_TX_DMA_CHANNEL
                        depends on BSP_LPUART1_TX_USING_DMA
                        int "Set LPUART1 TX DMA channel (0-32)"
                        default 1

            config BSP_USING_LPUART2
                bool "Enable LPUART2"
                default n

                config BSP_LPUART2_RX_USING_DMA
                    bool "Enable LPUART2 RX DMA"
                    depends on BSP_USING_LPUART2
                    select BSP_USING_DMA
                    select RT_SERIAL_USING_DMA
                    default n

                    config BSP_LPUART2_RX_DMA_CHANNEL
                        depends on BSP_LPUART2_RX_USING_DMA
                        int "Set LPUART2 RX DMA channel (0-32)"
                        default 2

                config BSP_LPUART2_TX_USING_DMA
                    bool "Enable LPUART2 TX DMA"
                    depends on BSP_USING_LPUART2
                    select BSP_USING_DMA
                    select RT_SERIAL_USING_DMA
                    default n

                    config BSP_LPUART2_TX_DMA_CHANNEL
                        depends on BSP_LPUART2_TX_USING_DMA
                        int "Set LPUART2 TX DMA channel (0-32)"
                        default 3
        endif

endmenu

menu "Onboard Peripheral Drivers"

    config BSP_USING_RS232
        bool "Enable RS232"
        select BSP_USING_LPUART1
        default n

endmenu

menu "Board extended module Drivers"

endmenu

endmenu
```

## bsp/nxp/imx/imxrt/imxrt1170-nxp-evk/Kconfig
```kconfig
mainmenu "RT-Thread Configuration"

RTT_DIR := ../../../../..

PKGS_DIR := packages

source "$(RTT_DIR)/Kconfig"
osource "$PKGS_DIR/Kconfig"
rsource "../libraries/Kconfig"
rsource "board/Kconfig"
```

## bsp/nxp/lpc/lpc1114/driver/Kconfig
```kconfig
menu "Hardware Drivers Config"

config SOC_LPC1114
    bool
    select SOC_LPC1114_SERIES
    select RT_USING_COMPONENTS_INIT
    select RT_USING_USER_MAIN
    default y

menu "On-chip Peripheral Drivers"

    menuconfig BSP_USING_SERIAL
        select RT_USING_SERIAL
        bool "Enable UART"
        default n
        
endmenu

menu "Onboard Peripheral Drivers"

endmenu

menu "Board extended module Drivers"

endmenu

endmenu
```

## bsp/nxp/lpc/lpc176x/Kconfig
```kconfig
mainmenu "RT-Thread Project Configuration"

BSP_DIR := .

RTT_DIR := ../../../..

PKGS_DIR := packages
	
source "$(RTT_DIR)/Kconfig"
osource "$PKGS_DIR/Kconfig"

config SOC_LPC176
    bool
    select ARCH_ARM_CORTEX_M3
    select PKG_USING_NXP_LPC_DRIVER
    default y
```

## bsp/nxp/lpc/lpc178x/Kconfig
```kconfig
mainmenu "RT-Thread Project Configuration"

BSP_DIR := .

RTT_DIR := ../../../..

PKGS_DIR := packages

source "$(RTT_DIR)/Kconfig"
osource "$PKGS_DIR/Kconfig"

config SOC_LPC178
    bool
    select ARCH_ARM_CORTEX_M3
    select RT_USING_COMPONENTS_INIT
    select RT_USING_USER_MAIN
    default y

source "$(BSP_DIR)/drivers/Kconfig"
```

## bsp/nxp/lpc/lpc178x/drivers/Kconfig
```kconfig
menu "Hardware Drivers Config"

config SOC_LPC178X
    bool
    select SOC_LPC178X_SERIES
    select RT_USING_COMPONENTS_INIT
    select RT_USING_USER_MAIN
    default y

menu "On-chip Peripheral Drivers"

    config BSP_USING_UART0
        bool "Enable UART0"
        default y

endmenu

menu "Onboard Peripheral Drivers"

endmenu

menu "Board extended module Drivers"

endmenu

endmenu
```

## bsp/nxp/lpc/lpc2148/Kconfig
```kconfig
mainmenu "RT-Thread Project Configuration"

BSP_DIR := .

RTT_DIR := ../../../..

PKGS_DIR := packages

source "$(RTT_DIR)/Kconfig"
osource "$PKGS_DIR/Kconfig"

config SOC_LPC2148
    bool
    select ARCH_ARM
    default y
```

## bsp/nxp/lpc/lpc5410x/Kconfig
```kconfig
mainmenu "RT-Thread Project Configuration"

BSP_DIR := .

RTT_DIR := ../../../..

PKGS_DIR := packages

source "$(RTT_DIR)/Kconfig"
osource "$PKGS_DIR/Kconfig"

config SOC_LPC5410
    bool
    select ARCH_ARM_CORTEX_M0
    default y
```

## bsp/nxp/lpc/lpc54114-lite/Kconfig
```kconfig
mainmenu "RT-Thread Configuration"

BSP_DIR := .

RTT_DIR := ../../../..

PKGS_DIR := packages

source "$(RTT_DIR)/Kconfig"
osource "$PKGS_DIR/Kconfig"

config SOC_LPC54114
    bool
    select ARCH_ARM_CORTEX_M4
    select RT_USING_COMPONENTS_INIT
    select RT_USING_USER_MAIN
    default y


source "$(BSP_DIR)/drivers/Kconfig"
```
