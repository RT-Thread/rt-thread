## bsp/hpmicro/hpm6800evk/board/Kconfig
```kconfig
menu "Hardware Drivers Config"

config SOC_HPM6800
    bool
    select SOC_HPM6800_SERIES
    select RT_USING_COMPONENTS_INIT
    select RT_USING_USER_MAIN
    default y

config BSP_USING_ENET_PHY_RTL8211
    bool
    default n

if BSP_USING_ETH
    config LWIP_SUPPORT_CUSTOM_PBUF
    int
    default 1
endif

menu "On-chip Peripheral Drivers"
    config BSP_USING_GPIO
        bool "Enable GPIO"
        select RT_USING_PIN if BSP_USING_GPIO
        default n
        if BSP_USING_GPIO
            config BSP_GPIO_IRQ_PRIORITY
            int "GPIO Interrupt Priority"
            range 1 7
            default 1
        endif

    menuconfig BSP_USING_UART
        bool "Enable UART"
        default y
        select RT_USING_SERIAL
        if BSP_USING_UART
            menuconfig BSP_USING_UART0
                bool "Enable UART0 (Debugger)"
                default y
                if BSP_USING_UART0
                    config BSP_UART0_RX_USING_DMA
                        bool "Enable UART0 RX DMA"
                        depends on BSP_USING_UART0 && RT_SERIAL_USING_DMA
                        default n
                    config BSP_UART0_TX_USING_DMA
                        bool "Enable UART0 TX DMA"
                        depends on BSP_USING_UART0 && RT_SERIAL_USING_DMA
                        default n
                    config BSP_UART0_RX_BUFSIZE
                        int "Set UART0 RX buffer size"
                        range 64 65535
                        depends on RT_USING_SERIAL_V2
                        default 128
                    config BSP_UART0_TX_BUFSIZE
                        int "Set UART0 TX buffer size"
                        range 0 65535
                        depends on RT_USING_SERIAL_V2
                        default 0
                    config BSP_UART0_IRQ_PRIORITY
                        int "UART0 Interrupt Priority"
                        range 1 7
                        default 1
                endif
            menuconfig BSP_USING_UART1
                bool "Enable UART1"
                default n
                if BSP_USING_UART1
                    config BSP_UART1_RX_USING_DMA
                        bool "Enable UART1 RX DMA"
                        depends on BSP_USING_UART1 && RT_SERIAL_USING_DMA
                        default n
                    config BSP_UART1_TX_USING_DMA
                        bool "Enable UART1 TX DMA"
                        depends on BSP_USING_UART1 && RT_SERIAL_USING_DMA
                        default n
                    config BSP_UART1_RX_BUFSIZE
                        int "Set UART1 RX buffer size"
                        range 64 65535
                        depends on RT_USING_SERIAL_V2
                        default 1024
                    config BSP_UART1_TX_BUFSIZE
                        int "Set UART1 TX buffer size"
                        range 0 65535
                        depends on RT_USING_SERIAL_V2
                        default 0
                    config BSP_UART1_IRQ_PRIORITY
                        int "UART1 Interrupt Priority"
                        range 1 7
                        default 1
                endif
            menuconfig BSP_USING_UART2
                bool "Enable UART2"
                default n
                if BSP_USING_UART2
                    config BSP_UART2_RX_USING_DMA
                        bool "Enable UART2 RX DMA"
                        depends on BSP_USING_UART2 && RT_SERIAL_USING_DMA
                        default n
                    config BSP_UART2_TX_USING_DMA
                        bool "Enable UART2 TX DMA"
                        depends on BSP_USING_UART2 && RT_SERIAL_USING_DMA
                        default n
                    config BSP_UART2_RX_BUFSIZE
                        int "Set UART2 RX buffer size"
                        range 64 65535
                        depends on RT_USING_SERIAL_V2
                        default 1024
                    config BSP_UART2_TX_BUFSIZE
                        int "Set UART2 TX buffer size"
                        range 0 65535
                        depends on RT_USING_SERIAL_V2
                        default 0
                    config BSP_UART2_IRQ_PRIORITY
                        int "UART2 Interrupt Priority"
                        range 1 7
                        default 1
                endif
            menuconfig BSP_USING_UART3
                bool "Enable UART3"
                default y
                if BSP_USING_UART3
                    config BSP_UART3_RX_USING_DMA
                        bool "Enable UART3 RX DMA"
                        depends on BSP_USING_UART3 && RT_SERIAL_USING_DMA
                        default n
                    config BSP_UART3_TX_USING_DMA
                        bool "Enable UART3 TX DMA"
                        depends on BSP_USING_UART3 && RT_SERIAL_USING_DMA
                        default n
                    config BSP_UART3_RX_BUFSIZE
                        int "Set UART3 RX buffer size"
                        range 64 65535
                        depends on RT_USING_SERIAL_V2
                        default 1024
                    config BSP_UART3_TX_BUFSIZE
                        int "Set UART3 TX buffer size"
                        range 0 65535
                        depends on RT_USING_SERIAL_V2
                        default 0
                    config BSP_UART3_IRQ_PRIORITY
                        int "UART3 Interrupt Priority"
                        range 1 7
                        default 1
                endif
            menuconfig BSP_USING_UART4
                bool "Enable UART4"
                default n
                if BSP_USING_UART4
                    config BSP_UART4_RX_USING_DMA
                        bool "Enable UART4 RX DMA"
                        depends on BSP_USING_UART4 && RT_SERIAL_USING_DMA
                        default n
                    config BSP_UART4_TX_USING_DMA
                        bool "Enable UART4 TX DMA"
                        depends on BSP_USING_UART4 && RT_SERIAL_USING_DMA
                        default n
                    config BSP_UART4_RX_BUFSIZE
                        int "Set UART4 RX buffer size"
                        range 64 65535
                        depends on RT_USING_SERIAL_V2
                        default 1024
                    config BSP_UART4_TX_BUFSIZE
                        int "Set UART4 TX buffer size"
                        range 0 65535
                        depends on RT_USING_SERIAL_V2
                        default 0
                    config BSP_UART4_IRQ_PRIORITY
                        int "UART4 Interrupt Priority"
                        range 1 7
                        default 1
                endif
            menuconfig BSP_USING_UART5
                bool "Enable UART5"
                default n
                if BSP_USING_UART5
                    config BSP_UART5_RX_USING_DMA
                        bool "Enable UART5 RX DMA"
                        depends on BSP_USING_UART5 && RT_SERIAL_USING_DMA
                        default n
                    config BSP_UART5_TX_USING_DMA
                        bool "Enable UART5 TX DMA"
                        depends on BSP_USING_UART5 && RT_SERIAL_USING_DMA
                        default n
                    config BSP_UART5_RX_BUFSIZE
                        int "Set UART5 RX buffer size"
                        range 64 65535
                        depends on RT_USING_SERIAL_V2
                        default 1024
                    config BSP_UART5_TX_BUFSIZE
                        int "Set UART5 TX buffer size"
                        range 0 65535
                        depends on RT_USING_SERIAL_V2
                        default 0
                    config BSP_UART5_IRQ_PRIORITY
                        int "UART5 Interrupt Priority"
                        range 1 7
                        default 1
                endif
            menuconfig BSP_USING_UART6
                bool "Enable UART6"
                default n
                if BSP_USING_UART6
                    config BSP_UART6_RX_USING_DMA
                        bool "Enable UART6 RX DMA"
                        depends on BSP_USING_UART6 && RT_SERIAL_USING_DMA
                        default n
                    config BSP_UART6_TX_USING_DMA
                        bool "Enable UART6 TX DMA"
                        depends on BSP_USING_UART6 && RT_SERIAL_USING_DMA
                        default n
                    config BSP_UART6_RX_BUFSIZE
                        int "Set UART6 RX buffer size"
                        range 64 65535
                        depends on RT_USING_SERIAL_V2
                        default 1024
                    config BSP_UART6_TX_BUFSIZE
                        int "Set UART6 TX buffer size"
                        range 0 65535
                        depends on RT_USING_SERIAL_V2
                        default 0
                    config BSP_UART6_IRQ_PRIORITY
                        int "UART6 Interrupt Priority"
                        range 1 7
                        default 1
                endif
            menuconfig BSP_USING_UART7
                bool "Enable UART7"
                default n
                if BSP_USING_UART7
                    config BSP_UART7_RX_USING_DMA
                        bool "Enable UART7 RX DMA"
                        depends on BSP_USING_UART7 && RT_SERIAL_USING_DMA
                        default n
                    config BSP_UART7_TX_USING_DMA
                        bool "Enable UART7 TX DMA"
                        depends on BSP_USING_UART7 && RT_SERIAL_USING_DMA
                        default n
                    config BSP_UART7_RX_BUFSIZE
                        int "Set UART7 RX buffer size"
                        range 64 65535
                        depends on RT_USING_SERIAL_V2
                        default 1024
                    config BSP_UART7_TX_BUFSIZE
                        int "Set UART7 TX buffer size"
                        range 0 65535
                        depends on RT_USING_SERIAL_V2
                        default 0
                    config BSP_UART7_IRQ_PRIORITY
                        int "UART7 Interrupt Priority"
                        range 1 7
                        default 1
                endif
        endif

    menuconfig BSP_USING_SPI
        bool "Enable SPI"
        default n
        select RT_USING_SPI if BSP_USING_SPI
        if BSP_USING_SPI
            config BSP_USING_SPI0
                bool "Enable SPI0"
                default n
                if BSP_USING_SPI0
                    config BSP_SPI0_USING_DMA
                        bool "Enable SPI0 DMA"
                        default n
                    config BSP_SPI0_IRQ_PRIORITY
                        int "SPI0 Interrupt Priority"
                        range 1 7
                        default 1
                    choice
                        prompt "Select SPI0 CS TYPE"
                        default BSP_SPI0_USING_SOFT_CS
                        config BSP_SPI0_USING_SOFT_CS
                            bool "Enable SPI0 software cs"
                        config BSP_SPI0_USING_HARD_CS
                            bool "Enable SPI0 hardware cs"
                    endchoice
                    choice
                        prompt "Select SPI0 IO mode"
                        default BSP_SPI0_USING_SINGLE_IO
                        config BSP_SPI0_USING_SINGLE_IO
                            bool "Enable SPI0 single IO mode"
                        config BSP_SPI0_USING_DUAL_IO
                            bool "Enable SPI0 dual IO mode"
                        config BSP_SPI0_USING_QUAD_IO
                            bool "Enable SPI0 quad IO mode"
                    endchoice
                endif
            config BSP_USING_SPI1
                bool "Enable SPI1"
                default n
                if BSP_USING_SPI1
                    config BSP_SPI1_USING_DMA
                        bool "Enable SPI1 DMA"
                        default n
                    config BSP_SPI1_IRQ_PRIORITY
                        int "SPI1 Interrupt Priority"
                        range 1 7
                        default 1
                    choice
                        prompt "Select SPI1 CS TYPE"
                        default BSP_SPI1_USING_SOFT_CS
                        config BSP_SPI1_USING_SOFT_CS
                            bool "Enable SPI1 software cs"
                        config BSP_SPI1_USING_HARD_CS
                            bool "Enable SPI1 hardware cs"
                    endchoice
                    choice
                        prompt "Select SPI1 IO mode"
                        default BSP_SPI1_USING_SINGLE_IO
                        config BSP_SPI1_USING_SINGLE_IO
                            bool "Enable SPI1 single IO mode"
                        config BSP_SPI1_USING_DUAL_IO
                            bool "Enable SPI1 dual IO mode"
                        config BSP_SPI1_USING_QUAD_IO
                            bool "Enable SPI1 quad IO mode"
                    endchoice
                endif
            config BSP_USING_SPI2
                bool "Enable SPI2"
                default n
                if BSP_USING_SPI2
                    config BSP_SPI2_USING_DMA
                        bool "Enable SPI2 DMA"
                        default n
                    config BSP_SPI2_IRQ_PRIORITY
                        int "SPI2 Interrupt Priority"
                        range 1 7
                        default 1
                    choice
                        prompt "Select SPI2 CS TYPE"
                        default BSP_SPI2_USING_SOFT_CS
                        config BSP_SPI2_USING_SOFT_CS
                            bool "Enable SPI2 software cs"
                        config BSP_SPI2_USING_HARD_CS
                            bool "Enable SPI2 hardware cs"
                    endchoice
                    choice
                        prompt "Select SPI2 IO mode"
                        default BSP_SPI2_USING_SINGLE_IO
                        config BSP_SPI2_USING_SINGLE_IO
                            bool "Enable SPI2 single IO mode"
                        config BSP_SPI2_USING_DUAL_IO
                            bool "Enable SPI2 dual IO mode"
                        config BSP_SPI2_USING_QUAD_IO
                            bool "Enable SPI2 quad IO mode"
                    endchoice
                endif
            config BSP_USING_SPI3
                bool "Enable SPI3"
                default n
                if BSP_USING_SPI3
                    config BSP_SPI3_USING_DMA
                        bool "Enable SPI3 DMA"
                        default n
                    config BSP_SPI3_IRQ_PRIORITY
                        int "SPI3 Interrupt Priority"
                        range 1 7
                        default 1
                    choice
                        prompt "Select SPI3 CS TYPE"
                        default BSP_SPI3_USING_SOFT_CS
                        config BSP_SPI3_USING_SOFT_CS
                            bool "Enable SPI3 software cs"
                        config BSP_SPI3_USING_HARD_CS
                            bool "Enable SPI3 hardware cs"
                    endchoice
                    choice
                        prompt "Select SPI3 IO mode"
                        default BSP_SPI3_USING_SINGLE_IO
                        config BSP_SPI3_USING_SINGLE_IO
                            bool "Enable SPI3 single IO mode"
                        config BSP_SPI3_USING_DUAL_IO
                            bool "Enable SPI3 dual IO mode"
                        config BSP_SPI3_USING_QUAD_IO
                            bool "Enable SPI3 quad IO mode"
                    endchoice
                endif
        endif

    menuconfig BSP_USING_RTC
       bool "Enable RTC"
       default n
       select RT_USING_RTC if BSP_USING_RTC

    menuconfig BSP_USING_ETH
       bool "Enable Ethernet"
       default n

       select RT_USING_ETH if BSP_USING_ETH
       select RT_USING_PHY if BSP_USING_ETH

       if BSP_USING_ETH
           choice
               prompt "ETH"
               default BSP_USING_ETH0

               config BSP_USING_ETH0
               bool "Enable ETH0"
               select BSP_USING_ENET_PHY_RTL8211
           endchoice
       endif

    menuconfig BSP_USING_SDXC
        bool "Enable SDXC"
        default n
        select RT_USING_SDIO if BSP_USING_SDXC
        select RT_USING_PIN if BSP_USING_SDXC
        if BSP_USING_SDXC
            config BSP_USING_SDXC0
                bool "Enable SDXC0"
                default n
            if BSP_USING_SDXC0
                config BSP_SDXC0_ENABLE_INTERRUPT_DRIVEN
                    bool "Enable Interrupt-driven mode"
                    default n
                choice
                    prompt "Select buffer type for unaligned data transfer"
                    default BSP_SDXC0_USE_CACHEABLE_BUFFER
                    config BSP_SDXC0_USE_CACHEABLE_BUFFER
                        bool "Use cacheable buffer"
                    config BSP_SDXC0_USE_NONCACHEABLE_BUFFER
                        bool "Use non-cacheable buffer"
                endchoice
                if BSP_SDXC0_USE_CACHEABLE_BUFFER
                    config BSP_SDXC0_CACHEABLE_BUFFER_SIZE_IN_SECTOR
                        int "Cacheable buffer size in sectors(512 bytes per sector)"
                        range 1  1024
                        default 32
                endif
                if BSP_SDXC0_USE_NONCACHEABLE_BUFFER
                    config BSP_SDXC0_NONCACHEABLE_BUFFER_SIZE_IN_SECTOR
                        int "Non-cacheable buffer size in sectors(512 bytes per sector)"
                        range 1  1024
                        default 32
                    config BSP_SDXC0_NONCACHEABLE_BUF_IN_FAST_RAM
                        bool "Place non-cacheable buffer into FAST RAM(available only if FAST_RAM is in ILM/DLM)"
                        default n
                endif

                config BSP_SDXC0_IRQ_PRIORITY
                    int "SDXC Interrupt Priority"
                    range 1 7
                    default 1
                choice
                    prompt "Select BUS_WIDTH"
                    default BSP_SDXC0_BUS_WIDTH_8BIT
                    config BSP_SDXC0_BUS_WIDTH_1BIT
                        bool "1-bit"
                    config BSP_SDXC0_BUS_WIDTH_4BIT
                        bool "4-bit"
                    config BSP_SDXC0_BUS_WIDTH_8BIT
                        bool "8-bit"
                endchoice
                choice
                    prompt "Select Voltage"
                    default BSP_SDXC0_VOLTAGE_1V8
                    config BSP_SDXC0_VOLTAGE_3V3
                        bool "3.3V"
                    config BSP_SDXC0_VOLTAGE_1V8
                        bool "1.8V"
                    config BSP_SDXC0_VOLTAGE_DUAL
                        bool "Dual voltage 3.3V / 1.8V"
                endchoice
                config BSP_SDXC0_VSEL_PIN
                    default "None"
                    string "VSEL pin name"
                config BSP_SDXC0_PWR_PIN
                    default "None"
                    string "PWR pin name"
            endif

            config BSP_USING_SDXC1
                bool "Enable SDXC1"
                default y
                if BSP_USING_SDXC1
                    config BSP_SDXC1_ENABLE_INTERRUPT_DRIVEN
                        bool "Enable Interrupt-driven mode"
                        default n
                choice
                    prompt "Select buffer type for unaligned data transfer"
                    default BSP_SDXC1_USE_CACHEABLE_BUFFER
                    config BSP_SDXC1_USE_CACHEABLE_BUFFER
                        bool "Use cacheable buffer"
                    config BSP_SDXC1_USE_NONCACHEABLE_BUFFER
                        bool "Use non-cacheable buffer"
                endchoice
                if BSP_SDXC1_USE_CACHEABLE_BUFFER
                    config BSP_SDXC1_CACHEABLE_BUFFER_SIZE_IN_SECTOR
                        int "Cacheable buffer size in sectors(512 bytes per sector)"
                        range 1  1024
                        default 32
                endif
                if BSP_SDXC1_USE_NONCACHEABLE_BUFFER
                    config BSP_SDXC1_NONCACHEABLE_BUFFER_SIZE_IN_SECTOR
                        int "Non-cacheable buffer size in sectors(512 bytes per sector)"
                        range 1  1024
                        default 32
                    config BSP_SDXC1_NONCACHEABLE_BUF_IN_FAST_RAM
                        bool "Place non-cacheable buffer into FAST RAM(available only if FAST_RAM is in ILM/DLM)"
                        default n
                endif
                config BSP_SDXC1_IRQ_PRIORITY
                    int "SDXC Interrupt Priority"
                    range 1 7
                    default 1
                choice
                    prompt "Select BUS_WIDTH"
                    default BSP_SDXC1_BUS_WIDTH_4BIT
                    config BSP_SDXC1_BUS_WIDTH_1BIT
                        bool "1-bit"
                    config BSP_SDXC1_BUS_WIDTH_4BIT
                        bool "4-bit"
                endchoice
                choice
                    prompt "Select Voltage"
                    default BSP_SDXC1_VOLTAGE_3V3
                    config BSP_SDXC1_VOLTAGE_3V3
                        bool "3.3V"
                    config BSP_SDXC1_VOLTAGE_1V8
                        bool "1.8V"
                    config BSP_SDXC1_VOLTAGE_DUAL
                        bool "Dual voltage 3.3V / 1.8V"
                endchoice
                config BSP_SDXC1_VSEL_PIN
                        default "PD12"
                    string "VSEL pin name"
                config BSP_SDXC1_PWR_PIN
                        default "PD07"
                    string "PWR pin name"
            endif
        endif

    menuconfig BSP_USING_TOUCH
       bool "Enable touch"
       default n
        if BSP_USING_TOUCH
            config BSP_USING_TOUCH_GT9xx
                bool "Enable GT9xx"
                default y

            config BSP_USING_TOUCH_FT5406
                bool "Enable FT5406"
                default n
        endif

    menuconfig BSP_USING_LCD
        bool "Enable LCD"
        default n
        if BSP_USING_LCD
            config BSP_USING_LCD_ISR
                bool "Enable LCD interrupt"
                default n
        endif

    menuconfig BSP_USING_LVGL
        bool "Enable LVGL"
        default n
        select PKG_USING_LVGL if BSP_USING_LVGL
        select BSP_USING_PDMA if BSP_USING_LVGL

    menuconfig BSP_USING_PDMA
        bool "Enable PDMA Driver"
        default n

    menuconfig BSP_USING_GPTMR
        bool "Enable GPTMR"
        default n
        select RT_USING_CLOCK_TIME if BSP_USING_GPTMR
        if BSP_USING_GPTMR
            config BSP_USING_GPTMR0
                bool "Enable GPTMR0"
                default n
                if BSP_USING_GPTMR0
                    config BSP_GPTMR0_IRQ_PRIORITY
                    int "GPTMR0 Interrupt Priority"
                    range 1 7
                    default 1
                endif
            config BSP_USING_GPTMR1
                bool "Enable GPTMR1"
                default n
                if BSP_USING_GPTMR1
                    config BSP_GPTMR1_IRQ_PRIORITY
                    int "GPTMR1 Interrupt Priority"
                    range 1 7
                    default 1
                endif
            config BSP_USING_GPTMR2
                bool "Enable GPTMR2"
                default n
                if BSP_USING_GPTMR2
                    config BSP_GPTMR2_IRQ_PRIORITY
                    int "GPTMR2 Interrupt Priority"
                    range 1 7
                    default 1
                endif
            config BSP_USING_GPTMR3
                bool "Enable GPTMR3"
                default n
                if BSP_USING_GPTMR3
                    config BSP_GPTMR3_IRQ_PRIORITY
                    int "GPTMR3 Interrupt Priority"
                    range 1 7
                    default 1
                endif
            config BSP_USING_GPTMR4
                bool "Enable GPTMR4"
                default n
                if BSP_USING_GPTMR4
                    config BSP_GPTMR4_IRQ_PRIORITY
                    int "GPTMR4 Interrupt Priority"
                    range 1 7
                    default 1
                endif
            config BSP_USING_GPTMR5
                bool "Enable GPTMR5"
                default n
                if BSP_USING_GPTMR5
                    config BSP_GPTMR5_IRQ_PRIORITY
                    int "GPTMR5 Interrupt Priority"
                    range 1 7
                    default 1
                endif
            config BSP_USING_GPTMR6
                bool "Enable GPTMR6"
                default n
                if BSP_USING_GPTMR6
                    config BSP_GPTMR6_IRQ_PRIORITY
                    int "GPTMR6 Interrupt Priority"
                    range 1 7
                    default 1
                endif
            config BSP_USING_GPTMR7
                bool "Enable GPTMR7"
                default n
                if BSP_USING_GPTMR7
                    config BSP_GPTMR7_IRQ_PRIORITY
                    int "GPTMR7 Interrupt Priority"
                    range 1 7
                    default 1
                endif
        endif

    menuconfig BSP_USING_I2C
        bool "Enable I2C"
        default n
        select RT_USING_I2C if BSP_USING_I2C
        if BSP_USING_I2C
            config BSP_USING_I2C0
                bool "Enable I2C0"
                default y
                if BSP_USING_I2C0
                    config BSP_I2C0_USING_DMA
                        bool "Enable I2C0 DMA"
                        default n
                    config BSP_I2C0_IRQ_PRIORITY
                        int "I2C0 Interrupt Priority"
                        range 1 7
                        default 1
                endif
            config BSP_USING_I2C1
                bool "Enable I2C1"
                default n
                if BSP_USING_I2C1
                    config BSP_I2C1_USING_DMA
                        bool "Enable I2C1 DMA"
                        default n
                    config BSP_I2C1_IRQ_PRIORITY
                        int "I2C1 Interrupt Priority"
                        range 1 7
                        default 1
                endif
            config BSP_USING_I2C2
                bool "Enable I2C2"
                default n
                if BSP_USING_I2C2
                    config BSP_I2C2_USING_DMA
                        bool "Enable I2C2 DMA"
                        default n
                    config BSP_I2C2_IRQ_PRIORITY
                        int "I2C2 Interrupt Priority"
                        range 1 7
                        default 1
                endif
            config BSP_USING_I2C3
                bool "Enable I2C3"
                default n
                if BSP_USING_I2C3
                    config BSP_I2C3_USING_DMA
                        bool "Enable I2C3 DMA"
                        default n
                    config BSP_I2C3_IRQ_PRIORITY
                        int "I2C3 Interrupt Priority"
                        range 1 7
                        default 1
                endif
        endif


    menuconfig INIT_EXT_RAM_FOR_DATA
        bool "INIT_EXT_RAM_FOR_DATA"
        default y


    menuconfig BSP_USING_XPI_FLASH
        bool "Enable XPI FLASH"
        default n
        select RT_USING_FAL if BSP_USING_XPI_FLASH

    menuconfig BSP_USING_DAO
        bool "Enable Audio DAO play"
        default n
        select RT_USING_AUDIO if BSP_USING_DAO

    menuconfig BSP_USING_PDM
        bool "Enable Audio PDM record"
        default n
        select RT_USING_AUDIO if BSP_USING_PDM

    menuconfig BSP_USING_I2S
        bool "Enable Audio I2S device"
        default n
        select RT_USING_AUDIO if BSP_USING_I2S
        if BSP_USING_I2S
            config BSP_USING_I2S3
                bool "Enable I2S3"
                default y
            config BSP_USING_AUDIO_CODEC_WM8960
                bool "Enable audio codec on board"
                default y
        endif

    menuconfig BSP_USING_USB
       bool "Enable USB"
       default n
       if BSP_USING_USB
            config BSP_USING_USB_DEVICE
                bool "Enable USB Device"
                select RT_USING_CACHE
                default n
            config BSP_USING_USB_HOST
                bool "Enable USB Host"
                select RT_USING_CACHE
                default n
       endif


    menuconfig BSP_USING_EWDG
        bool "Enable EWDG"
        default n
        select RT_USING_WDT if BSP_USING_EWDG
        if BSP_USING_EWDG
            config BSP_USING_EWDG0
                bool "Enable EWDG0"
                default n
            config BSP_USING_EWDG1
                bool "Enable EWDG1"
                default n
        endif

    menuconfig BSP_USING_MCAN
        bool "Enable MCAN"
        default n
        select RT_USING_CAN if BSP_USING_MCAN
        if BSP_USING_MCAN
            config BSP_USING_MCAN0
                bool "Enable MCAN0"
                default n
                if BSP_USING_MCAN0
                    config BSP_MCAN0_IRQ_PRIORITY
                        int "MCAN0 Interrupt Priority"
                        range 1 7
                        default 1
                endif
            config BSP_USING_MCAN1
                bool "Enable MCAN1"
                default n
                if BSP_USING_MCAN1
                    config BSP_MCAN1_IRQ_PRIORITY
                        int "MCAN1 Interrupt Priority"
                        range 1 7
                        default 1
                endif
            config BSP_USING_MCAN2
                bool "Enable MCAN2"
                default n
                if BSP_USING_MCAN2
                    config BSP_MCAN2_IRQ_PRIORITY
                        int "MCAN2 Interrupt Priority"
                        range 1 7
                        default 1
                endif
            config BSP_USING_MCAN3
                bool "Enable MCAN3"
                default n
                if BSP_USING_MCAN3
                    config BSP_MCAN3_IRQ_PRIORITY
                        int "MCAN3 Interrupt Priority"
                        range 1 7
                        default 1
                endif
            config BSP_USING_MCAN4
                bool "Enable MCAN4"
                default n
                if BSP_USING_MCAN4
                    config BSP_MCAN4_IRQ_PRIORITY
                        int "MCAN4 Interrupt Priority"
                        range 1 7
                        default 1
                endif
            config BSP_USING_MCAN5
                bool "Enable MCAN5"
                default n
                if BSP_USING_MCAN5
                    config BSP_MCAN5_IRQ_PRIORITY
                        int "MCAN5 Interrupt Priority"
                        range 1 7
                        default 1
                endif
            config BSP_USING_MCAN6
                bool "Enable MCAN6"
                default n
                if BSP_USING_MCAN6
                    config BSP_MCAN6_IRQ_PRIORITY
                        int "MCAN6 Interrupt Priority"
                        range 1 7
                        default 1
                endif
            config BSP_USING_MCAN7
                bool "Enable MCAN7"
                default n
                if BSP_USING_MCAN7
                    config BSP_MCAN7_IRQ_PRIORITY
                        int "MCAN7 Interrupt Priority"
                        range 1 7
                        default 1
                endif
        endif

    menuconfig BSP_USING_ADC
        bool "Enable ADC"
        default n
        select RT_USING_ADC if BSP_USING_ADC
        if BSP_USING_ADC
            menuconfig BSP_USING_ADC16
                bool "Enable ADC16"
                default n
                if BSP_USING_ADC16
                    config BSP_USING_ADC3
                        bool "Enable ADC3"
                        default n
                endif
         endif

    menuconfig BSP_USING_CAMERA
        bool "Enable camera"
        default n
            select BSP_USING_CAM if BSP_USING_CAMERA
            select BSP_USING_MIPI_CSI if BSP_USING_CAMERA
            if BSP_USING_CAMERA
                choice
                    prompt "Select camera"
                    default BSP_USING_CAMERA_OV5640
                    config BSP_USING_CAMERA_MT9M114
                        bool "Enable mt9m114"
                    config BSP_USING_CAMERA_OV5640
                        bool "Enable ov5640"
                    config BSP_USING_CAMERA_OV7725
                        bool "Enable ov7725"
                endchoice
            endif

    menuconfig BSP_USING_JPEG
        bool "Enable JPEG Driver"
        default n

    menuconfig BSP_USING_CAM
        bool "Enable CAM Driver"
        default n

    menuconfig  BSP_USING_PANEL
        bool "Enable panel"
        default n
        select BSP_USING_MIPI_DSI if BSP_USING_PANEL
        select BSP_USING_PIXELMUX if BSP_USING_PANEL
        if BSP_USING_PANEL
            choice
                prompt "Select Panel"
                default BSP_USEING_PANEL_MIPI_MC10128007_31B
                config BSP_USEING_PANEL_RGB_TM070RDH13
                    bool "Enable RGB TM070RDH13"
                config BSP_USEING_PANEL_MIPI_MC10128007_31B
                    bool "Enable MIPI MC10128007_31B"
                config BSP_USEING_PANEL_LVDS_TM103XDGP01
                    bool "Enable LVDS TM103XDGP01"
                config BSP_USEING_PANEL_LVDS_CC10128007
                    bool "Enable LVDS CC10128007"
            endchoice
        endif

    menuconfig BSP_USING_PIXELMUX
        bool "Enable pixelmux Driver"
        default n

    menuconfig BSP_USING_MIPI_CSI
        bool "Enable MIPI CSI Driver"
        default n

    menuconfig BSP_USING_MIPI_DSI
        bool "Enable MIPI DSI Driver"
        default n

    menuconfig BSP_USING_LVB
        bool "Enable LVB Driver"
        default n

    menuconfig BSP_USING_LCB
        bool "Enable LCB Driver"
        default n

    menuconfig BSP_USING_RTT_LCD_DRIVER
        bool "Enable RTT LCD Driver"
        select BSP_USING_LCD
        default n
        if BSP_USING_RTT_LCD_DRIVER
            config BSP_RTT_LCD_IRQ_PRIORITY
                int "RTT LCD Interrupt Priority"
                range 1 7
                default 1
        endif
endmenu

endmenu
```
