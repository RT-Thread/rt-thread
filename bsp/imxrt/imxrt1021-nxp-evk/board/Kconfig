## bsp/k230/board/Kconfig
```kconfig
menu "Drivers Configuration"

    menuconfig BSP_USING_SPI
        bool "Enable SPI"
        select RT_USING_SPI
        select RT_USING_QSPI
        default n

        if BSP_USING_SPI
            config BSP_USING_SPI0
                bool "Enable SPI0"
                help
                    Support 1, 2, 4 and 8 lines, Max clock frequency is 200 Mhz.
                default n

            config BSP_USING_SPI1
                bool "Enable SPI1"
                help
                    Support 1, 2, and 4 lines, Max clock frequency is 100 Mhz.
                default n

            config BSP_USING_SPI2
                bool "Enable SPI2"
                help
                    Support 1, 2, and 4 lines, Max clock frequency is 100 Mhz.
                default n
        endif

    menuconfig BSP_USING_I2C
        bool "Enable I2C"
        select RT_USING_I2C
        default n

        if BSP_USING_I2C
            config BSP_USING_I2C0
                bool "Enable I2C0"
                default n

            config BSP_USING_I2C1
                bool "Enable I2C1"
                default n

            config BSP_USING_I2C2
                bool "Enable I2C2"
                default n

            config BSP_USING_I2C3
                bool "Enable I2C3"
                default n

            config BSP_USING_I2C4
                bool "Enable I2C4"
                default n

        endif

    config BSP_USING_RTC
        bool "Enable RTC"
        select RT_USING_RTC
        default n

    config BSP_USING_ADC
        bool "Enable ADC"
        select RT_USING_ADC
        default n

    config BSP_USING_TS
        bool "Enable Temperature Sensor"
        select RT_USING_TS
        default n

    menuconfig BSP_USING_UART
        bool "Enable UART"
        select RT_USING_UART
        default y

        if BSP_USING_UART
            config BSP_UART_USING_DMA
                bool "Enable UART with DMA"
                default y

            config BSP_USING_UART0
                bool "Enable UART0"
                default y

            config BSP_USING_UART1
                bool "Enable UART1"
                default n

            config BSP_USING_UART2
                bool "Enable UART2"
                default n

            config BSP_USING_UART3
                bool "Enable UART3"
                default n

            config BSP_USING_UART4
                bool "Enable UART4"
                default n
        endif

    menuconfig BSP_USING_PWM
        bool "Enable PWM"
        select RT_USING_PWM
        default n

        if BSP_USING_PWM
            config BSP_USING_PWM0
                bool "Enable PWM0"
                default n

            config BSP_USING_PWM1
                bool "Enable PWM1"
                default n

        endif

    config BSP_USING_HARDLOCK
        bool "Enable Hard-Lock"
        default y

    menuconfig BSP_USING_SDIO
        bool "Enable SDIO"
        select RT_USING_SDIO
        default y

        if BSP_USING_SDIO

            choice BSP_SDIO_DEV
                prompt "Select SDIO device"
                default BSP_USING_SDIO0
                help
                    Select the SDIO device to be used.

                config BSP_USING_SDIO0
                    bool "Enable SDIO0"

                    if BSP_USING_SDIO0
                        config BSP_SDIO0_EMMC
                        bool "Enable eMMC"
                        default n

                        config BSP_SDIO0_1V8
                        bool "Enable 1.8V"
                        default n
                    endif

                config BSP_USING_SDIO1
                    bool "Enable SDIO1"
            endchoice

            config BSP_SD_MNT_DEVNAME
                string "The name of the SD-BlkDev to be mounted"
                default "sd0p1"
        endif

    menuconfig BSP_USING_TIMERS
        bool "Enable Hardware Timers"
        select RT_USING_HWTIMER
        default n

        if BSP_USING_TIMERS
            config BSP_USING_TIMER0
                bool "Enable Timer0"
                default n

            config BSP_USING_TIMER1
                bool "Enable Timer1"
                default n

            config BSP_USING_TIMER2
                bool "Enable Timer2"
                default n

            config BSP_USING_TIMER3
                bool "Enable Timer3"
                default n

            config BSP_USING_TIMER4
                bool "Enable Timer4"
                default n

            config BSP_USING_TIMER5
                bool "Enable Timer5"
                default n
        endif

    menuconfig BSP_USING_WDT
        bool "Enable Watchdog Timer"
        select RT_USING_WDT
        default n

        if BSP_USING_WDT
            config BSP_USING_WDT0
                bool "Enable WDT0"
                default n

            config BSP_USING_WDT1
                bool "Enable WDT1"
                default n

        endif

    menuconfig BSP_USING_PDMA
        bool "Enable PDMA"
        select RT_USING_PDMA
        default n

        if BSP_USING_PDMA
            config BSP_USING_PDMA_CHANNEL0
                bool "Enable PDMA Channel 0"
                default n

            config BSP_USING_PDMA_CHANNEL1
                bool "Enable PDMA Channel 1"
                default n

            config BSP_USING_PDMA_CHANNEL2
                bool "Enable PDMA Channel 2"
                default n

            config BSP_USING_PDMA_CHANNEL3
                bool "Enable PDMA Channel 3"
                default n

            config BSP_USING_PDMA_CHANNEL4
                bool "Enable PDMA Channel 4"
                default n

            config BSP_USING_PDMA_CHANNEL5
                bool "Enable PDMA Channel 5"
                default n

            config BSP_USING_PDMA_CHANNEL6
                bool "Enable PDMA Channel 6"
                default n

            config BSP_USING_PDMA_CHANNEL7
                bool "Enable PDMA Channel 7"
                default n
        endif

    config BSP_UTEST_DRIVERS
        bool "Enable drivers utest"
        select RT_USING_UTEST
        default n

endmenu
```

## bsp/lm3s8962/Kconfig
```kconfig
mainmenu "RT-Thread Project Configuration"

BSP_DIR := .

RTT_DIR := ../..

PKGS_DIR := packages

ENV_DIR := /

source "$(RTT_DIR)/Kconfig"
osource "$PKGS_DIR/Kconfig"

config SOC_LM3S8962
    bool
    select ARCH_ARM_CORTEX_M3
    default y

config RT_LWIP_PBUF_POOL_BUFSIZE
    int "The size of each pbuf in the pbuf pool"
    range 1500 2000
    default 1500

config RT_LWIP_ETH_PAD_SIZE
    int 
    default 2

config RT_USING_UART1
    bool
    default y
```

## bsp/lm3s9b9x/Kconfig
```kconfig
mainmenu "RT-Thread Project Configuration"

BSP_DIR := .

RTT_DIR := ../..

PKGS_DIR := packages

ENV_DIR := /

source "$(RTT_DIR)/Kconfig"
osource "$PKGS_DIR/Kconfig"

config SOC_LM3S9B9X
    bool
    select ARCH_ARM_CORTEX_M3
    default y

config RT_LWIP_ETH_PAD_SIZE
    int 
    default 2

config RT_USING_UART1
    bool
    default y
```

## bsp/lm4f232/Kconfig
```kconfig
mainmenu "RT-Thread Configuration"

BSP_DIR := .

RTT_DIR := ../..

PKGS_DIR := packages

ENV_DIR := /

source "$(RTT_DIR)/Kconfig"
osource "$PKGS_DIR/Kconfig"

config SOC_LM4F232
    bool
    select ARCH_ARM_CORTEX_M4
    default y
```
