## bsp/n32/n32g45xcl-stb/board/Kconfig
```kconfig
menu "Hardware Drivers Config"

config SOC_SERIES_N32G45X
    bool
    default y

config SOC_N32G45X
    bool
    select SOC_SERIES_N32G45X
    select RT_USING_COMPONENTS_INIT
    select RT_USING_USER_MAIN
    default y

menu "Onboard Peripheral Drivers"

endmenu

menu "On-chip Peripheral Drivers"

    config BSP_USING_GPIO
        bool "Enable GPIO"
        select RT_USING_PIN
        default y

    menuconfig BSP_USING_UART
        bool "Enable UART"
        default y
        select RT_USING_SERIAL
        if BSP_USING_UART
            config BSP_USING_USART1
                bool "Enable USART1"
                default y

            config BSP_USING_USART2
                bool "Enable USART2"
                default n

            config BSP_USING_USART3
                bool "Enable USART3"
                default n

            config BSP_USING_UART4
                bool "Enable UART4"
                default n

            config BSP_USING_UART5
                bool "Enable UART5"
                default n

            config BSP_USING_UART6
                bool "Enable UART6"
                default n

        endif

    menuconfig BSP_USING_SPI
        bool "Enable SPI BUS"
        default n
        select RT_USING_SPI
        if BSP_USING_SPI
            config BSP_USING_SPI1
                bool "Enable SPI1 BUS"
                default n

            config BSP_USING_SPI2
                bool "Enable SPI2 BUS"
                default n

            config BSP_USING_SPI3
                bool "Enable SPI3 BUS"
                default n

        endif

    menuconfig BSP_USING_I2C1
        bool "Enable I2C1 BUS (software simulation)"
        default n
        select RT_USING_I2C
        select RT_USING_I2C_BITOPS
        select RT_USING_PIN
        if BSP_USING_I2C1
            config BSP_I2C1_SCL_PIN
                int "i2c1 scl pin number"
                range 0 111
                default 22
            config BSP_I2C1_SDA_PIN
                int "I2C1 sda pin number"
                range 0 111
                default 23
        endif

    menuconfig BSP_USING_RTC
        bool "Enable RTC"
        select RT_USING_RTC
        default n
        if BSP_USING_RTC
            choice
                prompt "Select clock source"
                default BSP_RTC_USING_LSE

                config BSP_RTC_USING_LSE
                    bool "RTC USING LSE"

                config BSP_RTC_USING_HSE
                    bool "RTC USING HSE"

                config BSP_RTC_USING_LSI
                    bool "RTC USING LSI"
            endchoice
        endif

    config BSP_USING_WDT
        bool "Enable Watchdog Timer"
        select RT_USING_WDT
        default n

    menuconfig BSP_USING_HWTIMER
        bool "Enable hwtimer"
        default n
        select RT_USING_HWTIMER
        if BSP_USING_HWTIMER
            config BSP_USING_HWTIMER1
                bool "using hwtimer1"
                default n
            config BSP_USING_HWTIMER2
                bool "using hwtimer2"
                default n
            config BSP_USING_HWTIMER3
                bool "using hwtimer3"
                default n
            config BSP_USING_HWTIMER4
                bool "using hwtimer4"
                default n
            config BSP_USING_HWTIMER5
                bool "using hwtimer5"
                default n
            config BSP_USING_HWTIMER6
                bool "using hwtimer6"
                default n
            config BSP_USING_HWTIMER7
                bool "using hwtimer7"
                default n
            config BSP_USING_HWTIMER8
                bool "using hwtimer8"
                default n
        endif

    menuconfig BSP_USING_ADC
        bool "Enable ADC"
        default n
        select RT_USING_ADC
        if BSP_USING_ADC
            config BSP_USING_ADC1
                bool "using adc1"
                default n
            config BSP_USING_ADC2
                bool "using adc2"
                default n
            config BSP_USING_ADC3
                bool "using adc3"
                default n
            config BSP_USING_ADC4
                bool "using adc4"
                default n
        endif

    menuconfig BSP_USING_DAC
        bool "Enable DAC"
        default n
        select RT_USING_DAC
        if BSP_USING_DAC
            config BSP_USING_DAC1
                bool "using dac1"
                default n
            config BSP_USING_DAC2
                bool "using dac2"
                default n
        endif

    menuconfig BSP_USING_CAN
        bool "Enable CAN"
        default n
        select RT_USING_CAN
        if BSP_USING_CAN
            config BSP_USING_CAN1
                bool "using can1"
                default n
            config BSP_USING_CAN2
                bool "using can2"
                default n
        endif
    #-----------------------------PWM----------------------------------
    menuconfig BSP_USING_PWM
        bool "Enable  PWM"
        default n
        select RT_USING_PWM
        select RT_USING_HWTIMER
        if BSP_USING_PWM
        menuconfig BSP_USING_TIM1_PWM
            bool "Enable TIM1 output PWM"
            default n
            # --------------selcet remap-----------------
            if BSP_USING_TIM1_PWM
                choice
                    prompt "Select Pin"
                    default TIM1_REMAP_0
                    config TIM1_REMAP_0
                        bool "PA8 PA9 PA10 PA11"
                    config TIM1_REMAP_3
                        bool "PE9 PE11 PE13 PE14"
                endchoice
                # -----------tim chanle enable-----------------
                config BSP_USING_TIM1_PWM_CH1
                    bool "Enable TIM1 CH1"
                    default n
                config BSP_USING_TIM1_PWM_CH2
                    bool "Enable TIM1 CH2"
                    default n
                config BSP_USING_TIM1_PWM_CH3
                    bool "Enable TIM1 CH3"
                    default n
                config BSP_USING_TIM1_PWM_CH4
                    bool "Enable TIM1 CH4"
                    default n
            endif
        

        menuconfig BSP_USING_TIM2_PWM
            bool "Enable TIM2 output PWM"
            default n
            if BSP_USING_TIM2_PWM
                 choice
                    prompt "Select Pin"
                    default TIM2_REMAP_0
                    config TIM2_REMAP_0
                        bool "PA0 PA1 PA2 PA3"
                     config TIM2_REMAP_1
                        bool "PA15 PB3 PA2 PA3"
                     config TIM2_REMAP_2
                        bool "PA0 PA1 PB10 PB11"
                    config TIM2_REMAP_3
                        bool "PA15 PB3 PB10 PB11"
                endchoice

                config BSP_USING_TIM2_PWM_CH0
                    bool "Enable TIM2 CH1"
                    default n
                config BSP_USING_TIM2_PWM_CH1
                    bool "Enable TIM2 CH2"
                    default n
                config BSP_USING_TIM2_PWM_CH2
                    bool "Enable TIM2 CH3"
                    default n
                config BSP_USING_TIM2_PWM_CH3
                    bool "Enable TIM2 CH4"
                    default n
            endif

            menuconfig BSP_USING_TIM3_PWM
            bool "Enable TIM3 output PWM"
            default n
            if BSP_USING_TIM3_PWM
                 choice
                    prompt "Select Pin"
                    default TIM3_REMAP_0
                    config TIM3_REMAP_0
                        bool "PA6 PA7 PB0 PB1"
                    config TIM3_REMAP_2
                        bool "PB4 PB5 PB0 PB1"
                    config TIM3_REMAP_3
                        bool "PC6 PC7 PC8 PC9"
                endchoice

                config BSP_USING_TIM3_PWM_CH0
                    bool "Enable TIM3 CH1"
                    default n
                config BSP_USING_TIM3_PWM_CH1
                    bool "Enable TIM3 CH2"
                    default n
                config BSP_USING_TIM3_PWM_CH2
                    bool "Enable TIM3 CH3"
                    default n
                config BSP_USING_TIM3_PWM_CH3
                    bool "Enable TIM3 CH4"
                    default n
            endif#BSP_USING_TIM3_PWM
            
        endif#BSP_USING_PWM
    rsource "../../libraries/n32_drivers/Kconfig"

endmenu

menu "Board extended module Drivers"

endmenu

endmenu
```
