/*
 * Copyright (c) 2006-2021, RT-Thread Development Team
 *
 * SPDX-License-Identifier: Apache-2.0
 *
 * Change Logs:
 * Date           Author            Notes
 * 2021-09-24     iysheng           the first version
 */

#include "_gd32_pinmux.h"

static struct _gd32_pinmux_map gs_gd32f2xx_map = {
    /* 0 1 2 3
     * 4 5 6 7
     * 8 9 a b
     * c d e f */
    {{{PINMUX_DEFAULT, PINMUX_DEFAULT, PINMUX_DEFAULT, PINMUX_DEFAULT,
     PINMUX_DEFAULT, PINMUX_DEFAULT, PINMUX_DEFAULT, PINMUX_DEFAULT,
     PINMUX_DEFAULT, GPIO_MODE_AF_PP, GPIO_MODE_IN_FLOATING, PINMUX_DEFAULT,
     PINMUX_DEFAULT, PINMUX_DEFAULT, PINMUX_DEFAULT, PINMUX_DEFAULT},
     GPIOA, RCU_GPIOA}, /* GPIOA */
    {{PINMUX_DEFAULT, PINMUX_DEFAULT, PINMUX_DEFAULT, PINMUX_DEFAULT,
     PINMUX_DEFAULT, PINMUX_DEFAULT, PINMUX_DEFAULT, PINMUX_DEFAULT,
     PINMUX_DEFAULT, PINMUX_DEFAULT, PINMUX_DEFAULT, PINMUX_DEFAULT,
     PINMUX_DEFAULT, PINMUX_DEFAULT, PINMUX_DEFAULT, GPIO_MODE_OUT_PP},
     GPIOB, RCU_GPIOB}, /* GPIOB */
    {{PINMUX_DEFAULT, PINMUX_DEFAULT, PINMUX_DEFAULT, PINMUX_DEFAULT,
     PINMUX_DEFAULT, PINMUX_DEFAULT, PINMUX_DEFAULT, PINMUX_DEFAULT,
     PINMUX_DEFAULT, PINMUX_DEFAULT, PINMUX_DEFAULT, PINMUX_DEFAULT,
     PINMUX_DEFAULT, PINMUX_DEFAULT, PINMUX_DEFAULT, PINMUX_DEFAULT,
    }, GPIOC, RCU_GPIOC}, /* GPIOC */
    {{PINMUX_DEFAULT, PINMUX_DEFAULT, PINMUX_DEFAULT, PINMUX_DEFAULT,
     PINMUX_DEFAULT, PINMUX_DEFAULT, PINMUX_DEFAULT, PINMUX_DEFAULT,
     PINMUX_DEFAULT, PINMUX_DEFAULT, PINMUX_DEFAULT, PINMUX_DEFAULT,
     PINMUX_DEFAULT, PINMUX_DEFAULT, PINMUX_DEFAULT, PINMUX_DEFAULT,
    }, GPIOD, RCU_GPIOD}, /* GPIOD */
    {{PINMUX_DEFAULT, PINMUX_DEFAULT, PINMUX_DEFAULT, PINMUX_DEFAULT,
     PINMUX_DEFAULT, PINMUX_DEFAULT, PINMUX_DEFAULT, PINMUX_DEFAULT,
     PINMUX_DEFAULT, PINMUX_DEFAULT, PINMUX_DEFAULT, PINMUX_DEFAULT,
     PINMUX_DEFAULT, PINMUX_DEFAULT, PINMUX_DEFAULT, PINMUX_DEFAULT,
    }, GPIOE, RCU_GPIOE}, /* GPIOE */
    {{PINMUX_DEFAULT, PINMUX_DEFAULT, PINMUX_DEFAULT, PINMUX_DEFAULT,
     PINMUX_DEFAULT, PINMUX_DEFAULT, PINMUX_DEFAULT, PINMUX_DEFAULT,
     PINMUX_DEFAULT, PINMUX_DEFAULT, PINMUX_DEFAULT, PINMUX_DEFAULT,
     PINMUX_DEFAULT, PINMUX_DEFAULT, PINMUX_DEFAULT, PINMUX_DEFAULT,
    }, GPIOF, RCU_GPIOF}, /* GPIOF */
    {{PINMUX_DEFAULT, PINMUX_DEFAULT, PINMUX_DEFAULT, PINMUX_DEFAULT,
     PINMUX_DEFAULT, PINMUX_DEFAULT, PINMUX_DEFAULT, PINMUX_DEFAULT,
     PINMUX_DEFAULT, PINMUX_DEFAULT, PINMUX_DEFAULT, PINMUX_DEFAULT,
     PINMUX_DEFAULT, PINMUX_DEFAULT, PINMUX_DEFAULT, PINMUX_DEFAULT,
    }, GPIOG, RCU_GPIOG}, /* GPIOG */
    {{PINMUX_DEFAULT, PINMUX_DEFAULT, PINMUX_DEFAULT, PINMUX_DEFAULT,
     PINMUX_DEFAULT, PINMUX_DEFAULT, PINMUX_DEFAULT, PINMUX_DEFAULT,
     PINMUX_DEFAULT, PINMUX_DEFAULT, PINMUX_DEFAULT, PINMUX_DEFAULT,
     PINMUX_DEFAULT, PINMUX_DEFAULT, PINMUX_DEFAULT, PINMUX_DEFAULT,
    }, GPIOH, RCU_GPIOH}, /* GPIOH */
    {{PINMUX_DEFAULT, PINMUX_DEFAULT, PINMUX_DEFAULT, PINMUX_DEFAULT,
     PINMUX_DEFAULT, PINMUX_DEFAULT, PINMUX_DEFAULT, PINMUX_DEFAULT,
     PINMUX_DEFAULT, PINMUX_DEFAULT, PINMUX_DEFAULT, PINMUX_DEFAULT,
     PINMUX_DEFAULT, PINMUX_DEFAULT, PINMUX_DEFAULT, PINMUX_DEFAULT,
    }, GPIOI, RCU_GPIOI}, /* GPIOI */
    },
};

/**
  * @brief Init pin mux config
  * retval .
  */
static int gd32f2xx_pinmux_init(void)
{
    int port_index = 0, pin_index = 0;

    for (; port_index < MAX_PORT_COUNTS; port_index++)
    {
        for (pin_index = 0; pin_index < MAX_PIN_COUNTS_1PORT; pin_index++)
        {
            if (gs_gd32f2xx_map.port[port_index].pin_mode[pin_index] != PINMUX_DEFAULT)
            {
                if (PORT_CLK_STATE_DISABLE == gs_gd32f2xx_map.port_clk_state[port_index])
                {
                    rcu_periph_clock_enable(gs_gd32f2xx_map.port[port_index].port_clk);
                    gs_gd32f2xx_map.port_clk_state[port_index] = PORT_CLK_STATE_ENABLE;
                }
                gpio_init(gs_gd32f2xx_map.port[port_index].port_base,
                    gs_gd32f2xx_map.port[port_index].pin_mode[pin_index] ,
                    GPIO_OSPEED_50MHZ, BIT(pin_index));
            }
            else
            {
                continue;
            }
        }
    }

    return 0;
}
INIT_BOARD_EXPORT(gd32f2xx_pinmux_init);
