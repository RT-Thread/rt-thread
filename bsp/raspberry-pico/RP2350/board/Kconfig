## bsp/renesas/ebf_qi_min_6m5/board/Kconfig
```kconfig
menu "Hardware Drivers Config"

    config SOC_R7FA6M5BH
        bool
        select SOC_SERIES_R7FA6M5
        select RT_USING_COMPONENTS_INIT
        select RT_USING_USER_MAIN
        default y

    menu "Onboard Peripheral Drivers"

    endmenu

    menu "On-chip Peripheral Drivers"

        source "../libraries/HAL_Drivers/Kconfig"

        menuconfig BSP_USING_UART
            bool "Enable UART"
            default y
            select RT_USING_SERIAL
            select RT_USING_SERIAL_V2
            if BSP_USING_UART

                menuconfig BSP_USING_UART4
                    bool "Enable UART4"
                    default n
                    if BSP_USING_UART4
                        config BSP_UART0_RX_USING_DMA
                            bool "Enable UART4 RX DMA"
                            depends on BSP_USING_UART4 && RT_SERIAL_USING_DMA
                            default n

                        config BSP_UART4_TX_USING_DMA
                            bool "Enable UART4 TX DMA"
                            depends on BSP_USING_UART4 && RT_SERIAL_USING_DMA
                            default n

                        config BSP_UART4_RX_BUFSIZE
                            int "Set UART4 RX buffer size"
                            range 64 65535
                            depends on RT_USING_SERIAL_V2
                            default 256

                        config BSP_UART4_TX_BUFSIZE
                            int "Set UART4 TX buffer size"
                            range 0 65535
                            depends on RT_USING_SERIAL_V2
                            default 0
                    endif
            endif

        menuconfig BSP_USING_I2C
            bool "Enable I2C BUS"
            default n
            select RT_USING_I2C
            select RT_USING_I2C_BITOPS
            select RT_USING_PIN
            if BSP_USING_I2C
                menuconfig BSP_USING_SCI_I2C
                    bool "Enable SCI I2C BUS"
                    default n
                    if BSP_USING_SCI_I2C
                        config BSP_USING_SCI_I2C0
                            bool "Enable SCI I2C0 BUS"
                            default n
                        config BSP_USING_SCI_I2C1
                            bool "Enable SCI I2C1 BUS"
                            default n
                        config BSP_USING_SCI_I2C2
                            bool "Enable SCI I2C2 BUS"
                            default n
                        config BSP_USING_SCI_I2C3
                            bool "Enable SCI I2C3 BUS"
                            default n
                        config BSP_USING_SCI_I2C4
                            bool "Enable SCI I2C4 BUS"
                            default n
                        config BSP_USING_SCI_I2C5
                            bool "Enable SCI I2C5 BUS"
                            default n
                        config BSP_USING_SCI_I2C6
                            bool "Enable SCI I2C6 BUS"
                            default n
                        config BSP_USING_SCI_I2C7
                            bool "Enable SCI I2C7 BUS"
                            default n
                        config BSP_USING_SCI_I2C8
                            bool "Enable SCI I2C8 BUS"
                            default n
                        config BSP_USING_SCI_I2C9
                            bool "Enable SCI I2C9 BUS"
                            default n
                    endif
                config BSP_USING_HW_I2C
                    bool "Enable Hardware I2C BUS"
                    default n
                if BSP_USING_HW_I2C
                    config BSP_USING_HW_I2C1
                        bool "Enable Hardware I2C1 BUS"
                        default n
                endif
                if !BSP_USING_HW_I2C
                    menuconfig BSP_USING_I2C1
                        bool "Enable I2C1 BUS (software simulation)"
                        default n
                        if BSP_USING_I2C1
                            config BSP_I2C1_SCL_PIN
                                hex "i2c1 scl pin number"
                                range 0x0000 0x0B0F
                                default 0x050C
                            config BSP_I2C1_SDA_PIN
                                hex "I2C1 sda pin number"
                                range 0x0000 0x0B0F
                                default 0x050B
                        endif
                endif
            endif

        menuconfig BSP_USING_SCI_SPI
            bool "Enable SCI SPI BUS"
            default n
            select RT_USING_SPI
            if BSP_USING_SCI_SPI 
                config BSP_USING_SCI_SPI0
                    bool "Enable SCI SPI0 BUS"
                    default n
                config BSP_USING_SCI_SPI1
                    bool "Enable SCI SPI1 BUS"
                    default n
                config BSP_USING_SCI_SPI2
                    bool "Enable SCI SPI2 BUS"
                    default n
                config BSP_USING_SCI_SPI3
                    bool "Enable SCI SPI3 BUS"
                    default n
                config BSP_USING_SCI_SPI5
                    bool "Enable SCI SPI5 BUS"
                    default n
                config BSP_USING_SCI_SPI6
                    bool "Enable SCI SPI6 BUS"
                    default n
            endif

        menuconfig BSP_USING_SPI
            bool "Enable SPI BUS"
            default n
            select RT_USING_SPI
            if BSP_USING_SPI 
                config BSP_USING_SPI0
                    bool "Enable SPI0 BUS"
                    default n
                config BSP_USING_SPI1
                    bool "Enable SPI1 BUS"
                    default n
            endif

    endmenu

    menu "Board extended module Drivers"

    endmenu
endmenu
```

## bsp/renesas/libraries/HAL_Drivers/drivers/Kconfig
```kconfig
config BSP_USING_GPIO
    bool "Enable GPIO"
    select RT_USING_PIN
    default y

config BSP_USING_ONCHIP_FLASH
    bool "Enable Onchip FLASH"
    default n

config BSP_USING_WDT
    bool "Enable Watchdog Timer"
    select RT_USING_WDT
    default n

menuconfig BSP_USING_ONCHIP_RTC
    bool "Enable RTC"
    select RT_USING_RTC
    default n
    if BSP_USING_ONCHIP_RTC
    endif
```

## bsp/renesas/libraries/Kconfig
```kconfig
config SOC_FAMILY_RENESAS_RA
    bool
    default n

config SOC_FAMILY_RENESAS_RZ
    bool
    default n

config SOC_SERIES_R7FA6M3
    bool
    select ARCH_ARM_CORTEX_M4
    select SOC_FAMILY_RENESAS_RA
    default n

config SOC_SERIES_R7FA6M4
    bool
    select ARCH_ARM_CORTEX_M4
    select SOC_FAMILY_RENESAS_RA
    default n

config SOC_SERIES_R7FA2E2
    bool
    select ARCH_ARM_CORTEX_M23
    select SOC_FAMILY_RENESAS_RA
    default n

config SOC_SERIES_R7FA2L1
    bool
    select ARCH_ARM_CORTEX_M23
    select SOC_FAMILY_RENESAS_RA
    default n

config SOC_SERIES_R7FA6M5
    bool
    select ARCH_ARM_CORTEX_M33
    select SOC_FAMILY_RENESAS_RA
    default n

config SOC_SERIES_R7FA4E2
    bool
    select ARCH_ARM_CORTEX_M33
    select SOC_FAMILY_RENESAS_RA
    default n

config SOC_SERIES_R7FA4M1
    bool
    select ARCH_ARM_CORTEX_M4
    select SOC_FAMILY_RENESAS_RA
    default n

config SOC_SERIES_R7FA4M2
    bool
    select ARCH_ARM_CORTEX_M4
    select SOC_FAMILY_RENESAS_RA
    default n

config SOC_SERIES_R7FA8M85
    bool
    select ARCH_ARM_CORTEX_M85
    select SOC_FAMILY_RENESAS_RA
    default n

config SOC_SERIES_R9A07G0
    bool
    select ARCH_ARM_CORTEX_R52
    select SOC_FAMILY_RENESAS_RZ
    default n

config SOC_SERIES_R7FA6E2
    bool
    select ARCH_ARM_CORTEX_M33
    select SOC_FAMILY_RENESAS_RA
    default n

config SOC_SERIES_R7FA2A1
    bool
    select ARCH_ARM_CORTEX_M23
    select SOC_FAMILY_RENESAS_RA
    default n

if RT_USING_NANO
choice
prompt "Choice nano console device(Renesas)"
default RT_NANO_CONSOLE_UART0
depends on RT_USING_CONSOLE
config RT_NANO_CONSOLE_UART0
    bool "UART0"
config RT_NANO_CONSOLE_UART1
    bool "UART1"
config RT_NANO_CONSOLE_UART2
    bool "UART2"
config RT_NANO_CONSOLE_UART3
    bool "UART3"
config RT_NANO_CONSOLE_UART4
    bool "UART4"
config RT_NANO_CONSOLE_UART5
    bool "UART5"
config RT_NANO_CONSOLE_UART6
    bool "UART6"
config RT_NANO_CONSOLE_UART7
    bool "UART7"
config RT_NANO_CONSOLE_UART8
    bool "UART8"
config RT_NANO_CONSOLE_UART9
    bool "UART9"
endchoice
endif
```

## bsp/renesas/ra2a1-ek/Kconfig
```kconfig
mainmenu "RT-Thread Configuration"

BSP_DIR := .

RTT_DIR := ../../..

# you can change the RTT_ROOT default "../.." to your rtthread_root,
# example : default "F:/git_repositories/rt-thread"

PKGS_DIR := packages

ENV_DIR := /

config SOC_R7FA2A1AB
    bool
    select SOC_SERIES_R7FA2A1
    select RT_USING_COMPONENTS_INIT
    select RT_USING_USER_MAIN
    default y

source "$(RTT_DIR)/Kconfig"
osource "$PKGS_DIR/Kconfig"
rsource "../libraries/Kconfig"

if !RT_USING_NANO
rsource "$(BSP_DIR)/board/Kconfig"
endif
```
