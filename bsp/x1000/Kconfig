## bsp/zynqmp-a53-dfzu2eg/Kconfig
```kconfig
mainmenu "RT-Thread Project Configuration"

BSP_DIR := .

RTT_DIR := ../../

PKGS_DIR := packages

SOC_DM_RTC_DIR      := $(BSP_DIR)/drivers/rtc
SOC_DM_SERIAL_DIR   := $(BSP_DIR)/drivers/serial

source "$(RTT_DIR)/Kconfig"
osource "$PKGS_DIR/Kconfig"

config SOC_ZYNQMP_AARCH64
    bool
    select ARCH_ARMV8
    select RT_USING_COMPONENTS_INIT
    select RT_USING_USER_MAIN
    select ARCH_CPU_64BIT
    select RT_USING_CACHE
    select RT_USING_STDC_ATOMIC
    default y
```

## bsp/zynqmp-a53-dfzu2eg/drivers/Kconfig
```kconfig
menu "Hardware Drivers Config"
    config BSP_SUPPORT_FPU
        bool "Using Float"
        default y

    menuconfig BSP_USING_UART
        bool "Using UART"
        select RT_USING_SERIAL
        default y

        if BSP_USING_UART
            config BSP_USING_UART0
            bool "Enabel UART 0"
            default y
        endif

    config BSP_USING_GIC
        bool
        default y

    choice
        prompt "GIC Version"
        default BSP_USING_GICV2

        config BSP_USING_GICV2
            bool "GICv2"

        config BSP_USING_GICV3
            bool "GICv3"
    endchoice

endmenu
```

## bsp/zynqmp-a53-dfzu2eg/drivers/rtc/Kconfig
```kconfig
config RT_RTC_ZYNQMP
    bool "Xilinx Zynq Ultrascale+ MPSoC RTC"
    depends on RT_USING_RTC
    select RT_USING_ALARM
    default y
```
