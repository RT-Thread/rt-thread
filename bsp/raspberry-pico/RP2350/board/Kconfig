## bsp/renesas/ra6m3-ek/board/Kconfig
```kconfig
menu "Hardware Drivers Config"

    config SOC_R7FA6M4AF
        bool
        select SOC_SERIES_R7FA6M3
        select RT_USING_COMPONENTS_INIT
        select RT_USING_USER_MAIN
        default y

    menu "Onboard Peripheral Drivers"

        menuconfig BSP_USING_FS
            bool "Enable File System"
            select RT_USING_DFS
            default n

            if BSP_USING_FS
                config BSP_USING_SDCARD_FATFS
                    bool "Enable SDCARD (FATFS)"
                    select BSP_USING_SPI
                    select BSP_USING_SPI1
                    select RT_USING_SPI_MSD
                    select RT_USING_DFS_ELMFAT
                    default n
            endif

        config BSP_USING_SPI_LCD
            bool "Enable SPI LCD"
            select BSP_USING_GPIO
            select BSP_USING_SPI
            select BSP_USING_SPI0
            default n

        menuconfig BSP_USING_LVGL
            bool "Enable LVGL for LCD"
            select PKG_USING_LVGL
            default n
            if BSP_USING_LVGL
                config BSP_USING_LCD_ILI9431
                    bool "Enable LVGL for LCD_ILI9431"
                    select PKG_USING_ILI9341
                    select BSP_USING_SPI_LCD
                    default n

                config BSP_USING_LCD_RGB
                    bool "Enable LVGL for LCD_RGB565"
                    select BSP_USING_LCD
                    default n

                config BSP_USING_LVGL_DEMO
                    bool "Enable LVGL demo"
                    select PKG_USING_LV_MUSIC_DEMO
                    default y
            endif

    endmenu

    menu "On-chip Peripheral Drivers"

        rsource "../../libraries/HAL_Drivers/Kconfig"

        menuconfig BSP_USING_UART
            bool "Enable UART"
            default y
            select RT_USING_SERIAL
            select RT_USING_SERIAL_V2
            if BSP_USING_UART
                menuconfig BSP_USING_UART7
                    bool "Enable UART7"
                    default n
                    if BSP_USING_UART7
                        config BSP_UART7_RX_USING_DMA
                            bool "Enable UART7 RX DMA"
                            depends on BSP_USING_UART7 && RT_SERIAL_USING_DMA
                            default n

                        config BSP_UART7_TX_USING_DMA
                            bool "Enable UART7 TX DMA"
                            depends on BSP_USING_UART7 && RT_SERIAL_USING_DMA
                            default n

                        config BSP_UART7_RX_BUFSIZE
                            int "Set UART7 RX buffer size"
                            range 64 65535
                            depends on RT_USING_SERIAL_V2
                            default 256

                        config BSP_UART7_TX_BUFSIZE
                            int "Set UART7 TX buffer size"
                            range 0 65535
                            depends on RT_USING_SERIAL_V2
                            default 0
                    endif
            endif

        menuconfig BSP_USING_HW_I2C
            bool "Enable hardware I2C BUS"
            default n
            if BSP_USING_HW_I2C
                config BSP_USING_HW_I2C0
                    bool "Enable Hardware I2C0 BUS"
                    default n
            endif

        menuconfig BSP_USING_SOFT_I2C
            bool "Enable software I2C bus"
            select RT_USING_I2C
            select RT_USING_I2C_BITOPS
            select RT_USING_PIN
            default n
            if BSP_USING_SOFT_I2C
                config BSP_USING_SOFT_I2C
                menuconfig BSP_USING_I2C1
                    bool "Enable I2C1 Bus (software simulation)"
                    default n
                    if BSP_USING_I2C1
                        comment "Please refer to the 'bsp_io.h' file to configure the pins"
                        config BSP_I2C1_SCL_PIN
                            hex "i2c1 scl pin number (hex)"
                            range 0x0000 0xFFFF
                            default 0x050C
                        config BSP_I2C1_SDA_PIN
                            hex "i2c1 sda pin number (hex)"
                            range 0x0000 0xFFFF
                            default 0x050B
                    endif
            endif

        menuconfig BSP_USING_PWM
            bool "Enable PWM"
            default n
            select RT_USING_PWM
            if BSP_USING_PWM
                config BSP_USING_PWM12
                    bool "Enable GPT12 (16-Bits) output PWM"
                    default n
            endif

        menuconfig BSP_USING_TIM
        bool "Enable timer"
        default n
        select RT_USING_HWTIMER
        if BSP_USING_TIM
            config BSP_USING_TIM0
                bool "Enable TIM0"
                default n
            config BSP_USING_TIM1
                bool "Enable TIM1"
                default n
        endif

        menuconfig BSP_USING_SPI
            bool "Enable SPI BUS"
            default n
            select RT_USING_SPI
            if BSP_USING_SPI 
                config BSP_USING_SPI0
                    bool "Enable SPI0 BUS"
                    default n
                config BSP_USING_SPI1
                    bool "Enable SPI1 BUS"
                    default n
            endif

        config BSP_USING_ETH
            bool "Enable Ethernet"
            select RT_USING_SAL
            select RT_USING_LWIP
            select RT_USING_NETDEV
            default n

        config BSP_USING_LCD
            bool "Enable LCD"
            select BSP_USING_GPIO
            default n

        menuconfig BSP_USING_SCI
            bool "Enable SCI Controller"
            default n
            config BSP_USING_SCIn_SPI
                bool
                depends on BSP_USING_SCI
                select RT_USING_SPI
                default n

            config BSP_USING_SCIn_I2C
                bool
                depends on BSP_USING_SCI
                select RT_USING_I2C
                default n

            config BSP_USING_SCIn_UART
                bool
                depends on BSP_USING_SCI
                select RT_USING_SERIAL
                select RT_USING_SERIAL_V2
                default n

            if BSP_USING_SCI
                config BSP_USING_SCI0
                    bool "Enable SCI0"
                    default n
                    if BSP_USING_SCI0
                        choice
                        prompt "choice sci mode"
                        default BSP_USING_SCI0_SPI
                        config BSP_USING_SCI0_SPI
                            select BSP_USING_SCIn_SPI
                            bool "SPI mode"
                        config BSP_USING_SCI0_I2C
                            select BSP_USING_SCIn_I2C
                            bool "I2C mode"
                        config BSP_USING_SCI0_UART
                            select BSP_USING_SCIn_UART
                            bool "UART mode"
                        endchoice
                        if BSP_USING_SCI0_UART
                            config BSP_SCI0_UART_RX_BUFSIZE
                                int "Set UART0 RX buffer size"
                                range 64 65535
                                depends on RT_USING_SERIAL_V2
                                default 256

                            config BSP_SCI0_UART_TX_BUFSIZE
                                int "Set UART0 TX buffer size"
                                range 0 65535
                                depends on RT_USING_SERIAL_V2
                                default 0
                        endif
                    endif
                config BSP_USING_SCI1
                    bool "Enable SCI1"
                    default n
                    if BSP_USING_SCI1
                        choice
                        prompt "choice sci mode"
                        default BSP_USING_SCI1_SPI
                        config BSP_USING_SCI1_SPI
                            select BSP_USING_SCIn_SPI
                            bool "SPI mode"
                        config BSP_USING_SCI1_I2C
                            select BSP_USING_SCIn_I2C
                            bool "I2C mode"
                        config BSP_USING_SCI1_UART
                            select BSP_USING_SCIn_UART
                            bool "UART mode"
                        endchoice
                        if BSP_USING_SCI1_UART
                            config BSP_SCI1_UART_RX_BUFSIZE
                                int "Set UART1 RX buffer size"
                                range 64 65535
                                depends on RT_USING_SERIAL_V2
                                default 256

                            config BSP_SCI1_UART_TX_BUFSIZE
                                int "Set UART1 TX buffer size"
                                range 0 65535
                                depends on RT_USING_SERIAL_V2
                                default 0
                        endif
                    endif
                config BSP_USING_SCI2
                    bool "Enable SCI2"
                    default n
                    if BSP_USING_SCI2
                        choice
                        prompt "choice sci mode"
                        default BSP_USING_SCI2_SPI
                        config BSP_USING_SCI2_SPI
                            select BSP_USING_SCIn_SPI
                            bool "SPI mode"
                        config BSP_USING_SCI2_I2C
                            select BSP_USING_SCIn_I2C
                            bool "I2C mode"
                        config BSP_USING_SCI2_UART
                            select BSP_USING_SCIn_UART
                            bool "UART mode"
                        endchoice
                        if BSP_USING_SCI2_UART
                            config BSP_SCI2_UART_RX_BUFSIZE
                                int "Set UART2 RX buffer size"
                                range 64 65535
                                depends on RT_USING_SERIAL_V2
                                default 256

                            config BSP_SCI2_UART_TX_BUFSIZE
                                int "Set UART2 TX buffer size"
                                range 0 65535
                                depends on RT_USING_SERIAL_V2
                                default 0
                        endif
                    endif
                config BSP_USING_SCI3
                    bool "Enable SCI3"
                    default n
                    if BSP_USING_SCI3
                        choice
                        prompt "choice sci mode"
                        default BSP_USING_SCI3_SPI
                        config BSP_USING_SCI3_SPI
                            select BSP_USING_SCIn_SPI
                            bool "SPI mode"
                        config BSP_USING_SCI3_I2C
                            select BSP_USING_SCIn_I2C
                            bool "I2C mode"
                        config BSP_USING_SCI3_UART
                            select BSP_USING_SCIn_UART
                            bool "UART mode"
                        endchoice
                        if BSP_USING_SCI3_UART
                            config BSP_SCI3_UART_RX_BUFSIZE
                                int "Set UART3 RX buffer size"
                                range 64 65535
                                depends on RT_USING_SERIAL_V2
                                default 256

                            config BSP_SCI3_UART_TX_BUFSIZE
                                int "Set UART3 TX buffer size"
                                range 0 65535
                                depends on RT_USING_SERIAL_V2
                                default 0
                        endif
                    endif
                config BSP_USING_SCI4
                    bool "Enable SCI4"
                    default n
                    if BSP_USING_SCI4
                        choice
                        prompt "choice sci mode"
                        default BSP_USING_SCI4_SPI
                        config BSP_USING_SCI4_SPI
                            select BSP_USING_SCIn_SPI
                            bool "SPI mode"
                        config BSP_USING_SCI4_I2C
                            select BSP_USING_SCIn_I2C
                            bool "I2C mode"
                        config BSP_USING_SCI4_UART
                            select BSP_USING_SCIn_UART
                            bool "UART mode"
                        endchoice
                        if BSP_USING_SCI4_UART
                            config BSP_SCI4_UART_RX_BUFSIZE
                                int "Set UART4 RX buffer size"
                                range 64 65535
                                depends on RT_USING_SERIAL_V2
                                default 256

                            config BSP_SCI4_UART_TX_BUFSIZE
                                int "Set UART4 TX buffer size"
                                range 0 65535
                                depends on RT_USING_SERIAL_V2
                                default 0
                        endif
                    endif
                config BSP_USING_SCI5
                    bool "Enable SCI5"
                    default n
                    if BSP_USING_SCI5
                        choice
                        prompt "choice sci mode"
                        default BSP_USING_SCI5_SPI
                        config BSP_USING_SCI5_SPI
                            select BSP_USING_SCIn_SPI
                            bool "SPI mode"
                        config BSP_USING_SCI5_I2C
                            select BSP_USING_SCIn_I2C
                            bool "I2C mode"
                        config BSP_USING_SCI5_UART
                            select BSP_USING_SCIn_UART
                            bool "UART mode"
                        endchoice
                        if BSP_USING_SCI5_UART
                            config BSP_SCI5_UART_RX_BUFSIZE
                                int "Set UART5 RX buffer size"
                                range 64 65535
                                depends on RT_USING_SERIAL_V2
                                default 256

                            config BSP_SCI5_UART_TX_BUFSIZE
                                int "Set UART5 TX buffer size"
                                range 0 65535
                                depends on RT_USING_SERIAL_V2
                                default 0
                        endif
                    endif
                config BSP_USING_SCI6
                    bool "Enable SCI6"
                    default n
                    if BSP_USING_SCI6
                        choice
                        prompt "choice sci mode"
                        default BSP_USING_SCI6_SPI
                        config BSP_USING_SCI6_SPI
                            select BSP_USING_SCIn_SPI
                            bool "SPI mode"
                        config BSP_USING_SCI6_I2C
                            select BSP_USING_SCIn_I2C
                            bool "I2C mode"
                        config BSP_USING_SCI6_UART
                            select BSP_USING_SCIn_UART
                            bool "UART mode"
                        endchoice
                        if BSP_USING_SCI6_UART
                            config BSP_SCI6_UART_RX_BUFSIZE
                                int "Set UART6 RX buffer size"
                                range 64 65535
                                depends on RT_USING_SERIAL_V2
                                default 256

                            config BSP_SCI6_UART_TX_BUFSIZE
                                int "Set UART6 TX buffer size"
                                range 0 65535
                                depends on RT_USING_SERIAL_V2
                                default 0
                        endif
                    endif
                config BSP_USING_SCI7
                    bool "Enable SCI7"
                    default n
                    if BSP_USING_SCI7
                        choice
                        prompt "choice sci mode"
                        default BSP_USING_SCI7_SPI
                        config BSP_USING_SCI7_SPI
                            select BSP_USING_SCIn_SPI
                            bool "SPI mode"
                        config BSP_USING_SCI7_I2C
                            select BSP_USING_SCIn_I2C
                            bool "I2C mode"
                        config BSP_USING_SCI7_UART
                            select BSP_USING_SCIn_UART
                            bool "UART mode"
                        endchoice
                        if BSP_USING_SCI7_UART
                            config BSP_SCI7_UART_RX_BUFSIZE
                                int "Set UART7 RX buffer size"
                                range 64 65535
                                depends on RT_USING_SERIAL_V2
                                default 256

                            config BSP_SCI7_UART_TX_BUFSIZE
                                int "Set UART7 TX buffer size"
                                range 0 65535
                                depends on RT_USING_SERIAL_V2
                                default 0
                        endif
                    endif
                config BSP_USING_SCI8
                    bool "Enable SCI8"
                    default n
                    if BSP_USING_SCI8
                        choice
                        prompt "choice sci mode"
                        default BSP_USING_SCI8_SPI
                        config BSP_USING_SCI8_SPI
                            select BSP_USING_SCIn_SPI
                            bool "SPI mode"
                        config BSP_USING_SCI8_I2C
                            select BSP_USING_SCIn_I2C
                            bool "I2C mode"
                        config BSP_USING_SCI8_UART
                            select BSP_USING_SCIn_UART
                            bool "UART mode"
                        endchoice
                        if BSP_USING_SCI8_UART
                            config BSP_SCI8_UART_RX_BUFSIZE
                                int "Set UART8 RX buffer size"
                                range 64 65535
                                depends on RT_USING_SERIAL_V2
                                default 256

                            config BSP_SCI8_UART_TX_BUFSIZE
                                int "Set UART8 TX buffer size"
                                range 0 65535
                                depends on RT_USING_SERIAL_V2
                                default 0
                        endif
                    endif
                config BSP_USING_SCI9
                    bool "Enable SCI9"
                    default n
                    if BSP_USING_SCI9
                        choice
                        prompt "choice sci mode"
                        default BSP_USING_SCI9_SPI
                        config BSP_USING_SCI9_SPI
                            select BSP_USING_SCIn_SPI
                            bool "SPI mode"
                        config BSP_USING_SCI9_I2C
                            select BSP_USING_SCIn_I2C
                            bool "I2C mode"
                        config BSP_USING_SCI9_UART
                            select BSP_USING_SCIn_UART
                            bool "UART mode"
                        endchoice
                        if BSP_USING_SCI9_UART
                            config BSP_SCI9_UART_RX_BUFSIZE
                                int "Set UART9 RX buffer size"
                                range 64 65535
                                depends on RT_USING_SERIAL_V2
                                default 256

                            config BSP_SCI9_UART_TX_BUFSIZE
                                int "Set UART9 TX buffer size"
                                range 0 65535
                                depends on RT_USING_SERIAL_V2
                                default 0
                        endif
                    endif
            endif

    endmenu

    menu "Board extended module Drivers"

    endmenu
endmenu
```
