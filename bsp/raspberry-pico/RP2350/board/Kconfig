## bsp/renesas/ra6m3-hmi-board/board/Kconfig
```kconfig
menu "Hardware Drivers Config"

    config SOC_R7FA6M4AF
        bool
        select SOC_SERIES_R7FA6M3
        select RT_USING_COMPONENTS_INIT
        select RT_USING_USER_MAIN
        default y

    menu "Onboard Peripheral Drivers"
        
        config BSP_USING_ARDUINO
            bool "Compatible with Arduino Ecosystem (RTduino)"
            select PKG_USING_RTDUINO
            select BSP_USING_UART4
            select BSP_USING_GPIO
            select BSP_USING_ADC
            select BSP_USING_ADC0
            select BSP_USING_PWM
            select BSP_USING_PWM0
            select BSP_USING_PWM2
            select BSP_USING_PWM8
            select BSP_USING_SOFT_I2C
            select BSP_USING_I2C0
            select BSP_USING_SOFT_SPI
            select BSP_USING_SOFT_SPI1
            select RTDUINO_USING_WIRE
            select RTDUINO_USING_SPI
            imply RTDUINO_USING_SERVO
            default n

        menuconfig BSP_USING_FS
            bool "Enable filesystem"
            default n
            if BSP_USING_FS
                config BSP_USING_SDCARD_FS
                    bool "Enable SDCARD filesystem"
                    select BSP_USING_SDHI
                    select BSP_USING_SDHI1
                    select RT_USING_DFS_ELMFAT
                    default n
                config BSP_USING_SPICARD_FS
                    bool "Enable SPI FLASH filesystem"
                    select BSP_USING_SCI
                    select BSP_USING_SCI7
                    select BSP_USING_SCI7_SPI
                    select RT_USING_SPI_MSD
                    select RT_USING_DFS_ELMFAT
                    default n
            endif

        config BSP_USING_SPI_LCD
            bool
            select BSP_USING_GPIO
            select BSP_USING_SPI
            select BSP_USING_SPI0
            default n

        config BSP_USING_LCD
            bool "Enable LCD-RGB565"
            select BSP_USING_GPIO
            select BSP_USING_LCD_PWM_BACKLIGHT
            default n

        menuconfig BSP_USING_LCD_PWM_BACKLIGHT
            bool "Use pwm to drive lcd backlight"
            default n
            select BSP_USING_PWM
            select BSP_USING_PWM5
            if BSP_USING_LCD_PWM_BACKLIGHT
                config LCD_PWM_DEV_NAME
                    string "lcd backlight pwm name"
                    default "pwm5"
            endif

        config BSP_USING_TOUCH
            bool "Enable Touch GT911"
            select RT_USING_TOUCH
            select RT_TOUCH_PIN_IRQ
            select BSP_USING_SOFT_I2C
            select BSP_USING_I2C1
            default n

        menuconfig BSP_USING_LVGL
            bool "Enable LVGL for LCD"
            select PKG_USING_LVGL
            default n
            if BSP_USING_LVGL      
                config BSP_USING_LCD_ILI9431
                    bool "Enable LVGL for LCD_ILI9431"
                    select PKG_USING_ILI9341
                    select BSP_USING_SPI_LCD
                    default n
                config BSP_USING_LCD_RGB
                    bool "Enable LVGL for LCD_RGB565"
                    select BSP_USING_LCD
                    select BSP_USING_TOUCH
                    default n
            endif

        menuconfig BSP_USING_LVGL_DEMO
            bool "Enable LVGL demo for LCD"
            select BSP_USING_LVGL
            select BSP_USING_LCD_RGB
            if BSP_USING_LVGL_DEMO
                config BSP_USING_LVGL_MUSIC_DEMO
                    bool "Enable LVGL music demo"
                    select PKG_USING_LV_MUSIC_DEMO
                    default n
                    help
                        Enable this option to include LVGL music demo. -- LVGL8.3.x
                
                config BSP_USING_LVGL_STRESS_DEMO
                    bool "Enable LVGL stress demo"
                    default n
                    depends on !BSP_USING_LVGL_MUSIC_DEMO
                    help
                        Enable this option to include LVGL stress demo. -- LVGL9.3.x
            endif
    endmenu

    menu "On-chip Peripheral Drivers"

        rsource "../../libraries/HAL_Drivers/Kconfig"

        menuconfig BSP_USING_UART
            bool "Enable UART"
            default y
            select RT_USING_SERIAL
            select RT_USING_SERIAL_V2
            if BSP_USING_UART
                menuconfig BSP_USING_UART4
                    bool "Enable UART4"
                    default n
                    if BSP_USING_UART4
                        config BSP_UART4_RX_USING_DMA
                            bool "Enable UART4 RX DMA"
                            depends on BSP_USING_UART4 && RT_SERIAL_USING_DMA
                            default n

                        config BSP_UART4_TX_USING_DMA
                            bool "Enable UART4 TX DMA"
                            depends on BSP_USING_UART4 && RT_SERIAL_USING_DMA
                            default n

                        config BSP_UART4_RX_BUFSIZE
                            int "Set UART4 RX buffer size"
                            range 64 65535
                            depends on RT_USING_SERIAL_V2
                            default 256

                        config BSP_UART4_TX_BUFSIZE
                            int "Set UART4 TX buffer size"
                            range 0 65535
                            depends on RT_USING_SERIAL_V2
                            default 0
                    endif
                menuconfig BSP_USING_UART9
                    bool "Enable UART9"
                    default n
                    if BSP_USING_UART9
                        config BSP_UART9_RX_USING_DMA
                            bool "Enable UART9 RX DMA"
                            depends on BSP_USING_UART9 && RT_SERIAL_USING_DMA
                            default n

                        config BSP_UART9_TX_USING_DMA
                            bool "Enable UART9 TX DMA"
                            depends on BSP_USING_UART9 && RT_SERIAL_USING_DMA
                            default n

                        config BSP_UART9_RX_BUFSIZE
                            int "Set UART9 RX buffer size"
                            range 64 65535
                            depends on RT_USING_SERIAL_V2
                            default 256

                        config BSP_UART9_TX_BUFSIZE
                            int "Set UART9 TX buffer size"
                            range 0 65535
                            depends on RT_USING_SERIAL_V2
                            default 0
                    endif
            endif

        menuconfig BSP_USING_SPI
            bool "Enable SPI BUS"
            default n
            select RT_USING_SPI
            if BSP_USING_SPI 
                config BSP_USING_SPI0
                    bool "Enable SPI0 BUS"
                    default n
                config BSP_USING_SPI1
                    bool "Enable SPI1 BUS"
                    default n
            endif

        menuconfig BSP_USING_SOFT_SPI
            bool "Enable soft SPI BUS"
            default n
            select RT_USING_PIN
            select RT_USING_SPI_BITOPS
            select RT_USING_SPI
            if BSP_USING_SOFT_SPI
                config BSP_USING_SOFT_SPI1
                    bool "Enable soft SPI1 BUS (software simulation)"
                    default n
                    if BSP_USING_SOFT_SPI1
                        comment "Please refer to the 'bsp_io.h' file to configure the pins"
                        config BSP_S_SPI1_SCK_PIN
                            hex "spi1 sck pin number (hex)"
                            range 0x0000 0xFFFF
                            default 0x0204
                        config BSP_S_SPI1_MOSI_PIN
                            hex "spi1 mosi pin number (hex)"
                            range 0x0000 0xFFFF
                            default 0x050C
                        config BSP_S_SPI1_MISO_PIN
                            hex "spi1 miso pin number (hex)"
                            range 0x0000 0xFFFF
                            default 0x050B
                    endif
            endif

        menuconfig BSP_USING_SOFT_I2C
            bool "Enable software I2C bus"
            select RT_USING_I2C
            select RT_USING_I2C_BITOPS
            select RT_USING_PIN
            default n
            if BSP_USING_SOFT_I2C
                config BSP_USING_SOFT_I2C
                menuconfig BSP_USING_I2C0
                    bool "Enable I2C0 Bus (software simulation)"
                    default n
                    if BSP_USING_I2C0
                        comment "Please refer to the 'bsp_io.h' file to configure the pins"
                        config BSP_I2C0_SCL_PIN
                            hex "i2c0 scl pin number (hex)"
                            range 0x0000 0xFFFF
                            default 0x202
                        config BSP_I2C0_SDA_PIN
                            hex "i2c0 sda pin number (hex)"
                            range 0x0000 0xFFFF
                            default 0x203
                    endif

                menuconfig BSP_USING_I2C1
                    bool "Enable I2C1 Bus (software simulation)"
                    default n
                    if BSP_USING_I2C1
                        comment "Please refer to the 'bsp_io.h' file to configure the pins"
                        config BSP_I2C1_SCL_PIN
                            hex "i2c1 scl pin number (hex)"
                            range 0x0000 0xFFFF
                            default 0x202
                        config BSP_I2C1_SDA_PIN
                            hex "i2c1 sda pin number (hex)"
                            range 0x0000 0xFFFF
                            default 0x203
                    endif
            endif

        menuconfig BSP_USING_ADC
            bool "Enable ADC"
            default n
            select RT_USING_ADC
            if BSP_USING_ADC
                config BSP_USING_ADC0
                    bool "Enable ADC0"
                    default n
            endif

        menuconfig BSP_USING_DAC
	        bool "Enable DAC"
	        default n
	        select RT_USING_DAC
	        if BSP_USING_DAC
	            config BSP_USING_DAC0
	                bool "Enable DAC0"
	                default n
	        endif

        menuconfig BSP_USING_PWM
            bool "Enable PWM"
            default n
            select RT_USING_PWM
            if BSP_USING_PWM
            config BSP_USING_PWM0
                bool "Enable GPT0 (32-Bits) output PWM"
                default n

            config BSP_USING_PWM2
                bool "Enable GPT2 (32-Bits) output PWM"
                default n

            config BSP_USING_PWM5
                bool "Enable GPT5 (32-Bits) output PWM"
                default n

            config BSP_USING_PWM8
                bool "Enable GPT8 (32-Bits) output PWM"
                default n

            endif

        menuconfig BSP_USING_SDHI
            bool "Enable SDHI"
            default n
            select RT_USING_SDIO
            select RT_USING_DFS
            select RT_LIBC_USING_FILEIO
            select RT_USING_POSIX_DEVIO
            if BSP_USING_SDHI
                menuconfig BSP_USING_SDHI0
                    bool "Enable SDHI0"
                    default n
                    if BSP_USING_SDHI0
                        config SDHI_USING_1_BIT
                            bool "Use 1-bit Mode(4-bit when disable)"
                            default y
                    endif

                menuconfig BSP_USING_SDHI1
                    bool "Enable SDHI1"
                    default n
                    if BSP_USING_SDHI1
                        config SDHI_USING_1_BIT
                            bool "Use 1-bit Mode(4-bit when disable)"
                            default y
                    endif
                endif

        menuconfig BSP_USING_CAN
            bool "Enable CAN"
            default n
            select RT_USING_CAN
            if BSP_USING_CAN
                config BSP_USING_CAN0
                    bool "Enable CAN0"
                    default n
            endif

        config BSP_USING_G2D
            bool
            default n

        config BSP_USING_JPEG
            bool
            default n

        config BSP_USING_ETH
            bool "Enable Ethernet"
            select RT_USING_SAL
            select RT_USING_LWIP
            select RT_USING_NETDEV
            default n

        menuconfig BSP_USING_SCI
            bool "Enable SCI Controller"
            default n
            config BSP_USING_SCIn_SPI
                bool
                depends on BSP_USING_SCI
                select RT_USING_SPI
                default n

            config BSP_USING_SCIn_I2C
                bool
                depends on BSP_USING_SCI
                select RT_USING_I2C
                default n

            config BSP_USING_SCIn_UART
                bool
                depends on BSP_USING_SCI
                select RT_USING_SERIAL
                select RT_USING_SERIAL_V2
                default n

            if BSP_USING_SCI
                config BSP_USING_SCI0
                    bool "Enable SCI0"
                    default n
                    if BSP_USING_SCI0
                        choice
                        prompt "choice sci mode"
                        default BSP_USING_SCI0_SPI
                        config BSP_USING_SCI0_SPI
                            select BSP_USING_SCIn_SPI
                            bool "SPI mode"
                        config BSP_USING_SCI0_I2C
                            select BSP_USING_SCIn_I2C
                            bool "I2C mode"
                        config BSP_USING_SCI0_UART
                            select BSP_USING_SCIn_UART
                            bool "UART mode"
                        endchoice
                        if BSP_USING_SCI0_UART
                            config BSP_SCI0_UART_RX_BUFSIZE
                                int "Set UART0 RX buffer size"
                                range 64 65535
                                depends on RT_USING_SERIAL_V2
                                default 256

                            config BSP_SCI0_UART_TX_BUFSIZE
                                int "Set UART0 TX buffer size"
                                range 0 65535
                                depends on RT_USING_SERIAL_V2
                                default 0
                        endif
                    endif
                config BSP_USING_SCI1
                    bool "Enable SCI1"
                    default n
                    if BSP_USING_SCI1
                        choice
                        prompt "choice sci mode"
                        default BSP_USING_SCI1_SPI
                        config BSP_USING_SCI1_SPI
                            select BSP_USING_SCIn_SPI
                            bool "SPI mode"
                        config BSP_USING_SCI1_I2C
                            select BSP_USING_SCIn_I2C
                            bool "I2C mode"
                        config BSP_USING_SCI1_UART
                            select BSP_USING_SCIn_UART
                            bool "UART mode"
                        endchoice
                        if BSP_USING_SCI1_UART
                            config BSP_SCI1_UART_RX_BUFSIZE
                                int "Set UART1 RX buffer size"
                                range 64 65535
                                depends on RT_USING_SERIAL_V2
                                default 256

                            config BSP_SCI1_UART_TX_BUFSIZE
                                int "Set UART1 TX buffer size"
                                range 0 65535
                                depends on RT_USING_SERIAL_V2
                                default 0
                        endif
                    endif
                config BSP_USING_SCI2
                    bool "Enable SCI2"
                    default n
                    if BSP_USING_SCI2
                        choice
                        prompt "choice sci mode"
                        default BSP_USING_SCI2_SPI
                        config BSP_USING_SCI2_SPI
                            select BSP_USING_SCIn_SPI
                            bool "SPI mode"
                        config BSP_USING_SCI2_I2C
                            select BSP_USING_SCIn_I2C
                            bool "I2C mode"
                        config BSP_USING_SCI2_UART
                            select BSP_USING_SCIn_UART
                            bool "UART mode"
                        endchoice
                        if BSP_USING_SCI2_UART
                            config BSP_SCI2_UART_RX_BUFSIZE
                                int "Set UART2 RX buffer size"
                                range 64 65535
                                depends on RT_USING_SERIAL_V2
                                default 256

                            config BSP_SCI2_UART_TX_BUFSIZE
                                int "Set UART2 TX buffer size"
                                range 0 65535
                                depends on RT_USING_SERIAL_V2
                                default 0
                        endif
                    endif
                config BSP_USING_SCI3
                    bool "Enable SCI3"
                    default n
                    if BSP_USING_SCI3
                        choice
                        prompt "choice sci mode"
                        default BSP_USING_SCI3_SPI
                        config BSP_USING_SCI3_SPI
                            select BSP_USING_SCIn_SPI
                            bool "SPI mode"
                        config BSP_USING_SCI3_I2C
                            select BSP_USING_SCIn_I2C
                            bool "I2C mode"
                        config BSP_USING_SCI3_UART
                            select BSP_USING_SCIn_UART
                            bool "UART mode"
                        endchoice
                        if BSP_USING_SCI3_UART
                            config BSP_SCI3_UART_RX_BUFSIZE
                                int "Set UART3 RX buffer size"
                                range 64 65535
                                depends on RT_USING_SERIAL_V2
                                default 256

                            config BSP_SCI3_UART_TX_BUFSIZE
                                int "Set UART3 TX buffer size"
                                range 0 65535
                                depends on RT_USING_SERIAL_V2
                                default 0
                        endif
                    endif
                config BSP_USING_SCI4
                    bool "Enable SCI4"
                    default n
                    if BSP_USING_SCI4
                        choice
                        prompt "choice sci mode"
                        default BSP_USING_SCI4_SPI
                        config BSP_USING_SCI4_SPI
                            select BSP_USING_SCIn_SPI
                            bool "SPI mode"
                        config BSP_USING_SCI4_I2C
                            select BSP_USING_SCIn_I2C
                            bool "I2C mode"
                        config BSP_USING_SCI4_UART
                            select BSP_USING_SCIn_UART
                            bool "UART mode"
                        endchoice
                        if BSP_USING_SCI4_UART
                            config BSP_SCI4_UART_RX_BUFSIZE
                                int "Set UART4 RX buffer size"
                                range 64 65535
                                depends on RT_USING_SERIAL_V2
                                default 256

                            config BSP_SCI4_UART_TX_BUFSIZE
                                int "Set UART4 TX buffer size"
                                range 0 65535
                                depends on RT_USING_SERIAL_V2
                                default 0
                        endif
                    endif
                config BSP_USING_SCI5
                    bool "Enable SCI5"
                    default n
                    if BSP_USING_SCI5
                        choice
                        prompt "choice sci mode"
                        default BSP_USING_SCI5_SPI
                        config BSP_USING_SCI5_SPI
                            select BSP_USING_SCIn_SPI
                            bool "SPI mode"
                        config BSP_USING_SCI5_I2C
                            select BSP_USING_SCIn_I2C
                            bool "I2C mode"
                        config BSP_USING_SCI5_UART
                            select BSP_USING_SCIn_UART
                            bool "UART mode"
                        endchoice
                        if BSP_USING_SCI5_UART
                            config BSP_SCI5_UART_RX_BUFSIZE
                                int "Set UART5 RX buffer size"
                                range 64 65535
                                depends on RT_USING_SERIAL_V2
                                default 256

                            config BSP_SCI5_UART_TX_BUFSIZE
                                int "Set UART5 TX buffer size"
                                range 0 65535
                                depends on RT_USING_SERIAL_V2
                                default 0
                        endif
                    endif
                config BSP_USING_SCI6
                    bool "Enable SCI6"
                    default n
                    if BSP_USING_SCI6
                        choice
                        prompt "choice sci mode"
                        default BSP_USING_SCI6_SPI
                        config BSP_USING_SCI6_SPI
                            select BSP_USING_SCIn_SPI
                            bool "SPI mode"
                        config BSP_USING_SCI6_I2C
                            select BSP_USING_SCIn_I2C
                            bool "I2C mode"
                        config BSP_USING_SCI6_UART
                            select BSP_USING_SCIn_UART
                            bool "UART mode"
                        endchoice
                        if BSP_USING_SCI6_UART
                            config BSP_SCI6_UART_RX_BUFSIZE
                                int "Set UART6 RX buffer size"
                                range 64 65535
                                depends on RT_USING_SERIAL_V2
                                default 256

                            config BSP_SCI6_UART_TX_BUFSIZE
                                int "Set UART6 TX buffer size"
                                range 0 65535
                                depends on RT_USING_SERIAL_V2
                                default 0
                        endif
                    endif
                config BSP_USING_SCI7
                    bool "Enable SCI7"
                    default n
                    if BSP_USING_SCI7
                        choice
                        prompt "choice sci mode"
                        default BSP_USING_SCI7_SPI
                        config BSP_USING_SCI7_SPI
                            select BSP_USING_SCIn_SPI
                            bool "SPI mode"
                        config BSP_USING_SCI7_I2C
                            select BSP_USING_SCIn_I2C
                            bool "I2C mode"
                        config BSP_USING_SCI7_UART
                            select BSP_USING_SCIn_UART
                            bool "UART mode"
                        endchoice
                        if BSP_USING_SCI7_UART
                            config BSP_SCI7_UART_RX_BUFSIZE
                                int "Set UART7 RX buffer size"
                                range 64 65535
                                depends on RT_USING_SERIAL_V2
                                default 256

                            config BSP_SCI7_UART_TX_BUFSIZE
                                int "Set UART7 TX buffer size"
                                range 0 65535
                                depends on RT_USING_SERIAL_V2
                                default 0
                        endif
                    endif
                config BSP_USING_SCI8
                    bool "Enable SCI8"
                    default n
                    if BSP_USING_SCI8
                        choice
                        prompt "choice sci mode"
                        default BSP_USING_SCI8_SPI
                        config BSP_USING_SCI8_SPI
                            select BSP_USING_SCIn_SPI
                            bool "SPI mode"
                        config BSP_USING_SCI8_I2C
                            select BSP_USING_SCIn_I2C
                            bool "I2C mode"
                        config BSP_USING_SCI8_UART
                            select BSP_USING_SCIn_UART
                            bool "UART mode"
                        endchoice
                        if BSP_USING_SCI8_UART
                            config BSP_SCI8_UART_RX_BUFSIZE
                                int "Set UART8 RX buffer size"
                                range 64 65535
                                depends on RT_USING_SERIAL_V2
                                default 256

                            config BSP_SCI8_UART_TX_BUFSIZE
                                int "Set UART8 TX buffer size"
                                range 0 65535
                                depends on RT_USING_SERIAL_V2
                                default 0
                        endif
                    endif
                config BSP_USING_SCI9
                    bool "Enable SCI9"
                    default n
                    if BSP_USING_SCI9
                        choice
                        prompt "choice sci mode"
                        default BSP_USING_SCI9_SPI
                        config BSP_USING_SCI9_SPI
                            select BSP_USING_SCIn_SPI
                            bool "SPI mode"
                        config BSP_USING_SCI9_I2C
                            select BSP_USING_SCIn_I2C
                            bool "I2C mode"
                        config BSP_USING_SCI9_UART
                            select BSP_USING_SCIn_UART
                            bool "UART mode"
                        endchoice
                        if BSP_USING_SCI9_UART
                            config BSP_SCI9_UART_RX_BUFSIZE
                                int "Set UART9 RX buffer size"
                                range 64 65535
                                depends on RT_USING_SERIAL_V2
                                default 256

                            config BSP_SCI9_UART_TX_BUFSIZE
                                int "Set UART9 TX buffer size"
                                range 0 65535
                                depends on RT_USING_SERIAL_V2
                                default 0
                        endif
                    endif
            endif

    endmenu

    menu "Board extended module Drivers"

        menuconfig BSP_USING_RW007
            bool "Enable RW007"
            default n
            select PKG_USING_RW007
            select BSP_USING_SCI
            select BSP_USING_SCI3
            select BSP_USING_SCI3_SPI
            select RT_USING_MEMPOOL
            select RW007_NOT_USE_EXAMPLE_DRIVERS
            
            if BSP_USING_RW007
                config RA_RW007_SPI_BUS_NAME
                    string "RW007 BUS NAME"
                    default "sci3s"

                config RA_RW007_CS_PIN
                    hex "(HEX)CS pin index"
                    default 0x0308

                config RA_RW007_BOOT0_PIN
                    hex "(HEX)BOOT0 pin index (same as spi clk pin)"
                    default 0x030B

                config RA_RW007_BOOT1_PIN
                    hex "(HEX)BOOT1 pin index (same as spi cs pin)"
                    default 0x0308

                config RA_RW007_INT_BUSY_PIN
                    hex "(HEX)INT/BUSY pin index"
                    default 0x000F

                config RA_RW007_RST_PIN
                    hex "(HEX)RESET pin index"
                    default 0x030C
            endif

    endmenu

endmenu
```
