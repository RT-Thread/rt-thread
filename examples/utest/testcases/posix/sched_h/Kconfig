## examples/utest/testcases/posix/sched_h/Kconfig
```kconfig
menuconfig RTT_POSIX_TESTCASE_SCHED_H
    bool "<sched.h>"
    default n

if RTT_POSIX_TESTCASE_SCHED_H

    # functions, TODO

endif
```

## examples/utest/testcases/posix/setjmp_h/Kconfig
```kconfig
menuconfig RTT_POSIX_TESTCASE_SETJMP_H
    bool "<setjmp.h>"
    default n

if RTT_POSIX_TESTCASE_SETJMP_H

    # functions, TODO

endif
```

## examples/utest/testcases/posix/signal_h/Kconfig
```kconfig
menuconfig RTT_POSIX_TESTCASE_SIGNAL_H
    bool "<signal.h>"
    default n

if RTT_POSIX_TESTCASE_SIGNAL_H

    config SIGNAL_H_SIGACTION
        bool "<signal.h> -> sigaction"
        default n

    config SIGNAL_H_SIGPROCMASK
        bool "<signal.h> -> sigprocmask"
        default n

    config SIGNAL_H_RAISE
        bool "<signal.h> -> raise"
        default n

    config SIGNAL_H_SIGNAL
        bool "<signal.h> -> signal"
        default n

endif
```

## examples/utest/testcases/posix/stdarg_h/Kconfig
```kconfig
menuconfig RTT_POSIX_TESTCASE_STDARG_H
    bool "<stdarg.h>"
    default n

if RTT_POSIX_TESTCASE_STDARG_H

    # functions, TODO

endif
```

## examples/utest/testcases/posix/stdio_h/Kconfig
```kconfig
menuconfig RTT_POSIX_TESTCASE_STDIO_H
    bool "<stdio.h>"
    default n

if RTT_POSIX_TESTCASE_STDIO_H

    config STDIO_H_CLEARERR
        bool "<stdio.h> -> clearerr"
        default n

    config STDIO_H_FCLOSE
        bool "<stdio.h> -> fclose"
        default n

    config STDIO_H_FDOPEN
        bool "<stdio.h> -> fdopen"
        default n

    config STDIO_H_FEOF
        bool "<stdio.h> -> feof"
        default n

    config STDIO_H_FERROR
        bool "<stdio.h> -> ferror"
        default n

    config STDIO_H_FFLUSH
        bool "<stdio.h> -> fflush"
        default n

    config STDIO_H_FGETC
        bool "<stdio.h> -> fgetc"
        default n

    config STDIO_H_FGETS
        bool "<stdio.h> -> fgets"
        default n

    config STDIO_H_FILENO
        bool "<stdio.h> -> fileno"
        default n

    config STDIO_H_FOPEN
        bool "<stdio.h> -> fopen"
        default n

    config STDIO_H_FPRINTF
        bool "<stdio.h> -> fprintf"
        default n

    config STDIO_H_FPUTC
        bool "<stdio.h> -> fputc"
        default n

    config STDIO_H_FPUTS
        bool "<stdio.h> -> fputs"
        default n

    config STDIO_H_FREAD
        bool "<stdio.h> -> fread"
        default n

    config STDIO_H_FSCANF
        bool "<stdio.h> -> fscanf"
        default n

    config STDIO_H_FSEEK
        bool "<stdio.h> -> fseek"
        default n

    config STDIO_H_FTELL
        bool "<stdio.h> -> ftell"
        default n

    config STDIO_H_FWRITE
        bool "<stdio.h> -> fwrite"
        default n



    config STDIO_H_PERROR
        bool "<stdio.h> -> perror"
        default n

    config STDIO_H_PRINTF
        bool "<stdio.h> -> printf"
        default n

    config STDIO_H_PUTC
        bool "<stdio.h> -> putc"
        default n

    config STDIO_H_PUTCHAR
        bool "<stdio.h> -> putchar"
        default n

    config STDIO_H_PUTS
        bool "<stdio.h> -> puts"
        default n

    config STDIO_H_REMOVE
        bool "<stdio.h> -> remove"
        default n

    config STDIO_H_RENAME
        bool "<stdio.h> -> rename"
        default n

    config STDIO_H_REWIND
        bool "<stdio.h> -> rewind"
        default n

    config STDIO_H_SETBUF
        bool "<stdio.h> -> setbuf"
        default n

    config STDIO_H_SETVBUF
        bool "<stdio.h> -> setvbuf"
        default n

    config STDIO_H_SNPRINTF
        bool "<stdio.h> -> snprintf"
        default n

    config STDIO_H_SPRINTF
        bool "<stdio.h> -> sprintf"
        default n

    config STDIO_H_SSCANF
        bool "<stdio.h> -> sscanf"
        default n

    config STDIO_H_VFPRINTF
        bool "<stdio.h> -> vfprintf"
        default n

    config STDIO_H_VPRINTF
        bool "<stdio.h> -> vprintf"
        default n

    config STDIO_H_VSNPRINTF
        bool "<stdio.h> -> vsnprintf"
        default n

    config STDIO_H_VSPRINTF
        bool "<stdio.h> -> vsprintf"
        default n

endif
```

## examples/utest/testcases/posix/stdlib_h/Kconfig
```kconfig
menuconfig RTT_POSIX_TESTCASE_STDLIB_H
    bool "<stdlib.h>"
    default n

if RTT_POSIX_TESTCASE_STDLIB_H

    config STDLIB_H_ATOI
        bool "<stdlib.h> -> atoi"
        default n

    config STDLIB_H_ATOL
        bool "<stdlib.h> -> atol"
        default n

    config STDLIB_H_QSORT
        bool "<stdlib.h> -> qsort"
        default n

    config STDLIB_H_STRTOL
        bool "<stdlib.h> -> strtol"
        default n

endif
```

## examples/utest/testcases/posix/string_h/Kconfig
```kconfig
menuconfig RTT_POSIX_TESTCASE_STRING_H
    bool "<string.h>"
    default n

if RTT_POSIX_TESTCASE_STRING_H

    # functions, TODO

endif
```

## examples/utest/testcases/posix/sys/mman_h/Kconfig
```kconfig
menuconfig RTT_POSIX_TESTCASE_SYS_MMAN_H
    bool "<sys/mman.h>"
    default n

if RTT_POSIX_TESTCASE_SYS_MMAN_H

    config MMAN_H_MLOCK
        bool "<sys/mman.h> -> mlock"
        default n

    config MMAN_H_MMAP
        bool "<sys/mman.h> -> mmap"
        default n

    config MMAN_H_MPROTECT
        bool "<sys/mman.h> -> mprotect"
        default n

    config MMAN_H_MSYNC
        bool "<sys/mman.h> -> msync"
        default n

    config MMAN_H_MUNLOCK
        bool "<sys/mman.h> -> munlock"
        default n

    config MMAN_H_MUNMAP
        bool "<sys/mman.h> -> munmap"
        default n

endif
```

## examples/utest/testcases/posix/sys/select_h/Kconfig
```kconfig
menuconfig RTT_POSIX_TESTCASE_SYS_SHM_H
    bool "<sys/shm.h>"
    default n

if RTT_POSIX_TESTCASE_SYS_SELECT_H

    config SELECT_H_SELECT
        bool "<sys/select.h> -> select"
        default n

endif
```

## examples/utest/testcases/posix/sys/shm_h/Kconfig
```kconfig
menuconfig RTT_POSIX_TESTCASE_SYS_SHM_H
    bool "<sys/shm.h>"
    default n

if RTT_POSIX_TESTCASE_SYS_SHM_H

    # functions, TODO

endif
```

## examples/utest/testcases/posix/sys/socket_h/Kconfig
```kconfig
menuconfig RTT_POSIX_TESTCASE_SYS_SOCKET_H
    bool "<sys/shm.h>"
    default n

if RTT_POSIX_TESTCASE_SYS_SOCKET_H

    config SOCKET_H_SELECT
        bool "<sys/socket.h> -> socket, accept, listen...."
        default n

endif
```

## examples/utest/testcases/posix/sys/stat_h/Kconfig
```kconfig
menuconfig RTT_POSIX_TESTCASE_SYS_STAT_H
    bool "<sys/shm.h>"
    default n

if RTT_POSIX_TESTCASE_SYS_STAT_H

    config STAT_H_CHMOD
        bool "<sys/stat.h> -> chmod"
        default n

    config STAT_H_FCHMOD
        bool "<sys/stat.h> -> fchmod"
        default n

    config STAT_H_FSTAT
        bool "<sys/stat.h> -> fstat"
        default n

    config STAT_H_LSTAT
        bool "<sys/stat.h> -> lstat"
        default n

endif
```

## examples/utest/testcases/posix/sys/statvfs_h/Kconfig
```kconfig
menuconfig RTT_POSIX_TESTCASE_SYS_STATVFS_H
    bool "<sys/shm.h>"
    default n

if RTT_POSIX_TESTCASE_SYS_STATVFS_H

    config STATVFS_H_STATVFS
        bool "<sys/statvfs.h> -> statvfs"
        default n

endif
```

## examples/utest/testcases/posix/sys/utsname_h/Kconfig
```kconfig
menuconfig RTT_POSIX_TESTCASE_SYS_UTSNAME_H
    bool "<sys/shm.h>"
    default n

if RTT_POSIX_TESTCASE_SYS_UTSNAME_H

    # functions, TODO

endif
```

## examples/utest/testcases/posix/time_h/Kconfig
```kconfig
menuconfig RTT_POSIX_TESTCASE_TIME_H
    bool "<time.h>"
    default n

if RTT_POSIX_TESTCASE_TIME_H

    config TIME_H_ASCTIME
        bool "<time.h, sys/time.h> -> asctime"
        default n

    config TIME_H_CLOCK_GETTIME
        bool "<time.h, sys/time.h> -> clock_gettime"
        default n

    config TIME_H_CLOCK
        bool "<time.h, sys/time.h> -> clock"
        default n

    config TIME_H_DIFFTIME
        bool "<time.h, sys/time.h> -> difftime"
        default n

    config TIME_H_GMTIME_R
        bool "<time.h, sys/time.h> -> gmtime_r"
        default n

    config TIME_H_GMTIME
        bool "<time.h, sys/time.h> -> gmtime"
        default n

    config TIME_H_LOCALTIME
        bool "<time.h, sys/time.h> -> localtime"
        default n

    config TIME_H_MKTIME
        bool "<time.h, sys/time.h> -> mktime"
        default n

    config TIME_H_NANOSLEEP
        bool "<time.h, sys/time.h> -> nanosleep"
        default n

    config TIME_H_STRFTIME
        bool "<time.h, sys/time.h> -> strftime"
        default n

    config TIME_H_TIME
        bool "<time.h, sys/time.h> -> time"
        default n

    config TIME_H_UTIMES
        bool "<time.h, sys/time.h> -> utimes"
        default n

endif
```

## examples/utest/testcases/posix/unistd_h/Kconfig
```kconfig
menuconfig RTT_POSIX_TESTCASE_UNISTD_H
    bool "<unistd.h>"
    default n

if RTT_POSIX_TESTCASE_UNISTD_H

    config UNISTD_H_ACCESS
        bool "<unistd.h> -> access"
        default n
    config UNISTD_H_CHDIR
        bool "<unistd.h> -> chdir"
        default n

    config UNISTD_H_FTRUNCATE
        bool "<unistd.h> -> ftruncate"
        default n
    config UNISTD_H_ISATTY
        bool "<unistd.h> -> isatty"
        default n

    config UNISTD_H_FSYNC
        bool "<unistd.h> -> fsync"
        default n
    config UNISTD_H_RMDIR
        bool "<unistd.h> -> rmdir"
        default n
endif
```

## examples/utest/testcases/pref/Kconfig
```kconfig
menu "System Performance Testcase"

config UTEST_SYS_PREF_TC
    bool "system performance test"
    default n

choice
    prompt "Select time reference for System Performance Testcase"
    default USING_TICK_AS_TIME_REF
    depends on UTEST_SYS_PREF_TC

config USING_HWTIME_AS_TIME_REF
    bool "Use hardware timer as time reference"
    depends on RT_USING_HWTIMER

config USING_TICK_AS_TIME_REF
    bool "Use system tick as time reference"

endchoice

config UTEST_HWTIMER_DEV_NAME
    string "Hardware timer device name"
    default "timer0"
    depends on USING_HWTIME_AS_TIME_REF
    help
        Specify the hardware timer device name used for context switch testing (e.g., timer11).

config UTEST_SYS_CONTEXT_SWITCH
    bool "system context switch test"
    default n

endmenu
```

## examples/utest/testcases/smp_call/Kconfig
```kconfig
menu "SMP-Call Testcase"

config UTEST_SMP_CALL_FUNC
    bool "SMP-Call test cases"
    default n
endmenu
```

## examples/utest/testcases/smp_ipi/Kconfig
```kconfig
menu "SMP Testcase"

config UTEST_SMP_CALL_FUNC
    bool "Call random cpu to run func"
    default n
endmenu
```

## examples/utest/testcases/tfs/Kconfig
```kconfig
menu "Tfs Testcase"

config UTEST_TMPFS_CP
    bool "tmpfs cp test"
    default y
endmenu
```

## examples/utest/testcases/tmpfs/Kconfig
```kconfig
menu "Tmpfs Testcase"

config UTEST_TMPFS_CP
    bool "tmpfs cp test"
    default n
endmenu
```
