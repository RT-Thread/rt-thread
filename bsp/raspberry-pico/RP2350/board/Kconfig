## bsp/renesas/ra6m4-cpk/drivers/Kconfig
```kconfig
menu "Hardware Drivers Config"

    config SOC_SERIES_R7FA6M4AF
        bool
        select RT_USING_COMPONENTS_INIT
        select RT_USING_USER_MAIN
        default y

    menu "Onboard Peripheral Drivers"

    endmenu

    menu "On-chip Peripheral Drivers"

        config BSP_USING_GPIO
            bool "Enable GPIO"
            select RT_USING_PIN
            default y

        config BSP_USING_ONCHIP_FLASH
            bool "Enable Onchip FLASH"
            default n

        config BSP_USING_WDT
            bool "Enable Watchdog Timer"
            select RT_USING_WDT
            default n

        menuconfig BSP_USING_UART
            bool "Enable UART"
            default y
            select RT_USING_SERIAL
            select RT_USING_SERIAL_V2
            if BSP_USING_UART
                menuconfig BSP_USING_UART7
                    bool "Enable UART7 (Console)"
                    default y
                    if BSP_USING_UART7
                        config BSP_UART7_RX_USING_DMA
                            bool "Enable UART7 RX DMA"
                            depends on BSP_USING_UART7 && RT_SERIAL_USING_DMA
                            default n

                        config BSP_UART7_TX_USING_DMA
                            bool "Enable UART7 TX DMA"
                            depends on BSP_USING_UART7 && RT_SERIAL_USING_DMA
                            default n

                        config BSP_UART7_RX_BUFSIZE
                            int "Set UART7 RX buffer size"
                            range 64 65535
                            depends on RT_USING_SERIAL_V2
                            default 256

                        config BSP_UART7_TX_BUFSIZE
                            int "Set UART7 TX buffer size"
                            range 0 65535
                            depends on RT_USING_SERIAL_V2
                            default 0
                    endif
            endif

        menuconfig BSP_USING_I2C
            bool "Enable I2C BUS"
            default n
            select RT_USING_I2C
            select RT_USING_I2C_BITOPS
            select RT_USING_PIN
            if BSP_USING_I2C
                menuconfig BSP_USING_I2C1
                    bool "Enable I2C1 BUS (software simulation)"
                    default y
                    if BSP_USING_I2C1
                        config BSP_I2C1_SCL_PIN
                            hex "i2c1 scl pin number"
                            range 0x0000 0x0B0F
                            default 0x0512
                        config BSP_I2C1_SDA_PIN
                            hex "I2C1 sda pin number"
                            range 0x0000 0x0B0F
                            default 0x0511
                    endif
            endif

        menuconfig BSP_USING_ONCHIP_RTC
            bool "Enable RTC"
            select RT_USING_RTC
            default n
            if BSP_USING_ONCHIP_RTC
            endif

        menuconfig BSP_USING_SPI
            bool "Enable SPI BUS"
            default n
            select RT_USING_SPI
            if BSP_USING_SPI
                config BSP_SPI_USING_DTC_DMA
                    bool "Enable SPI DTC transfers data without using the CPU."
                    default n

                config BSP_USING_SPI0
                    bool "Enable SPI0 BUS"
                    default n
        
                config BSP_USING_SPI1
                    bool "Enable SPI1 BUS"
                    default n
            endif

        menuconfig BSP_USING_ADC
            bool "Enable ADC"
            default n
            select RT_USING_ADC
            if BSP_USING_ADC
                config BSP_USING_ADC0
                    bool "Enable ADC0"
                    default n

                config BSP_USING_ADC1
                    bool "Enable ADC1"
                    default n
            endif

        menuconfig BSP_USING_DAC
            bool "Enable DAC"
            default n
            select RT_USING_DAC
            if BSP_USING_DAC
                config BSP_USING_DAC0
                    bool "Enable DAC0"
                    default n

                config BSP_USING_DAC1
                    bool "Enable DAC1"
                    default n
            endif

        menuconfig BSP_USING_PWM
            bool "Enable PWM"
            default n
            select RT_USING_PWM
            if BSP_USING_PWM
                config BSP_USING_PWM0
                    bool "Enable GPT0 (32-Bits) output PWM"
                    default n
                
                config BSP_USING_PWM1
                    bool "Enable GPT1 (32-Bits) output PWM"
                    default n

                config BSP_USING_PWM2
                    bool "Enable GPT2 (32-Bits) output PWM"
                    default n

                config BSP_USING_PWM3
                    bool "Enable GPT3 (32-Bits) output PWM"
                    default n

                config BSP_USING_PWM4
                    bool "Enable GPT4 (16-Bits) output PWM"
                    default n

                config BSP_USING_PWM5
                    bool "Enable GPT5 (16-Bits) output PWM"
                    default n

                config BSP_USING_PWM6
                    bool "Enable GPT6 (16-Bits) output PWM"
                    default n

                config BSP_USING_PWM7
                    bool "Enable GPT7 (16-Bits) output PWM"
                    default n

                config BSP_USING_PWM8
                    bool "Enable GPT8 (16-Bits) output PWM"
                    default n

                config BSP_USING_PWM9
                    bool "Enable GPT9 (16-Bits) output PWM"
                    default n
            endif

        menuconfig BSP_USING_CAN
            bool "Enable CAN"
            default n
            select RT_USING_CAN
            if BSP_USING_CAN
                config BSP_USING_CAN0
                    bool "Enable CAN0"
                    default n

                config BSP_USING_CAN1
                    bool "Enable CAN1"
                    default n
            endif

    endmenu

    menu "Board extended module Drivers"

        menuconfig BSP_USING_RW007
            bool "Enable RW007"
            default n
            select PKG_USING_RW007
            select BSP_USING_SPI

        if BSP_USING_RW007
            config RA_RW007_SPI_BUS_NAME
                string "RW007 BUS NAME"
                default "spi1"

            config RA_RW007_CS_PIN
                hex "(HEX)CS pin index"
                default 0x040D

            config RA_RW007_BOOT0_PIN
                hex "(HEX)BOOT0 pin index (same as spi clk pin)"
                default 0x040C

            config RA_RW007_BOOT1_PIN
                hex "(HEX)BOOT1 pin index (same as spi cs pin)"
                default 0x040D

            config RA_RW007_INT_BUSY_PIN
                hex "(HEX)INT/BUSY pin index"
                default 0x0506

            config RA_RW007_RST_PIN
                hex "(HEX)RESET pin index"
                default 0x040F
        endif

    endmenu
endmenu
```
