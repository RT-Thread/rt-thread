## components/drivers/rtc/Kconfig
```kconfig
menuconfig RT_USING_RTC
    bool "Using RTC device drivers"
    default n
    help
      Enable the RTC core so hardware real-time clocks can be registered via
      `rt_hw_rtc_register`, the kernel can keep wall clock time across suspend/
      resume, and applications can query or set calendar values through the
      `rtc` character device. Turn this on whenever you have a peripheral or
      PMIC that supplies timestamp/backup registers referenced from the device
      tree; disable it only on chips that genuinely lack RTC hardware.

    if RT_USING_RTC
        config RT_USING_ALARM
            bool "Using RTC alarm"
            default n
            help
              Spawn the alarm service defined in `dev_alarm.c`. The driver
              creates an RT-Thread worker thread that reconciles user-space
              alarms with the RTC wakeup registers, automatically reprograms
              oneshot/periodic alarms, and raises callbacks when the hardware
              interrupt fires. Enable this if your application needs wakeup at a
              given date/time; leave it disabled to save RAM/CPU when alarms are
              not used.

        if RT_USING_ALARM
            config RT_ALARM_STACK_SIZE
                int "stack size for alarm thread"
                default IDLE_THREAD_STACK_SIZE
                help
                  Specify the stack size (bytes) used by the internal alarm
                  management thread. Increase this when alarm callbacks perform
                  complex logic or use libc time conversions; shrink it on very
                  constrained MCUs when you are sure the callbacks stay shallow.

            config RT_ALARM_TIMESLICE
                int "timeslice for alarm thread"
                default 5
                help
                  Define the timeslice (OS ticks) granted to the alarm thread
                  when it runs at the same priority as other time-sensitive
                  tasks. Lower values make the system more responsive at the
                  cost of additional context switches; higher values slightly
                  delay alarm handling under load.

            config RT_ALARM_PRIORITY
                int "priority for alarm thread"
                default 10
                help
                  RT-Thread priority (smaller numbers are higher priority) of
                  the alarm management thread. Choose a priority above most
                  application threads if you require deterministic wakeups, or
                  below CPU-intensive tasks when alarm latency is less critical.

            config RT_ALARM_USING_LOCAL_TIME
                bool "Using local time for the alarm calculation"
                default n
                depends on RT_USING_ALARM
                help
                  Make the alarm service convert timestamps with `mktime()` so
                  alarms follow the configured local time zone instead of UTC.
                  Enable this when alarms must honor daylight saving or custom
                  offsets; otherwise keep it disabled to avoid the overhead of
                  repeatedly converting between UTC and local time.
        endif

        config RT_USING_SOFT_RTC
            bool "Using software simulation RTC device"
            default n
            help
              Build the tick-based software RTC implementation (`dev_soft_rtc`)
              for boards without dedicated RTC hardware. The driver keeps time
              by accumulating system ticks and stores values in RAM only, so it
              resets to the compile-time default after power loss. Enable it for
              simulations or low-cost MCUs that still need an `rtc` device node;
              disable it when real RTC registers are available to avoid two
              competing time sources.
    endif

config RT_RTC_DS1302
    bool "Dallas/Maxim DS1302"
    depends on RT_USING_DM
    depends on RT_USING_RTC
    depends on RT_USING_SPI
    default n

config RT_RTC_DS1307
    bool "Dallas/Maxim DS1307/37/38/39/40, ST M41T11"
    depends on RT_USING_DM
    depends on RT_USING_RTC
    depends on RT_USING_I2C
    default n

config RT_RTC_GOLDFISH
    bool "Goldfish Real Time Clock"
    depends on RT_USING_DM
    depends on RT_USING_RTC
    default n

config RT_RTC_HYM8563
    bool "Haoyu Microelectronics HYM8563"
    depends on RT_USING_DM
    depends on RT_USING_RTC
    depends on RT_USING_I2C
    default n

config RT_RTC_PCF8523
    bool "NXP PCF8523"
    depends on RT_USING_DM
    depends on RT_USING_RTC
    depends on RT_USING_I2C
    default n

config RT_RTC_PCF8563
    bool "Philips PCF8563/Epson RTC8564"
    depends on RT_USING_DM
    depends on RT_USING_RTC
    depends on RT_USING_I2C
    default n

config RT_RTC_PL031
    bool "ARM PL031"
    depends on RT_USING_DM
    depends on RT_USING_RTC
    default n

config RT_RTC_RX8010
    bool "Epson RX8010SJ"
    depends on RT_USING_DM
    depends on RT_USING_RTC
    depends on RT_USING_I2C
    default n

if RT_USING_DM && RT_USING_RTC
    osource "$(SOC_DM_RTC_DIR)/Kconfig"
endif
```

## components/drivers/scsi/Kconfig
```kconfig
menuconfig RT_USING_SCSI
    bool "Using Small Computer System Interface (SCSI)"
    depends on RT_USING_DM
    default n
    help
      Enable the SCSI mid-layer which translates block requests to SCSI command
      packets. Needed by AHCI, USB Mass Storage, and NVMe drivers that expose
      disks as SCSI devices.

config RT_SCSI_SD
    bool "SD device on SCSI"
    depends on RT_USING_SCSI
    depends on RT_USING_BLK
    default y
    help
      Register disk-type SCSI devices (direct-access). Keep enabled unless you
      intentionally drop support for SCSI disks.

config RT_SCSI_CDROM
    bool "CD-ROM device on SCSI"
    depends on RT_USING_SCSI
    depends on RT_USING_BLK
    default y
    help
      Provide SCSI CD-ROM device emulation (read-only block devices). Disable
      only if optical-style devices are never needed.

if RT_USING_SCSI
    osource "$(SOC_DM_SCSI_DIR)/Kconfig"
endif
```

## components/drivers/sdio/Kconfig
```kconfig
config RT_USING_SDIO
    bool "Using SD/MMC device drivers"
    select RT_USING_BLK
    default n
    help
      Enable the SDIO/MMC host stack so SD cards and eMMC devices can be
      enumerated and exposed as block devices. Requires the block layer and an
      SDIO host controller driver.

    if RT_USING_SDIO
        config RT_SDIO_STACK_SIZE
            int "The stack size for sdio irq thread"
            default 512
            help
              Stack size for the SDIO interrupt handler thread; increase if your
              controller driver performs complex processing in IRQ context.

        config RT_SDIO_THREAD_PRIORITY
            int "The priority level value of sdio irq thread"
            default 15
            help
              Scheduler priority assigned to the SDIO IRQ thread.

        config RT_MMCSD_STACK_SIZE
            int "The stack size for mmcsd thread"
            default 1024
            help
              Stack size for the mmc/sd management thread that handles requests.

        config RT_MMCSD_THREAD_PRIORITY
            int "The priority level value of mmcsd thread"
            default 22
            help
              Priority for the mmc/sd management thread; tune relative to other
              storage tasks.

        config RT_MMCSD_MAX_PARTITION
            int "mmcsd max partition"
            default 16
            help
              Maximum number of partitions to scan on an SD/MMC device.
        config RT_SDIO_DEBUG
            bool "Enable SDIO debug log output"
            default n
            help
              Print verbose SDIO/MMC driver logs for debugging.
        config RT_USING_SDHCI
            bool "Using sdhci for sd/mmc drivers"
            default n
            help
              Build the SD Host Controller Interface (SDHCI) compatible driver.
              Enable when your controller follows the SDHCI specification.
        endif
```

## components/drivers/sdio/host/Kconfig
```kconfig
config RT_SDIO_SDHCI_PCI
    bool "SDHCI support on PCI bus"
    depends on RT_USING_PCI
    select RT_USING_SDHCI
    default n

config RT_SDIO_DW_MMC
    bool "Synopsys DesignWare MMC Family"
    depends on RT_USING_PINCTRL
    depends on RT_USING_RESET
    depends on RT_USING_REGULATOR
    select RT_USING_DEVICE_IPC
    select RT_USING_SYSTEM_WORKQUEUE
    default n

config RT_SDIO_DW_MMC_PCI
    bool "Synopsys Designware MCI support on PCI bus"
    depends on RT_SDIO_DW_MMC
    depends on RT_USING_PCI
    default n

osource "$(SOC_DM_SDIO_DIR)/Kconfig"
```

## components/drivers/sensor/Kconfig
```kconfig
config RT_USING_SENSOR
    bool "Using Sensor device drivers"
    select RT_USING_PIN
    default n
    help
      Enable the sensor framework so accelerometers, gyros, temperature sensors,
      etc. can register unified data channels. Depends on GPIO for interrupt
      pins. Disable if no sensors are present.

if RT_USING_SENSOR
    config RT_USING_SENSOR_V2
        bool "Enable Sensor Framework v2"
        default n
        help
          Opt in to the redesigned sensor framework (v2) that updates the device
          APIs and CLI tools. Only enable if your BSP/drivers support it.

    config RT_USING_SENSOR_CMD
        bool "Using Sensor cmd"
        select RT_KLIBC_USING_VSNPRINTF_STANDARD if RT_USING_SENSOR_V2
        default y
        help
          Build the shell command helpers for listing and testing sensors. Useful
          during bring-up; disable to save a bit of code.
endif
```

## components/drivers/serial/Kconfig
```kconfig
menuconfig RT_USING_SERIAL
    bool "USING Serial device drivers"
    select RT_USING_DEVICE_IPC
    select RT_USING_DEVICE
    default y
    help
      Enable the UART/USART driver framework that backs the console and TTY
      devices. Required for shell access or any serial communications.

    if RT_USING_SERIAL
        choice RT_USING_SERIAL_VERSION
            prompt "Choice Serial version"
            default RT_USING_SERIAL_V1
            config RT_USING_SERIAL_V1
                bool "RT_USING_SERIAL_V1"
            config RT_USING_SERIAL_V2
                bool "RT_USING_SERIAL_V2"
        help
          Select between the legacy serial core (V1) and the newer buffer/ISR
          design (V2). Choose V2 for advanced buffer strategies, otherwise stay
          with V1 for compatibility.
        endchoice

        choice RT_USING_SERIAL_MODE
            prompt "Choice Serial version"
            depends on RT_USING_SERIAL_V2
            default RT_SERIAL_BUF_STRATEGY_OVERWRITE
            config RT_SERIAL_BUF_STRATEGY_DROP
                bool "drop new incoming data when the buffer is full"
            config RT_SERIAL_BUF_STRATEGY_OVERWRITE
                bool "overwrite old data when the buffer is full"
        help
          Define how V2 RX buffers behave on overflow: drop new bytes or
          overwrite oldest data.
        endchoice

        config RT_SERIAL_USING_DMA
            bool "Enable serial DMA mode"
            default y
            help
              Allow serial drivers to use DMA for RX/TX to reduce CPU load. Turn
              off if your SoC lacks UART DMA support.

        config RT_SERIAL_RB_BUFSZ
            int "Set RX buffer size"
            depends on !RT_USING_SERIAL_V2
            default 64
            help
              Size of the legacy (V1) receive ring buffer in bytes.
        config RT_USING_SERIAL_BYPASS
            bool "Using serial bypass"
            default n
            help
              Enable bypass mode that forwards data between two serial devices,
              useful for debugging or bridging.
        endif
```

## components/drivers/serial/device/8250/Kconfig
```kconfig
menuconfig RT_SERIAL_8250
    bool "8250 Serial Family"
    default n

config RT_SERIAL_8250_DW
    bool "Synopsys DesignWare 8250"
    depends on RT_SERIAL_8250
    default n

config RT_SERIAL_8250_PCI
    bool "8250 PCI/2x/4x"
    depends on RT_SERIAL_8250
    depends on RT_USING_PCI
    default n
```
