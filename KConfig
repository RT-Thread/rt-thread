## bsp/Infineon/xmc7100d-f144k4160aa/board/Kconfig
```kconfig
menu "Hardware Drivers Config"

config SOC_XMC7100D_F144K4160AA
    bool
    select SOC_SERIES_IFX_XMC
    select RT_USING_COMPONENTS_INIT
    select RT_USING_USER_MAIN
    default y

menu "Onboard Peripheral Drivers"

    config BSP_USING_USB_TO_USART
        bool "Enable USB TO USART (uart4)"
        select BSP_USING_GPIO
        select BSP_USING_UART
        select BSP_USING_UART4
        default y
    menuconfig BSP_USING_TF_CARD
        bool "Enable TF_CARD"
        select BSP_USING_SPI
        select RT_USING_SPI_MSD
        select RT_USING_DFS
        select RT_USING_DFS_DEVFS
        select RT_USING_DFS_ELMFAT
        default n
        if BSP_USING_TF_CARD
            config BSP_USING_SPI_FLASH
                bool "Using SPI TO SDCARD"
                default y
        endif
    config BSP_USING_QMI8658
        bool "Enable QMI8658"
        select BSP_USING_I2C
        select PKG_USING_QMI8658
        default n

    menuconfig BSP_USING_ARDUINO
        bool "Compatible with Arduino Ecosystem (RTduino)"
        default n
        select PKG_USING_RTDUINO
        select BSP_USING_UART2
        select BSP_USING_GPIO
        select BSP_USING_I2C
        select BSP_USING_HW_I2C2
        select BSP_USING_SPI
        select BSP_USING_SPI0
        imply RTDUINO_USING_SERVO
        imply RTDUINO_USING_WIRE
        imply RTDUINO_USING_SPI
        if BSP_USING_ARDUINO
            menuconfig BSP_USING_ARDUINO_RTDUINO_SENSORFUSION_SHIELD
                bool "Enable ARDUINO RTDUINO SENSORFUSION SHIELD"
                default n
                select PKG_USING_ARDUINO_RTDUINO_SENSORFUSION_SHIELD
                select PKG_ARDUINO_RTDUINO_SENSORFUSION_SHIELD_DEMO
                if BSP_USING_ARDUINO_RTDUINO_SENSORFUSION_SHIELD
                    config BSP_USING_RTDUINO_SENSORFUSION_SHIELD_BMP280_DEMO
                        bool "Enable RTDUINO SENSORFUSION SHIELD BMP280 DEMO"
                        select PKG_RTDUINO_SENSORFUSION_SHIELD_BMP280_DEMO
                        default n
                    config BSP_USING_RTDUINO_SENSORFUSION_SHIELD_SHT31_DEMO
                        bool "Enable RTDUINO SENSORFUSION SHIELD SHT31 DEMO"
                        select PKG_RTDUINO_SENSORFUSION_SHIELD_SHT31_DEMO
                        default n
                    config BSP_USING_RTDUINO_SENSORFUSION_SHIELD_QMC5883L_DEMO
                        bool "Enable RTDUINO SENSORFUSION SHIELD QMC5883L DEMO"
                        select PKG_RTDUINO_SENSORFUSION_SHIELD_QMC5883L_DEMO
                        default n
                    config BSP_USING_RTDUINO_SENSORFUSION_SHIELD_SC7A20_DEMO
                        bool "Enable RTDUINO SENSORFUSION SHIELD SC7A20 DEMO"
                        select PKG_RTDUINO_SENSORFUSION_SHIELD_SC7A20_DEMO
                        default n
                    config BSP_USING_RTDUINO_SENSORFUSION_SHIELD_SSD1306_DEMO
                        bool "Enable RTDUINO SENSORFUSION SHIELD SSD1306 DEMO"
                        select PKG_RTDUINO_SENSORFUSION_SHIELD_SSD1306_DEMO
                        default n
                endif
        endif

    menuconfig BSP_USING_RW007
        bool "Enable RW007"
        default n
        select PKG_USING_RW007
        select BSP_USING_SPI
        select BSP_USING_SPI0
        select RW007_NOT_USE_EXAMPLE_DRIVERS

    if BSP_USING_RW007
        comment "Notice: P5_7 --> 47; P5_6 -->46; P0_5 --> 5; P0_4 --> 4"
        config IFX_RW007_SPI_BUS_NAME
            string "RW007 BUS NAME"
            default "spi0"

        config IFX_RW007_WIFI_SSID
            string "Wi-Fi SSID"
            default "realthread_VIP"

        config IFX_RW007_WIFI_PASSWORD
            string "Wi-Fi Password"
            default "your wifi password"

        config IFX_RW007_CS_PIN
            int "(INT)CS pin index"
            range 1 113
            default 3

        config IFX_RW007_BOOT0_PIN
            int "(INT)BOOT0 pin index (same as spi clk pin)"
            range 1 113
            default 2

        config IFX_RW007_BOOT1_PIN
            int "(INT)BOOT1 pin index (same as spi cs pin)"
            range 1 113
            default 3

        config IFX_RW007_INT_BUSY_PIN
            int "(INT)INT/BUSY pin index"
            range 1 190
            default 160

        config IFX_RW007_RST_PIN
            int "(INT)RESET pin index"
            range 1 190
            default 180
    endif
endmenu

menu "On-chip Peripheral Drivers"

    config BSP_USING_GPIO
        bool "Enable GPIO"
        select RT_USING_PIN
        default y

    menuconfig BSP_USING_UART
        bool "Enable UART"
        default y
        select RT_USING_SERIAL
        if BSP_USING_UART
            config BSP_USING_UART2
                bool "Enable UART2"
                default n
            config BSP_USING_UART4
                bool "Enable UART4"
                default y
            config UART_CPU_IRQ_Number
                int "UART connect CPU Interrupt Number (0-7)"
                range 0 7
                default 3
        endif
    menuconfig BSP_USING_I2C
        bool "Enable HW I2C"
        default n
        select RT_USING_I2C
        if BSP_USING_I2C
            menuconfig BSP_USING_HW_I2C1
                bool "Enable BSP_USING_HW_I2C1"
                default y
                if BSP_USING_HW_I2C1
                    config BSP_I2C1_SCL_PIN
                        int "BSP_I2C1_SCL_PIN number(18,2)"
                        range 0 999
                        default 146
                    config BSP_I2C1_SDA_PIN
                        int "BSP_I2C1_SDA_PIN number(18,1)"
                        range 0 999
                        default 145
                endif
            menuconfig BSP_USING_HW_I2C2
                bool "Enable BSP_USING_HW_I2C2"
                default y
                if BSP_USING_HW_I2C2
                    config BSP_I2C2_SCL_PIN
                        int "BSP_I2C2_SCL_PIN number(0,1)"
                        range 0 999
                        default 1
                    config BSP_I2C2_SDA_PIN
                        int "BSP_I2C2_SDA_PIN number(0,0)"
                        range 0 999
                        default 0
                endif
        endif
    menuconfig BSP_USING_SPI
        bool "Enable SPI"
        default n
        select RT_USING_SPI
        if BSP_USING_SPI
            config BSP_USING_SPI5
                bool "Enable BSP_USING_SPI5"
                default y
            config BSP_USING_SPI0
                bool "Enable BSP_USING_SPI0"
                default y
        endif
endmenu

endmenu
```

## bsp/Infineon/xmc7200-kit_xmc7200_evk/board/Kconfig
```kconfig
menu "Hardware Drivers Config"

config SOC_XMC7200D_E272K8384AA
    bool
    select SOC_SERIES_IFX_XMC
    select RT_USING_COMPONENTS_INIT
    select RT_USING_USER_MAIN
    default y

menu "Onboard Peripheral Drivers"

    config BSP_USING_USB_TO_USART
        bool "Enable USB TO USART (uart3)"
        select BSP_USING_GPIO
        select BSP_USING_UART
        select BSP_USING_UART3
        default y
endmenu

menu "On-chip Peripheral Drivers"

    config BSP_USING_GPIO
        bool "Enable GPIO"
        select RT_USING_PIN
        default y

    menuconfig BSP_USING_UART
        bool "Enable UART"
        default y
        select RT_USING_SERIAL
        if BSP_USING_UART
            config BSP_USING_UART3
                bool "Enable UART3"
                default n
            config UART_CPU_IRQ_Number
                int "UART connect CPU Interrupt Number (0-7)"
                range 0 7
                default 3
        endif
    
    config BSP_USING_ETH
        bool "Enable ETH"
        select RT_USING_ETH
        default n  

endmenu

endmenu
```

## bsp/Vango/v85xx/Kconfig
```kconfig
mainmenu "RT-Thread Configuration"

BSP_DIR := .

RTT_DIR := ../../..

# you can change the RTT_ROOT default: "rt-thread"
# example : default "F:/git_repositories/rt-thread"

PKGS_DIR := packages

source "$(RTT_DIR)/Kconfig"
osource "$PKGS_DIR/Kconfig"

config SOC_SERIES_V85XX
    bool
    default y

config SOC_V85XX
    bool
    select RT_USING_COMPONENTS_INIT
    select RT_USING_USER_MAIN
    select SOC_SERIES_V85XX
    default y

menu "On-chip Peripheral Drivers"
    menuconfig BSP_USING_UART
        bool "Enable UART"
        default y
        select RT_USING_SERIAL
        if BSP_USING_UART
            config BSP_USING_UART0
                bool "using uart0"
                default n
            config BSP_USING_UART1
                bool "using uart1"
                default n
            config BSP_USING_UART2
                bool "using uart2"
                default y
            config BSP_USING_UART3
                bool "using uart3"
                default n
            config BSP_USING_UART4
                bool "using uart4"
                default n
        endif
    menuconfig BSP_USING_ADC
        bool "Enable ADC"
        default n
        select RT_USING_ADC
        if BSP_USING_ADC
            config BSP_USING_ADC0
                bool "using adc0"
                default n
            config BSP_USING_ADC1
                bool "using adc1"
                default n
        endif
    menuconfig BSP_USING_CLOCK_TIMER
        bool "Enable clock_timer"
        default n
        select RT_USING_CLOCK_TIME
        if BSP_USING_CLOCK_TIMER
            config BSP_USING_CLOCK_TIMER0
                bool "using clock_timer0"
                default n
            config BSP_USING_CLOCK_TIMER1
                bool "using clock_timer1"
                default n
            config BSP_USING_CLOCK_TIMER2
                bool "using clock_timer2"
                default n
            config BSP_USING_CLOCK_TIMER3
                bool "using clock_timer3"
                default n
            config BSP_USING_CLOCK_TIMER4
                bool "using clock_timer4"
                default n
            config BSP_USING_CLOCK_TIMER5
                bool "using clock_timer5"
                default n
            config BSP_USING_CLOCK_TIMER6
                bool "using clock_timer6"
                default n
            config BSP_USING_CLOCK_TIMER7
                bool "using clock_timer7"
                default n
        endif
    config BSP_USING_WDT
        bool "Enable Watchdog Timer"
        select RT_USING_WDT
        default n

    config BSP_USING_RTC
        bool "using internal rtc"
        default n
        select RT_USING_RTC

endmenu
```

## bsp/acm32/acm32f0x0-nucleo/Kconfig
```kconfig
mainmenu "RT-Thread Project Configuration"

BSP_DIR := .

RTT_DIR := ../../..

PKGS_DIR := packages

source "$(RTT_DIR)/Kconfig"
osource "$PKGS_DIR/Kconfig"

config SOC_SERIES_ACM32F0
    bool
    select ARCH_ARM_CORTEX_M0
    select RT_USING_COMPONENTS_INIT
    select RT_USING_USER_MAIN
    default y

source "$(BSP_DIR)/drivers/Kconfig"
```
