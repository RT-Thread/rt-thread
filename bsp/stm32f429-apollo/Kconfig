## bsp/tae32/tae32g5800_eval_board/board/Kconfig
```kconfig
menu "Hardware Drivers Config"

menu "Onboard Peripheral Drivers"

endmenu

menu "On-chip Peripheral Drivers"

    config BSP_USING_GPIO
        bool "Enable GPIO"
        select RT_USING_PIN
        default y

    config BSP_USING_WDT
        bool "Enable Independent Watch Dog Timer"
        select RT_USING_WDT
        default n

    menuconfig BSP_USING_CAN
        bool "Enable CAN"
        default n
        select RT_USING_CAN
        select RT_CAN_USING_HDR
        if BSP_USING_CAN
            config BSP_USING_CAN0
                bool "Enable can0"
                default n
        
            config BSP_USING_CAN1
                bool "Enable can1"
                default n
        endif

    menuconfig BSP_USING_UART
        bool "Enable UART"
        default y
        select RT_USING_SERIAL
        if BSP_USING_UART
            config BSP_USING_UART0
                bool "Enable UART0"
                default y

            config BSP_UART0_USING_OVER_SAMP16X
                bool "    Enable UART0 OVER SAMP16X"
                depends on BSP_USING_UART0
                default n

            config BSP_UART0_RX_BUFSIZE
                int "    Set UART0 RX buffer size"
                range 0 65535
                depends on BSP_USING_UART0 && RT_USING_SERIAL_V2
                default 64

            config BSP_UART0_TX_BUFSIZE
                int "    Set UART0 TX buffer size"
                range 0 65535
                depends on BSP_USING_UART0 && RT_USING_SERIAL_V2
                default 0    

            config BSP_USING_UART1
                bool "Enable UART1"
                default y

            config BSP_UART1_USING_OVER_SAMP16X
                bool "    Enable UART1 OVER_SAMP16X"
                depends on BSP_USING_UART1
                default n

            config BSP_UART1_RX_BUFSIZE
                int "    Set UART1 RX buffer size"
                range 0 65535
                depends on BSP_USING_UART1 && RT_USING_SERIAL_V2
                default 64

            config BSP_UART1_TX_BUFSIZE
                int "    Set UART1 TX buffer size"
                range 0 65535
                depends on BSP_USING_UART1 && RT_USING_SERIAL_V2
                default 0    

            config BSP_USING_UART2
                bool "Enable UART2"
                default y

            config BSP_UART2_USING_OVER_SAMP16X
                bool "    Enable UART2 OVER_SAMP16X"
                depends on BSP_USING_UART2
                default n

            config BSP_UART2_RX_BUFSIZE
                int "    Set UART2 RX buffer size"
                range 0 65535
                depends on BSP_USING_UART2 && RT_USING_SERIAL_V2
                default 64

            config BSP_UART2_TX_BUFSIZE
                int "    Set UART2 TX buffer size"
                range 0 65535
                depends on BSP_USING_UART2 && RT_USING_SERIAL_V2
                default 0    

            config BSP_USING_UART3
                bool "Enable UART3"
                default y

            config BSP_UART3_USING_OVER_SAMP16X
                bool "    Enable UART3 OVER_SAMP16X"
                depends on BSP_USING_UART3
                default n

            config BSP_UART3_RX_BUFSIZE
                int "    Set UART3 RX buffer size"
                range 0 65535
                depends on BSP_USING_UART3 && RT_USING_SERIAL_V2
                default 64

            config BSP_UART3_TX_BUFSIZE
                int "    Set UART3 TX buffer size"
                range 0 65535
                depends on BSP_USING_UART3 && RT_USING_SERIAL_V2
                default 0        

            config BSP_USING_UART4
                bool "Enable UART4"
                default y

            config BSP_UART4_USING_OVER_SAMP16X
                bool "    Enable UART4 OVER_SAMP16X"
                depends on BSP_USING_UART4
                default n

            config BSP_UART4_RX_BUFSIZE
                int "    Set UART4 RX buffer size"
                range 0 65535
                depends on BSP_USING_UART4 && RT_USING_SERIAL_V2
                default 64

            config BSP_UART4_TX_BUFSIZE
                int "    Set UART4 TX buffer size"
                range 0 65535
                depends on BSP_USING_UART4 && RT_USING_SERIAL_V2
                default 0      
        endif

        menuconfig BSP_USING_ON_CHIP_FLASH
            bool "Enable on-chip FLASH"
            default n
            if BSP_USING_ON_CHIP_FLASH
                choice 
                    prompt "Select based on the actual bank mode of the chip"
                    default BSP_USING_FLASH_SBANK

                    config BSP_USING_FLASH_SBANK
                        bool "Single Bank Flash"
    
                    config BSP_USING_FLASH_DBANK
                        bool "Dual Bank Flash"
                endchoice     
            endif    

endmenu

menu "Board extended module Drivers"

endmenu

endmenu
```

## bsp/thead-smart/Kconfig
```kconfig
mainmenu "RT-Thread Configuration"

BSP_DIR := .

RTT_DIR := ../..

# you can change the RTT_ROOT default "../.." to your rtthread_root,
# example : default "F:/git_repositories/rt-thread"

PKGS_DIR := packages

source "$(RTT_DIR)/Kconfig"
osource "$PKGS_DIR/Kconfig"

config SOC_THEAD_SMART
    bool
    select RT_USING_COMPONENTS_INIT
    select RT_USING_USER_MAIN
    select ARCH_RISCV32
    select ARCH_RISCV_FPU_S
    default y

if RT_USING_SERIAL

    config RT_USING_UART1
        bool "Using uart1"
        default y

endif
```

## bsp/ti/boards/myb-am335x-y/Kconfig
```kconfig
mainmenu "RT-Thread Configuration"

config BSP_DIR
    string
    option env="BSP_ROOT"
    default "."

config RTT_DIR
    string
    option env="RTT_ROOT"
    default "../../../.."

# you can change the RTT_ROOT default "../.." to your rtthread_root,
# example: default "F:/git_repositories/rt-thread"

config PKGS_DIR
    string
    option env="PKGS_ROOT"
    default "packages"

config ENV_DIR
    string
    option env="ENV_ROOT"
    default "/"

source "$RTT_DIR/Kconfig"
source "$PKGS_DIR/Kconfig"

menu "Hardware Drivers Config"

source "$RTT_DIR/bsp/ti/libraries/Kconfig"
source "board/Kconfig"

endmenu
```

## bsp/ti/boards/myb-am335x-y/board/Kconfig
```kconfig
menu "Onboard Peripheral Drivers"

endmenu

menu "Board extended module Drivers"

endmenu
```
