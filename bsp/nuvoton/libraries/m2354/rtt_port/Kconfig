## bsp/nuvoton/ma35-rtp/Kconfig
```kconfig
mainmenu "RT-Thread Configuration"

BSP_DIR := .

RTT_DIR := ../../..

# you can change the RTT_ROOT default "../../.." to your rtthread_root,
# example : default "F:/git_repositories/rt-thread"

PKGS_DIR := packages

config USE_MA35D1_SUBM
    bool
    default y

source "$(RTT_DIR)/Kconfig"
osource "$PKGS_DIR/Kconfig"
source "$(BSP_DIR)/board/Kconfig"
```

## bsp/nuvoton/ma35-rtp/board/Kconfig
```kconfig
menu "Hardware Drivers Config"

    menu "On-chip Peripheral Drivers"
        source "$(BSP_DIR)/../libraries/ma35/rtt_port/Kconfig"
    endmenu

    menu "On-board Peripheral Drivers"

        config BSP_USING_NULINKME
            bool "Enable UART16 for RTT Console(uart16)"
            select BSP_USING_UART
            select BSP_USING_UART16
            default y

    endmenu

    menu "Board extended module drivers"

    endmenu

    source "$(BSP_DIR)/../libraries/nu_packages/Kconfig"

endmenu
```

## bsp/nuvoton/nk-980iot/board/Kconfig
```kconfig
menu "Hardware Drivers Config"

    menu "On-chip Peripheral Drivers"
        source "$(BSP_DIR)/../libraries/nuc980/rtt_port/Kconfig"
    endmenu

    menu "On-board Peripheral Drivers"

        config BSP_USING_CONSOLE
            bool "Enable UART0 for RTT Console(uart0)"
            select BSP_USING_UART
            select BSP_USING_UART0
            default y

        config BOARD_USING_IP101GR
            bool "Enable ethernet phy supporting(over emac/mdio)"
            select BSP_USING_EMAC
            default n


        config BOARD_USING_NAU8822
            bool "NAU8822 Audio Codec supporting(over i2s, i2c0)"
            select NU_PKG_USING_NAU8822
            select BSP_USING_I2C0
            select BSP_USING_I2S
            select BSP_USING_I2S0
            default n

        config BOARD_USING_STORAGE_SDCARD
            bool "SDCARD supporting(over sdh1)"
            select BSP_USING_SDH
            select BSP_USING_SDH1
            default y

        config BOARD_USING_STORAGE_SPIFLASH
            bool "SPI NOR FLASH supporting(over qspi0)"
            select BSP_USING_QSPI
            select BSP_USING_QSPI0
            default n

        config BOARD_USING_STORAGE_SPINAND
            bool "SPI NAND FLASH supporting(over qspi0)"
            select BSP_USING_QSPI
            select BSP_USING_QSPI0
            select NU_PKG_USING_SPINAND
            default y

        config BOARD_USING_USB0_DEVICE_HOST
            select BSP_USING_USBH
            select BSP_USING_USBD
            bool "Enable USB0 Device/Host"
            help
                Choose this option if you need USB device or host function mode.
                    If you need USB host, please remember short to ground on JP1 jumper.

        config BOARD_USING_USB1_HOST
            select BSP_USING_USBH
            bool "Enable USB1 Host"
            help
                Choose this option if you need USB1 HOST.

    endmenu

    menu "Board extended module drivers"

        config BOARD_USING_MAX31875
            bool "MAX31875 Temperature sensor(over i2c1)"
            select NU_PKG_USING_MAX31875
            select BSP_USING_I2C1
            default n

        config BOARD_USING_LCD_ILI9341
            bool "LCD ILI9341 (over spi0)"
            select RT_USING_TOUCH
            select BSP_USING_ADC_TOUCH
            select NU_PKG_USING_ADC_TOUCH
            select NU_PKG_USING_ILI9341
            select NU_PKG_USING_ILI9341_SPI
            select NU_PKG_ILI9341_WITH_OFFSCREEN_FRAMEBUFFER
            select NU_PKG_ILI9341_HORIZONTAL
            select BSP_USING_SPI0
            default n

        if BOARD_USING_LCD_ILI9341

            config BOARD_USING_ILI9341_PIN_BACKLIGHT
            int "Specify the pin index of backlight pin index"
                range 0 127
                default 103

            config BOARD_USING_ILI9341_PIN_RESET
            int "Specify the pin index of reset pin index"
                range 0 127
                default 90

            config BOARD_USING_ILI9341_PIN_DC
            int "Specify the pin index of data&command switching"
                range 0 127
                default 89

        endif

        config BOARD_USING_ESP8266
            bool "ESP8266 Wi-Fi module supporting(over uart1)"
            select BSP_USING_UART
            select BSP_USING_UART1
            select BSP_USING_UART1_RX_DMA
            select BSP_USING_UART1_TX_DMA
            select PKG_USING_AT_DEVICE
            select AT_DEVICE_USING_ESP8266
            select AT_DEVICE_ESP8266_INIT_ASYN
            default n

    endmenu

    source "$(BSP_DIR)/../libraries/nu_packages/Kconfig"

endmenu
```

## bsp/nuvoton/nk-n9h30/board/Kconfig
```kconfig
menu "Hardware Drivers Config"

    menu "On-chip Peripheral Drivers"
        source "$(BSP_DIR)/../libraries/n9h30/rtt_port/Kconfig"
    endmenu

    menu "On-board Peripheral Drivers"

        config BSP_USING_CONSOLE
            bool "Enable UART0 for RTT Console(uart0)"
            select BSP_USING_UART
            select BSP_USING_UART0
            default y

        config BOARD_USING_IP101GR
            bool "Enable ethernet phy supporting(over emac/mdio)"
            select BSP_USING_EMAC
            select BSP_USING_EMAC0
            select BSP_USING_EMAC1
            default n

        config BOARD_USING_NAU8822
            bool "NAU8822 Audio Codec supporting(over i2s, i2c0)"
            select NU_PKG_USING_NAU8822
            select BSP_USING_I2C0
            select BSP_USING_I2S
            select BSP_USING_I2S0
            default n

        config BOARD_USING_STORAGE_SDCARD
            bool "SDCARD supporting(over sdh_p0)"
            select BSP_USING_SDH
            select BSP_USING_SDH0
            default y

        config BOARD_USING_STORAGE_SPIFLASH
            bool "SPIFLASH supporting(over qspi0)"
            select BSP_USING_QSPI
            select BSP_USING_QSPI0
            default y

        config BOARD_USING_BUZZER
            bool "BUZZER.(over pwm0_ch1)"
            select BSP_USING_PWM
            select BSP_USING_PWM0
            default n

        config BOARD_USING_USB0_DEVICE_HOST
            select BSP_USING_USBH
            select BSP_USING_USBD
            bool "Enable USB0 Device/Host"
            help
                Choose this option if you need USB device or host function mode.
                    If you need USB host, please remember short to ground on JP1 jumper.

        config BOARD_USING_USB1_HOST
            select BSP_USING_USBH
            bool "Enable USB1 Host"
            help
                Choose this option if you need USB1 HOST.

    endmenu

    menu "Board extended module drivers"

        config BOARD_USING_LCM
            bool "Use LCD panel."
            default y

        if BOARD_USING_LCM

            choice
                prompt "Select LCD panel devices.(Over VPOST)"
                    default BOARD_USING_LCM_FW070TFT_WVGA

                config BOARD_USING_LCM_FW070TFT_WVGA
                    bool "NuDesign TFT-LCD7-WVGA"
                    select BSP_USING_VPOST
                    select LCM_USING_FW070TFT
                    help
                        Choose this option if you use 7" 800x480x32b LCD panel.

                config BOARD_USING_LCM_FW043TFT_HVGA
                    bool "NuDesign TFT-LCD43-HVGA"
                    select BSP_USING_VPOST
                    select LCM_USING_FW043TFT
                    help
                        Choose this option if you use 4.3" 480x272x32b LCD panel.

                config BOARD_USING_LCM_FW070TFT_WSVGA
                    bool "NuDesign TFT-LCD7-WSVGA"
                    select BSP_USING_VPOST
                    select LCM_USING_FW070TFT_WSVGA
                    help
                        Choose this option if you use 7" 1024x600x32b LCD panel.
            endchoice

            choice
                prompt "Select Touch devices."
                    default BOARD_USING_ADCTOUCH

                config BOARD_USING_ADCTOUCH
                    bool "ADC touching"
                    select BSP_USING_ADC_TOUCH
                    select NU_PKG_USING_ADC_TOUCH
                    help
                        Choose this option if you use internal ADC touching function.

                config BOARD_USING_GT911
                    bool "GT911 TSC"
                    select BSP_USING_I2C
                    select BSP_USING_I2C0
                    select NU_PKG_USING_TPC
                    select NU_PKG_USING_TPC_GT911
                    help
                        Choose this option if you use GT911 external TSC touching function.

                config BOARD_USING_FT5446
                    bool "FT5446 TSC"
                    select BSP_USING_I2C
                    select BSP_USING_I2C0
                    select NU_PKG_USING_TPC
                    select NU_PKG_USING_TPC_FT5446
                    help
                        Choose this option if you use FT5446 external TSC touching function.

            endchoice

        endif

    endmenu

    source "$(BSP_DIR)/../libraries/nu_packages/Kconfig"

endmenu
```

## bsp/nuvoton/nk-rtu980/board/Kconfig
```kconfig
menu "Hardware Drivers Config"

    menu "On-chip Peripheral Drivers"
        source "$BSP_DIR/../libraries/nuc980/rtt_port/Kconfig"
    endmenu

    menu "On-board Peripheral Drivers"

        config BSP_USING_CONSOLE
            bool "Enable UART0 for RTT Console(uart0)"
            select BSP_USING_UART
            select BSP_USING_UART0
            default y

        config BOARD_USING_UART8_RS485
            bool "Enable UART8 for RS485(AUD) communication(uart8)"
            select BSP_USING_UART
            select BSP_USING_UART8
            default y

        config BOARD_USING_STORAGE_SPIFLASH
            bool "SPI NOR FLASH supporting(over qspi0)"
            select BSP_USING_QSPI
            select BSP_USING_QSPI0
            default y

        config BOARD_USING_USB0_DEVICE_HOST
            select BSP_USING_USBH
            select BSP_USING_USBD
            bool "Enable USB0 Device/Host"
            help
                Choose this option if you need USB device or host function mode.
                    If you need USB host, please remember short to ground on JP1 jumper.

    endmenu

    menu "Board extended module drivers"

        config BOARD_USING_IP101GR
            bool "Enable ethernet phy supporting(over emac/mdio)"
            select BSP_USING_EMAC
            select BSP_USING_EMAC1
            default n

    endmenu


endmenu
```

## bsp/nuvoton/numaker-hmi-ma35d1/Kconfig
```kconfig
mainmenu "RT-Thread Configuration"

config BSP_DIR
    string
    option env="BSP_ROOT"
    default "."

config RTT_DIR
    string
    option env="RTT_ROOT"
    default "../../.."

# you can change the RTT_ROOT default "../../.." to your rtthread_root,
# example : default "F:/git_repositories/rt-thread"

config PKGS_DIR
    string
    option env="PKGS_ROOT"
    default "packages"

config USE_MA35D1_AARCH32
    bool
    default y

source "$RTT_DIR/Kconfig"
source "$PKGS_DIR/Kconfig"
source "$BSP_DIR/board/Kconfig"
```
