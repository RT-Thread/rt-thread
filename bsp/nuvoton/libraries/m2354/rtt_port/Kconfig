## bsp/nuvoton/libraries/m3331/rtt_port/Kconfig
```kconfig
config SOC_FAMILY_NUMICRO
    bool

config SOC_SERIES_M3331
    bool
    select ARCH_ARM
    select ARCH_ARM_CORTEX_M
    select ARCH_ARM_CORTEX_M33
    select ARCH_ARM_CORTEX_SECURE    
    select SOC_FAMILY_NUMICRO
    select RT_USING_COMPONENTS_INIT
    select RT_USING_USER_MAIN
    select PKG_USING_NUVOTON_SERIES_DRIVER
    default y

menuconfig BSP_USING_BPWM
    bool "Enable Basic PWM Generator and Capture Timer(BPWM)"
    select RT_USING_PWM

    if BSP_USING_BPWM
        config BSP_USING_BPWM_CAPTURE
            bool

        config BSP_USING_BPWM0
            bool "Enable BPWM0"
            select RT_USING_PWM
            depends on !BSP_USING_BPWM0_CAPTURE

        config BSP_USING_BPWM0_CAPTURE
            bool "Enable BPWM0_CAPTURE"
            select RT_USING_INPUT_CAPTURE
            select BSP_USING_BPWM_CAPTURE

        config BSP_USING_BPWM1
            bool "Enable BPWM1"
            select RT_USING_PWM
            depends on !BSP_USING_BPWM1_CAPTURE

        config BSP_USING_BPWM1_CAPTURE
            bool "Enable BPWM1_CAPTURE"
            select RT_USING_INPUT_CAPTURE
            select BSP_USING_BPWM_CAPTURE

        config BSP_USING_BPWM2
            bool "Enable BPWM2"
            select RT_USING_PWM
            depends on !BSP_USING_BPWM2_CAPTURE

        config BSP_USING_BPWM2_CAPTURE
            bool "Enable BPWM2_CAPTURE"
            select RT_USING_INPUT_CAPTURE
            select BSP_USING_BPWM_CAPTURE

        config BSP_USING_BPWM3
            bool "Enable BPWM3"
            select RT_USING_PWM
            depends on !BSP_USING_BPWM3_CAPTURE

        config BSP_USING_BPWM3_CAPTURE
            bool "Enable BPWM3_CAPTURE"
            select RT_USING_INPUT_CAPTURE
            select BSP_USING_BPWM_CAPTURE

        config BSP_USING_BPWM4
            bool "Enable BPWM4"
            select RT_USING_PWM
            depends on !BSP_USING_BPWM4_CAPTURE

        config BSP_USING_BPWM4_CAPTURE
            bool "Enable BPWM4_CAPTURE"
            select RT_USING_INPUT_CAPTURE
            select BSP_USING_BPWM_CAPTURE

        config BSP_USING_BPWM5
            bool "Enable BPWM5"
            select RT_USING_PWM
            depends on !BSP_USING_BPWM5_CAPTURE

        config BSP_USING_BPWM5_CAPTURE
            bool "Enable BPWM5_CAPTURE"
            select RT_USING_INPUT_CAPTURE
            select BSP_USING_BPWM_CAPTURE
    endif

menuconfig BSP_USING_CANFD
    bool "Enable Controller Area Network Flexible Data-Rate Controller(CANFD)"
    select RT_USING_CAN

    if BSP_USING_CANFD
        config BSP_USING_CANFD0
            bool "Enable CANFD0"

        config BSP_USING_CANFD1
            bool "Enable CANFD1"
    endif

menuconfig BSP_USING_CLK
    bool "Enable Clock Controller(CLK)"
    select RT_USING_PM
    select BSP_USING_TMR
    default y
    help
        Choose this option if you need CLK function.

menuconfig BSP_USING_CRC
    bool "Enable Cyclic Redundancy Check Generator(CRC)"

    if BSP_USING_CRC
        config BSP_USING_CRC0
            bool "Enable CRC0"
    endif

menuconfig BSP_USING_CRYPTO
    bool "Enable Cryptographic Accelerator(CRYPTO)"

    if BSP_USING_CRYPTO
        config BSP_USING_CRYPTO0
            bool "Enable CRYPTO0"
    endif

menuconfig BSP_USING_EADC
    bool "Enable Enhanced Analog-to-Digital Converter(EADC)"
    select RT_USING_ADC

    if BSP_USING_EADC
        config BSP_USING_EADC0
            bool "Enable EADC0"
    endif

menuconfig BSP_USING_EBI
    bool "Enable External Bus Interface(EBI)"

menuconfig BSP_USING_EPWM
    bool "Enable Enhanced PWM Generator and Capture Timer(EPWM)"
    select RT_USING_PWM

    if BSP_USING_EPWM
        config BSP_USING_EPWM_CAPTURE
            bool

        config BSP_USING_EPWM0
            bool "Enable EPWM0"
            select RT_USING_PWM
            depends on !BSP_USING_EPWM0_CAPTURE

        config BSP_USING_EPWM0_CAPTURE
            bool "Enable EPWM0_CAPTURE"
            select RT_USING_INPUT_CAPTURE
            select BSP_USING_EPWM_CAPTURE

        config BSP_USING_EPWM1
            bool "Enable EPWM1"
            select RT_USING_PWM
            depends on !BSP_USING_EPWM1_CAPTURE

        config BSP_USING_EPWM1_CAPTURE
            bool "Enable EPWM1_CAPTURE"
            select RT_USING_INPUT_CAPTURE
            select BSP_USING_EPWM_CAPTURE
    endif

menuconfig BSP_USING_EQEI
    bool "Enable Enhanced Quadrature Encoder Interface(EQEI)"

    if BSP_USING_EQEI
        config BSP_USING_EQEI0
            bool "Enable EQEI0"

        config BSP_USING_EQEI1
            bool "Enable EQEI1"

        config BSP_USING_EQEI2
            bool "Enable EQEI2"

        config BSP_USING_EQEI3
            bool "Enable EQEI3"
    endif

menuconfig BSP_USING_FMC
    bool "Enable Flash Memory Controller(FMC)"
    select RT_USING_FAL

menuconfig BSP_USING_GPIO
    bool "Enable General Purpose I/O(GPIO)"
    select RT_USING_PIN
    default y

menuconfig BSP_USING_I2C
    bool "Enable Inter-Integrated Circuit(I2C)"
    select RT_USING_I2C
    select RT_USING_BITOPS

    if BSP_USING_I2C
        config BSP_USING_I2C0
            bool "Enable I2C0"

        config BSP_USING_I2C1
            bool "Enable I2C1"

        config BSP_USING_I2C2
            bool "Enable I2C2"

        config BSP_USING_I2C3
            bool "Enable I2C3"
    endif

menuconfig BSP_USING_LPADC
    bool "Enable Low Power Analog-to-Digital Converter(LPADC)"
    select RT_USING_ADC

    if BSP_USING_LPADC
        config BSP_USING_LPADC0
            bool "Enable LPADC0"
    endif

menuconfig BSP_USING_LPTMR
    bool "Enable Low Power Timer(LPTMR)"

    if BSP_USING_LPTMR
        config BSP_USING_LPTMR0
            bool "Enable LPTMR0"

        config BSP_USING_LPTMR1
            bool "Enable LPTMR1"
    endif

menuconfig BSP_USING_PDMA
    bool "Enable Peripheral Direct Memory Access(PDMA)"

    if BSP_USING_PDMA
        config BSP_USING_PDMA0
            bool "Enable PDMA0"

        config NU_PDMA_SGTBL_POOL_SIZE
            int "The size of PDMA scatter-gather tables pool."
            default 16

        config NU_PDMA_MEMFUN_ACTOR_MAX
            int "The maximal actor number of PDMA memory function."
            range 0 2
            default 2
    endif

menuconfig BSP_USING_QSPI
    bool "Enable Quad Serial Peripheral Interface(QSPI)"
    select RT_USING_QSPI

    if BSP_USING_QSPI
        config BSP_USING_QSPI0
            bool "Enable QSPI0"

        if BSP_USING_QSPI0
            config BSP_USING_QSPI0_PDMA
                bool "Enable PDMA for QSPI0"
                select BSP_USING_SPI_PDMA
        endif
    endif

menuconfig BSP_USING_RTC
    bool "Enable Real Time Clock(RTC)"
    select RT_USING_RTC

    if BSP_USING_RTC
        config BSP_USING_RTC_INTERNAL
            bool "Enable Internal RTC"
    endif

menuconfig BSP_USING_SC
    bool "Enable Smart Card Interface(SC)"

    if BSP_USING_SC
        config BSP_USING_SC0
            bool "Enable SC0"

        config BSP_USING_SC1
            bool "Enable SC1"

        config BSP_USING_SC2
            bool "Enable SC2"
    endif

menuconfig BSP_USING_SPI
    bool "Enable Serial Peripheral Interface(SPI)"
    select RT_USING_SPI

    if BSP_USING_SPI
        config BSP_USING_SPI_PDMA
            bool

        config BSP_USING_SPII2S
            bool

        if BSP_USING_SPI
            config BSP_USING_SPI0
                bool "Enable SPI0"
                select RT_USING_SPI
                depends on !BSP_USING_SPII2S0

            config BSP_USING_SPII2S0
                bool "Enable SPII2S0"
                select RT_USING_AUDIO
                select BSP_USING_SPII2S

            if BSP_USING_SPI0
                config BSP_USING_SPI0_PDMA
                    bool "Enable PDMA for SPI0"
                    select BSP_USING_SPI_PDMA
            endif

            config BSP_USING_SPI1
                bool "Enable SPI1"
                select RT_USING_SPI
                depends on !BSP_USING_SPII2S1

            config BSP_USING_SPII2S1
                bool "Enable SPII2S1"
                select RT_USING_AUDIO
                select BSP_USING_SPII2S

            if BSP_USING_SPI1
                config BSP_USING_SPI1_PDMA
                    bool "Enable PDMA for SPI1"
                    select BSP_USING_SPI_PDMA
            endif

            config BSP_USING_SPI2
                bool "Enable SPI2"
                select RT_USING_SPI
                depends on !BSP_USING_SPII2S2

            config BSP_USING_SPII2S2
                bool "Enable SPII2S2"
                select RT_USING_AUDIO
                select BSP_USING_SPII2S

            if BSP_USING_SPI2
                config BSP_USING_SPI2_PDMA
                    bool "Enable PDMA for SPI2"
                    select BSP_USING_SPI_PDMA
            endif
        endif
    endif

menuconfig BSP_USING_TMR
    bool "Enable Timer(TMR)"

    if BSP_USING_TMR
        config BSP_USING_TIMER
            bool

        config BSP_USING_TPWM
            bool

        config BSP_USING_TMR0
            bool "Enable TIMER0"
            depends on BSP_USING_TMR

        if BSP_USING_TMR0
            config BSP_USING_TIMER0
                bool "TIMER"
                select BSP_USING_TIMER
                select RT_USING_HWTIMER
                depends on !BSP_USING_TPWM0

            config BSP_USING_TPWM0
                bool "TIMER PWM"
                select BSP_USING_TPWM
                select RT_USING_PWM
        endif

        config BSP_USING_TMR1
            bool "Enable TIMER1"
            depends on BSP_USING_TMR

        if BSP_USING_TMR1
            config BSP_USING_TIMER1
                bool "TIMER"
                select BSP_USING_TIMER
                select RT_USING_HWTIMER
                depends on !BSP_USING_TPWM1

            config BSP_USING_TPWM1
                bool "TIMER PWM"
                select BSP_USING_TPWM
                select RT_USING_PWM
        endif

        config BSP_USING_TMR2
            bool "Enable TIMER2"
            depends on BSP_USING_TMR

        if BSP_USING_TMR2
            config BSP_USING_TIMER2
                bool "TIMER"
                select BSP_USING_TIMER
                select RT_USING_HWTIMER
                depends on !BSP_USING_TPWM2

            config BSP_USING_TPWM2
                bool "TIMER PWM"
                select BSP_USING_TPWM
                select RT_USING_PWM
        endif

        config BSP_USING_TMR3
            bool "Enable TIMER3"
            depends on BSP_USING_TMR

        if BSP_USING_TMR3
            config BSP_USING_TIMER3
                bool "TIMER"
                select BSP_USING_TIMER
                select RT_USING_HWTIMER
                depends on !BSP_USING_TPWM3

            config BSP_USING_TPWM3
                bool "TIMER PWM"
                select BSP_USING_TPWM
                select RT_USING_PWM
        endif
    endif

menuconfig BSP_USING_UART
    bool "Enable Universal Asynchronous Receiver/Transmitter(UART)"
    select RT_USING_SERIAL
    default y

    if BSP_USING_UART
        config BSP_USING_UART0
            bool "Enable UART0"
            default y

        config BSP_USING_UART1
            bool "Enable UART1"

        config BSP_USING_UART2
            bool "Enable UART2"

        config BSP_USING_UART3
            bool "Enable UART3"

        config BSP_USING_UART4
            bool "Enable UART4"

        config BSP_USING_UART5
            bool "Enable UART5"
    endif

menuconfig BSP_USING_USCI
    bool "Enable Universal Serial Control Interface(USCI)"

    if BSP_USING_USCI
        config BSP_USING_UUART
            bool

        config BSP_USING_USPI
            bool

        config BSP_USING_USPI_PDMA
            bool
            default n

        config BSP_USING_UI2C
            bool

        config BSP_USING_USCI0
            bool "Enable USCI0"

        config BSP_USING_USCI1
            bool "Enable USCI1"

        if BSP_USING_USCI0
            config BSP_USING_UUART0
                bool "UUART0"
                select RT_USING_SERIAL
                select BSP_USING_UUART

            config BSP_USING_UI2C0
                bool "UI2C0"
                select RT_USING_I2C
                select BSP_USING_UI2C
                depends on !BSP_USING_UUART0

            config BSP_USING_USPI0
                bool "USPI0"
                select RT_USING_SPI
                select BSP_USING_USPI
                depends on !BSP_USING_UUART0 && !BSP_USING_UI2C0

            config BSP_USING_UUART0_TX_DMA
                bool "Enable UUART0 TX DMA"
                depends on BSP_USING_UUART0 && RT_SERIAL_USING_DMA

            config BSP_USING_UUART0_RX_DMA
                bool "Enable UUART0 RX DMA"
                depends on BSP_USING_UUART0 && RT_SERIAL_USING_DMA

            config BSP_USING_USPI0_PDMA
                bool "Use PDMA for data transferring"
                select BSP_USING_USPI_PDMA
                depends on BSP_USING_USPI0
        endif

        if BSP_USING_USCI1
            config BSP_USING_UUART1
                bool "UUART1"
                select RT_USING_SERIAL
                select BSP_USING_UUART

            config BSP_USING_UI2C1
                bool "UI2C1"
                select RT_USING_I2C
                select BSP_USING_UI2C
                depends on !BSP_USING_UUART1

            config BSP_USING_USPI1
                bool "USPI1"
                select RT_USING_SPI
                select BSP_USING_USPI
                depends on !BSP_USING_UUART1 && !BSP_USING_UI2C1

            config BSP_USING_UUART1_TX_DMA
                bool "Enable UUART1 TX DMA"
                depends on BSP_USING_UUART1 && RT_SERIAL_USING_DMA

            config BSP_USING_UUART1_RX_DMA
                bool "Enable UUART1 RX DMA"
                depends on BSP_USING_UUART1 && RT_SERIAL_USING_DMA

            config BSP_USING_USPI1_PDMA
                bool "Use PDMA for data transferring"
                select BSP_USING_USPI_PDMA
                depends on BSP_USING_USPI1
        endif
    endif

config BSP_USING_HSUSBD
    bool "Enable High-Speed USB Device Controller(HSUSBD)"

config BSP_USING_HSUSBH
    bool "Enable High-Speed USB Host Controller(HSUSBH)"

config BSP_USING_HSOTG
    bool "Enable High-Speed USB On-The-Go(HSOTG)"
    select BSP_USING_HSUSBH
    select BSP_USING_HSUSBD

config BSP_USING_WDT
    bool "Enable Watchdog Timer(WDT)"
    select RT_USING_WDT
```
