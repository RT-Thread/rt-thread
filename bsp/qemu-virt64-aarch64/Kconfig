## bsp/qemu-virt64-aarch64/Kconfig
```kconfig
mainmenu "RT-Thread Project Configuration"

BSP_DIR := .

RTT_DIR := ../../

PKGS_DIR := packages

source "$(RTT_DIR)/Kconfig"
osource "$PKGS_DIR/Kconfig"

config SOC_VIRT64_AARCH64
    bool
    select ARCH_ARMV8
    select RT_USING_COMPONENTS_INIT
    select RT_USING_USER_MAIN
    select ARCH_CPU_64BIT
    select RT_USING_CACHE
    select RT_USING_STDC_ATOMIC
    default y
```

## bsp/qemu-virt64-aarch64/driver/Kconfig
```kconfig
menu "AARCH64 qemu virt64 configs"

    menuconfig BSP_USING_UART
        bool "Using UART"
        select RT_USING_SERIAL
        default y

        if BSP_USING_UART
            config RT_USING_UART0
            bool "Enabel UART 0"
            default y
        endif


    menuconfig BSP_USING_RTC
            bool "Using RTC"
            select RT_USING_RTC
            default y

        if BSP_USING_RTC
            config BSP_USING_ALARM
                bool "Enable Alarm"
                select RT_USING_ALARM
                default n
        endif

    menuconfig BSP_USING_VIRTIO_BLK
        bool "Using VirtIO BLK"
        default y

    config BSP_USING_GIC
    bool
    default y

    choice
        prompt "GIC Version"
        default BSP_USING_GICV2

        config BSP_USING_GICV2
            bool "GICv2"

        config BSP_USING_GICV3
            bool "GICv3"
    endchoice

endmenu
```

## bsp/qemu-virt64-aarch64/drivers/Kconfig
```kconfig
config RT_GRAPHIC_ROMFB_WIDTH
    int "ROM FB width"
    depends on RT_GRAPHIC_FB
    default 800

config RT_GRAPHIC_ROMFB_HEIGHT
    int "ROM FB height"
    depends on RT_GRAPHIC_FB
    default 600

config RT_SOC_CAMERA
    bool "Camera"
    depends on RT_GRAPHIC_FB
    depends on RT_USING_PCI
    default y
```

## bsp/qemu-virt64-riscv/packages/Kconfig
```kconfig
config PKG_USING_LVGL
    bool "LVGL: powerful and easy-to-use embedded GUI library"
    default n
    help
        LVGL is a free and open-source embedded graphic library.

if PKG_USING_LVGL

config PKG_LVGL_THREAD_STACK_SIZE
    int "LVGL thread stack size"
    default 8192

config PKG_LVGL_THREAD_PRIO
    int "LVGL thread priority"
    default 10

config PKG_LVGL_DISP_REFR_PERIOD
    int "LVGL display refresh period (ms)"
    default 33

endif
```

## bsp/qemu-xuantie-riscv/c910/Kconfig
```kconfig
mainmenu "RT-Thread Project Configuration"

BSP_DIR := .

RTT_DIR := ../../..

PKGS_DIR := packages

source "$(RTT_DIR)/Kconfig"
osource "$PKGS_DIR/Kconfig"
rsource "board/Kconfig"

config BSP_USING_XIAOHUI
    bool
    select ARCH_RISCV64
    select ARCH_RISCV_FPU_D
    select ARCH_USING_RISCV_COMMON64
    select RT_USING_SYSTEM_WORKQUEUE
    select RT_USING_COMPONENTS_INIT
    select RT_USING_USER_MAIN

    default y

config BSP_PLIC_PHY_ADDR
    hex
    default 0x70000000

config IRQ_MAX_NR
    int 
    default 61

config BSP_UART_FREQ
    int
    default 36000000

config IRQ_MAX_NR
    int
    default 101

config __STACKSIZE__
    int "stack size for interrupt"
    default 4096
```

## bsp/qemu-xuantie-riscv/c910/board/Kconfig
```kconfig
menu "xuantie qemu virt64 configs"
    menuconfig BSP_SUPPORT_FPU
        bool "Using Float"
        default y

    menuconfig BSP_USING_UART
        bool "Using UART"
        select RT_USING_SERIAL
        default y

        if BSP_USING_UART
            config RT_USING_UART0
            bool "Enabel UART 0"
            default y
        endif

endmenu
```

## bsp/qemu-zynqmp-r5/drivers/Kconfig
```kconfig
menu "Hardware Drivers Config"

	config SOC_ZYNQMP_R5
		bool
    	select RT_USING_CACHE
    	select RT_USING_COMPONENTS_INIT
    	select RT_USING_USER_MAIN
    	default y

    menu "On-Chip Peripheral Drivers"

		config BSP_USING_UART0
		bool "Enable UART0"
		default y

	endmenu

endmenu
```

## bsp/ra6m4-cpk/Kconfig
```kconfig
mainmenu "RT-Thread Configuration"

config BSP_DIR
    string
    option env="BSP_ROOT"
    default "."

config RTT_DIR
    string
    option env="RTT_ROOT"
    default "../.."
    
# you can change the RTT_ROOT default "../.." to your rtthread_root,
# example : default "F:/git_repositories/rt-thread"

config PKGS_DIR
    string
    option env="PKGS_ROOT"
    default "packages"
    
config ENV_DIR
    string
    option env="ENV_ROOT"
    default "/"

source "$RTT_DIR/Kconfig"
source "$PKGS_DIR/Kconfig"
source "$BSP_DIR/drivers/Kconfig"

config SOC_FAMILY_RENESAS
    bool
    default y

config SOC_SERIES_R7FA6M4AF
    bool
    select ARCH_ARM_CORTEX_M4
    select SOC_FAMILY_RENESAS
    default y
```

## bsp/ra6m4-cpk/drivers/Kconfig
```kconfig
menu "Hardware Drivers Config"

    config SOC_SERIES_R7FA6M4AF
        bool
        select RT_USING_COMPONENTS_INIT
        select RT_USING_USER_MAIN
        default y

    menu "Onboard Peripheral Drivers"

    endmenu

    menu "On-chip Peripheral Drivers"

        config BSP_USING_GPIO
            bool "Enable GPIO"
            select RT_USING_PIN
            default y

        config BSP_USING_ONCHIP_FLASH
            bool "Enable Onchip FLASH"
            default n

        config BSP_USING_WDT
            bool "Enable Watchdog Timer"
            select RT_USING_WDT
            default n

        menuconfig BSP_USING_UART
            bool "Enable UART"
            default y
            select RT_USING_SERIAL
            select RT_USING_SERIAL_V2
            if BSP_USING_UART
                menuconfig BSP_USING_UART7
                    bool "Enable UART7 (Console)"
                    default y
                    if BSP_USING_UART7
                        config BSP_UART7_RX_USING_DMA
                            bool "Enable UART7 RX DMA"
                            depends on BSP_USING_UART7 && RT_SERIAL_USING_DMA
                            default n

                        config BSP_UART7_TX_USING_DMA
                            bool "Enable UART7 TX DMA"
                            depends on BSP_USING_UART7 && RT_SERIAL_USING_DMA
                            default n

                        config BSP_UART7_RX_BUFSIZE
                            int "Set UART7 RX buffer size"
                            range 64 65535
                            depends on RT_USING_SERIAL_V2
                            default 256

                        config BSP_UART7_TX_BUFSIZE
                            int "Set UART7 TX buffer size"
                            range 0 65535
                            depends on RT_USING_SERIAL_V2
                            default 0
                    endif
            endif

        menuconfig BSP_USING_I2C
            bool "Enable I2C BUS"
            default n
            select RT_USING_I2C
            select RT_USING_I2C_BITOPS
            select RT_USING_PIN
            if BSP_USING_I2C
                menuconfig BSP_USING_I2C1
                    bool "Enable I2C1 BUS (software simulation)"
                    default y
                    if BSP_USING_I2C1
                        config BSP_I2C1_SCL_PIN
                            int "i2c1 scl pin number"
                            range 0x0000 0x0B0F
                            default 0x0512
                        config BSP_I2C1_SDA_PIN
                            int "I2C1 sda pin number"
                            range 0x0000 0x0B0F
                            default 0x0511
                    endif
            endif

        menuconfig BSP_USING_ONCHIP_RTC
            bool "Enable RTC"
            select RT_USING_RTC
            default n
            if BSP_USING_ONCHIP_RTC
            endif

        menuconfig BSP_USING_SPI
            bool "Enable SPI BUS"
            default n
            select RT_USING_SPI
            if BSP_USING_SPI
                config BSP_SPI_USING_DTC_DMA
                    bool "Enable SPI DTC transfers data without using the CPU."
                    default n

                config BSP_USING_SPI0
                    bool "Enable SPI0 BUS"
                    default n
        
                config BSP_USING_SPI1
                    bool "Enable SPI1 BUS"
                    default n
            endif

        menuconfig BSP_USING_ADC
            bool "Enable ADC"
            default n
            select RT_USING_ADC
            if BSP_USING_ADC
                config BSP_USING_ADC0
                    bool "Enable ADC0"
                    default n

                config BSP_USING_ADC1
                    bool "Enable ADC1"
                    default n
            endif

        menuconfig BSP_USING_DAC
            bool "Enable DAC"
            default n
            select RT_USING_DAC
            if BSP_USING_DAC
                config BSP_USING_DAC0
                    bool "Enable DAC0"
                    default n

                config BSP_USING_DAC1
                    bool "Enable DAC1"
                    default n
            endif

        menuconfig BSP_USING_PWM
            bool "Enable PWM"
            default n
            select RT_USING_PWM
            if BSP_USING_PWM
                config BSP_USING_PWM0
                    bool "Enable GPT0 (32-Bits) output PWM"
                    default n
                
                config BSP_USING_PWM1
                    bool "Enable GPT1 (32-Bits) output PWM"
                    default n

                config BSP_USING_PWM2
                    bool "Enable GPT2 (32-Bits) output PWM"
                    default n

                config BSP_USING_PWM3
                    bool "Enable GPT3 (32-Bits) output PWM"
                    default n

                config BSP_USING_PWM4
                    bool "Enable GPT4 (16-Bits) output PWM"
                    default n

                config BSP_USING_PWM5
                    bool "Enable GPT5 (16-Bits) output PWM"
                    default n

                config BSP_USING_PWM6
                    bool "Enable GPT6 (16-Bits) output PWM"
                    default n

                config BSP_USING_PWM7
                    bool "Enable GPT7 (16-Bits) output PWM"
                    default n

                config BSP_USING_PWM8
                    bool "Enable GPT8 (16-Bits) output PWM"
                    default n

                config BSP_USING_PWM9
                    bool "Enable GPT9 (16-Bits) output PWM"
                    default n
            endif

    endmenu

    menu "Board extended module Drivers"

    endmenu
endmenu
```

## bsp/raspberry-pi/raspi-dm2.0/drivers/Kconfig
```kconfig
menu "Hardware Drivers Config"
     config BSP_USING_PL011
        bool "Enable pl011 for uart"
        default n

    config BSP_USING_SDHCI
        bool "Enable sdhci driver"
        select RT_USING_SDHCI
        default y
    rsource sdhci/Kconfig
endmenu
```

## bsp/raspberry-pi/raspi-dm2.0/drivers/sdhci/Kconfig
```kconfig
menuconfig RT_USING_SDHCI
    bool "Using sdhci for sd/mmc drivers"
    default n
```

## bsp/raspberry-pi/raspi-pico/Kconfig
```kconfig
mainmenu "RT-Thread Configuration"

config BSP_DIR
    string
    option env="BSP_ROOT"
    default "."

config RTT_DIR
    string
    option env="RTT_ROOT"
    default "../../.."

config PKGS_DIR
    string
    option env="PKGS_ROOT"
    default "packages"
 
source "$RTT_DIR/Kconfig"
source "$PKGS_DIR/Kconfig"
source "board/Kconfig"

config SOC_SERIES_RP2040
    bool
    select ARCH_ARM_CORTEX_M0

config BOARD_RASPBERRYPI_PICO
    bool
    select SOC_SERIES_RP2040
    select RT_USING_COMPONENTS_INIT
    select RT_USING_USER_MAIN
    select PKG_USING_RASPBERRYPI_PICO_SDK
    default y
```

## bsp/raspberry-pi/raspi-pico/board/Kconfig
```kconfig
menu "Hardware Drivers Config"

menu "Onboard Peripheral Drivers"

    config BSP_USING_LVGL
        bool "Enable LVGL for LCD"
        select PKG_USING_LVGL
        select BSP_USING_SPI_LCD
        default n

    if BSP_USING_LVGL
        config BSP_USING_LVGL_DEMO
            bool "Enable LVGL demo"
            select PKG_USING_LV_MUSIC_DEMO
            default n
    endif
endmenu         

endmenu   
```

## bsp/raspberry-pi/raspi-pico/drivers/Kconfig
```kconfig
config SOC_SERIES_RP2040
    bool
    select ARCH_ARM_CORTEX_M0

config BOARD_RASPBERRYPI_PICO
    bool
    select SOC_SERIES_RP2040
    select RT_USING_COMPONENTS_INIT
    select RT_USING_USER_MAIN
    select PKG_USING_RASPBERRYPI_PICO_SDK
    default y

menu "Hardware Drivers Config"

menu "Onboard Peripheral Drivers"

    config BSP_USING_LVGL
        bool "Enable LVGL for LCD"
        select PKG_USING_LVGL
        select BSP_USING_SPI_LCD
        default n

    if BSP_USING_LVGL
        config BSP_USING_LVGL_DEMO
            bool "Enable LVGL demo"
            select PKG_USING_LV_MUSIC_DEMO
            default n
    endif
endmenu         

endmenu   
```

## bsp/raspberry-pi/raspi2/Kconfig
```kconfig
mainmenu "RT-Thread Project Configuration"

BSP_DIR := .

RTT_DIR := ../../..

PKGS_DIR := packages

source "$(RTT_DIR)/Kconfig"
osource "$PKGS_DIR/Kconfig"

config BCM2836_SOC
    bool
    select ARCH_ARM_CORTEX_A7
    select RT_USING_COMPONENTS_INIT
    select RT_USING_USER_MAIN
    default y

rsource "driver/Kconfig"
```

## bsp/raspberry-pi/raspi3-32/Kconfig
```kconfig
mainmenu "RT-Thread Project Configuration"

BSP_DIR := .

RTT_DIR := ../../..

PKGS_DIR := packages

source "$(RTT_DIR)/Kconfig"
osource "$PKGS_DIR/Kconfig"

config BCM2836_SOC
    bool
    select RT_USING_COMPONENTS_INIT
    select RT_USING_USER_MAIN
    default y

rsource "driver/Kconfig"
```

## bsp/raspberry-pi/raspi3-64/Kconfig
```kconfig
mainmenu "RT-Thread Project Configuration"

BSP_DIR := .

RTT_DIR := ../../..

PKGS_DIR := packages

source "$(RTT_DIR)/Kconfig"
osource "$PKGS_DIR/Kconfig"

config BCM2836_SOC
    bool
    select ARCH_ARMV8
    select RT_USING_COMPONENTS_INIT
    select RT_USING_USER_MAIN
    select ARCH_CPU_64BIT
    select RT_USING_CACHE
    select SOC_BCM283x
    default y

config SOC_BCM283x
    bool
    default y

rsource "driver/Kconfig"
```
