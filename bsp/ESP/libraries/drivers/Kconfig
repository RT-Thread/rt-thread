## bsp/allwinner/dm/nvmem/Kconfig
```kconfig
config RT_NVMEM_SUNXI_SID
    bool "Allwinner Sunxi SID eFuse"
    depends on RT_USING_NVMEM
    default n
    help
      Enable read-only access to the Allwinner SID eFuse controller.

      Programming eFuse bits is intentionally not exposed by this driver.
```

## bsp/allwinner/dm/pinctrl/Kconfig
```kconfig
config RT_PINCTRL_SUN50I_H616
    bool "Allwinner H616 main pin controller"
    depends on RT_USING_PINCTRL && RT_USING_OFW
    default n
    help
      Provide main PIO GPIO and UART/TWI/MMC/SPI pin multiplexing.
      Includes main PIO interrupts and always-on R_PIO pin multiplexing.
      Keep firmware-programmed bank supply voltages unchanged.

config RT_PINCTRL_SUN252I_F101
    bool "Allwinner Sun252i F101 pin controller"
    depends on RT_USING_PINCTRL
    depends on RT_USING_OFW
    default n
```

## bsp/allwinner/dm/pwm/Kconfig
```kconfig
config RT_PWM_SUNXI
    bool "Allwinner Sunxi PWM controller"
    depends on RT_USING_DM
    depends on RT_USING_CLK
    depends on RT_USING_PWM
    depends on RT_USING_RESET
    default n
```

## bsp/allwinner/dm/reset/Kconfig
```kconfig
config RT_RESET_SUN252I_F101
    bool "Allwinner Sun252i F101 reset controller"
    depends on RT_USING_RESET
    depends on RT_USING_OFW
    depends on RT_CLK_SUN252I_F101
    default n
```

## bsp/allwinner/dm/rtc/Kconfig
```kconfig
config RT_RTC_SUNXI
    bool "Allwinner Sunxi RTC"
    depends on RT_USING_DM
    depends on RT_USING_RTC
    depends on RT_USING_ALARM
    default n
    help
      Enable the RTC and alarm controller found on supported Allwinner SoCs.
```

## bsp/allwinner/dm/sdio/Kconfig
```kconfig
config RT_SDIO_SUNXI
    bool "Allwinner Sunxi MMC controller"
    depends on RT_USING_SDIO
    depends on RT_USING_DM
    depends on RT_USING_CLK
    depends on RT_USING_RESET
    default n
```

## bsp/allwinner/dm/soc/Kconfig
```kconfig
config RT_SOC_SUNXI_G2D
    bool "Allwinner RCQ G2D graphics accelerator"
    depends on RT_USING_OFW
    depends on RT_USING_DMA
    depends on RT_USING_CLK
    depends on RT_USING_RESET
    default y
    help
      Enable the RCQ command-queue transport used by supported Allwinner
      Sunxi G2D blocks. The driver owns the hardware
      resources and provides DMA buffer management plus synchronous RCQ
      submission.

config RT_SOC_SUNXI_JPEG_DEC
    bool "Allwinner VE JPEG/MJPEG decoder"
    depends on RT_USING_OFW
    depends on RT_USING_DMA
    depends on RT_USING_CLK
    depends on RT_USING_RESET
    help
      Enable the baseline JPEG and MJPEG decoder in the Allwinner Video
      Engine. The jpegd device accepts DMA buffers and produces MB32 4:2:0
      reconstruction surfaces.

config RT_SOC_SUNXI_JPEG_ENC
    bool "Allwinner VE JPEG/MJPEG encoder"
    depends on RT_USING_OFW
    depends on RT_USING_DMA
    depends on RT_USING_CLK
    depends on RT_USING_RESET
    help
      Enable the baseline JPEG encoder in the Allwinner Video Engine. The
      jpege device accepts contiguous NV12 frames and produces JPEG streams.

config RT_SOC_SUNXI_PNG_DEC
    bool "Allwinner VE PNG decoder"
    depends on RT_USING_OFW
    depends on RT_USING_DMA
    depends on RT_USING_CLK
    depends on RT_USING_RESET
    help
      Enable the PNG decoder in the Allwinner Video Engine. The pngd device
      accepts complete, non-interlaced 8-bit RGB or RGBA PNG streams and
      produces RGBA8888 frames.

config RT_SOC_SUNXI_H264_DEC
    bool "Allwinner VE H.264 decoder"
    depends on RT_USING_OFW
    depends on RT_USING_DMA
    depends on RT_USING_CLK
    depends on RT_USING_RESET
    default y
    help
      Enable the H.264 video decoder. The driver uses the Video Engine
      clocks, reset, interrupt and dedicated SRAM described by the device
      tree, and accepts progressive Annex-B H.264 access units through the
      vdec API. The current implementation accepts one-slice I/P pictures
      using pic_order_cnt_type 0 or 2; B pictures, field pictures and stream
      reconfiguration return -ENOTSUP.
      Codecs share one VE resource owner at runtime. H.264 holds the
      engine until stream close; JPEG/PNG tasks return busy while it is held.
      JPEG, PNG and H.264 may be built into the same firmware.
```

## bsp/allwinner/dm/spi/Kconfig
```kconfig
config RT_SPI_SUNXI
    bool "Allwinner Sunxi SPI controller"
    depends on RT_USING_SPI
    depends on RT_USING_DM
    depends on RT_USING_CLK
    depends on RT_USING_RESET
    default n

config RT_QSPI_SUNXI
    bool "Allwinner Sunxi QSPI controller mode"
    depends on RT_USING_QSPI
    select RT_SPI_SUNXI
    default n
```

## bsp/allwinner/dm/thermal/Kconfig
```kconfig
config RT_THERMAL_SUNXI
    bool "Allwinner Sunxi thermal sensor"
    depends on RT_USING_CLK
    depends on RT_USING_NVMEM
    depends on RT_USING_RESET
    depends on RT_USING_THERMAL
    default n

config RT_THERMAL_SUN50I_H616
    bool "Allwinner H616 thermal sensors"
    depends on RT_USING_CLK && RT_USING_NVMEM && RT_USING_RESET
    depends on RT_USING_THERMAL
    select RT_NVMEM_SUNXI_SID
    select RT_USING_MFD
    select RT_MFD_SYSCON
    default n
```

## bsp/allwinner/dm/usb/Kconfig
```kconfig
config RT_USB_SUNXI_MUSB
    bool "Allwinner Sunxi MUSB device glue"
    depends on RT_USING_CHERRYUSB
    depends on RT_CHERRYUSB_DEVICE
    depends on RT_CHERRYUSB_DEVICE_MUSB_SUNXI
    depends on RT_USING_DM
    depends on RT_USING_CLK
    depends on RT_USING_RESET
    select RT_USING_MFD
    select RT_MFD_SYSCON
    default y
```

## bsp/allwinner/dm/watchdog/Kconfig
```kconfig
config RT_WDT_SUNXI
    bool "Allwinner Sunxi watchdog"
    depends on RT_USING_DM
    depends on RT_USING_WDT
    default n
```

## bsp/allwinner/f101/Kconfig
```kconfig
mainmenu "Allwinner F101 BSP Configuration"

BSP_DIR := .

RTT_DIR := ../../..

PKGS_DIR := packages

SOC_DM_DIR := $BSP_DIR/../dm/

source "$(SOC_DM_DIR)/Kconfig"

source "$(RTT_DIR)/Kconfig"
osource "$PKGS_DIR/Kconfig"

config SOC_ALLWINNER_F101
    bool
    select ARCH_RISCV
    select ARCH_RISCV32
    select ARCH_RISCV_FPU_D
    select RT_USING_HW_ATOMIC
    select RT_USING_CACHE
    select RT_USING_RISCV_NEW_COMMON
    select RT_USING_COMPONENTS_INIT
    select RT_USING_USER_MAIN
    default y

choice
    prompt "Allwinner F101 SBC"
    default SBC_YUZUKINEKO
    depends on SOC_ALLWINNER_F101

config SBC_YUZUKINEKO
    bool "YuzukiNeko"
    select RT_USING_DM
    select RT_USING_OFW
    select RT_USING_BUILTIN_FDT

endchoice

if SBC_YUZUKINEKO
    source "f101-yuzukineko.Kconfig"
endif
```
