## components/libc/cplusplus/Kconfig
```kconfig
menuconfig RT_USING_CPLUSPLUS
    bool "Enable C++ features"
    default n

if RT_USING_CPLUSPLUS

    config RT_USING_CPP_CRT_INIT
        bool "Startup runtime already runs .init_array constructors"
        default y if SOC_SIMULATOR
        default n
        help
            Enable this for GCC ports whose startup runtime already walks the
            .init_array section, so that RT-Thread skips it and does not run
            the constructors twice. RT-Thread still walks the ctors range.
            This option is usually set by the BSP; do not change it manually.
            Leave this disabled when the startup code relies on the empty
            __libc_init_array provided by RT-Thread's newlib port, which
            defers constructors to RT-Thread.

    config RT_USING_CPLUSPLUS11
        bool "Enable C++11 standard multi-threading feature support"
        default n
        select RT_USING_POSIX_FS
        select RT_USING_POSIX_STDIO
        select RT_USING_PTHREADS
        select RT_USING_RTC

    config RT_USING_CPP_WRAPPER
        bool "Enable RT-Thread APIs C++ wrapper"
        default n

    config RT_USING_CPP_EXCEPTIONS
        bool "Enable C++ exceptions (will increase overhead)"
        default n

endif
```

## components/libc/posix/libdl/utest/Kconfig
```kconfig
config RT_UTEST_DLMODULE
    bool "dlmodule ELF loading and relocation tests (32-bit ARM GCC)"
    depends on ARCH_ARM_CORTEX_A && !ARCH_CPU_64BIT && !RT_USING_SMART
    depends on RT_USING_MODULE && RT_USING_DFS && RT_USING_POSIX_FS
    default n
    help
        Build real 32-bit ARM ELF modules and test dlopen, dlsym and dlclose.
        Requires GCC and a writable filesystem mounted at /.
        Fixture generation uses -marm -mcpu=arm926ej-s and verifies the
        GCC-generated ELF layout, section types and symbol properties.
```

## components/lwp/utest/Kconfig
```kconfig
menu "LWP Testcase"

config RT_UTEST_LWP
    bool "Enable LWP condvar test"
    depends on RT_USING_SMART
    default n

config RT_UTEST_LWP_TTY_PTMX
    bool "Enable tty_ptmx regression tests"
    depends on RT_USING_SMART
    default n
    help
        Regression guards for tty_ptmx buffer bounds and ioctl argument
        handling.

endmenu
```

## components/mprotect/Kconfig
```kconfig
menu "Memory protection"

config RT_USING_MEM_PROTECTION
    bool "Enable memory protection"
    default n
    select RT_USING_HEAP

config RT_USING_HW_STACK_GUARD
    bool "Enable hardware stack guard"
    default n
    select RT_USING_MEM_PROTECTION

if RT_USING_MEM_PROTECTION
    config USE_MEM_PROTECTION_EXAMPLES
    bool "Use memory protection examples"
    default y

    config NUM_MEM_REGIONS
    int "Total number of memory protection regions supported by hardware"
    default 8
    help
        The number of MPU regions supported by the target MCU. The common value
        for Cortex-M4/M7/M33 is 8, but some MCUs expose 4, 12, or 16 regions.
        Set this to the actual value reported by the hardware, otherwise the MPU
        initialization will reject the configuration at runtime.

    config NUM_EXCLUSIVE_REGIONS
    int "Total number of exclusive memory regions added using rt_mprotect_add_exclusive_region API"
    default 0

    config NUM_CONFIGURABLE_REGIONS
    int "Maximum number of configurable memory regions for each thread, excluding stack guard and exclusive regions added using rt_mprotect_add_exclusive_region API"
    default 0
endif

endmenu
```

## components/net/Kconfig
```kconfig
menu "Network"

rsource "sal/Kconfig"
rsource "af_unix/Kconfig"
rsource "netdev/Kconfig"
rsource "lwip/Kconfig"
rsource "at/Kconfig"

endmenu
```
