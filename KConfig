## bsp/acm32/acm32f4xx-nucleo/drivers/Kconfig
```kconfig
menu "Hardware Drivers Config"

choice
    prompt "select chip type"
    default SOC_ACM32F403RET7

    config SOC_ACM32F403KCU7
    bool "SOC_ACM32F403KCU7"
    select RT_USING_COMPONENTS_INIT
    select RT_USING_USER_MAIN
    help
        Refer to ACM32F403 DataSheet

    config SOC_ACM32F403KEU7
    bool "SOC_ACM32F403KEU7"
    select RT_USING_COMPONENTS_INIT
    select RT_USING_USER_MAIN
    help
        Refer to ACM32F403 DataSheet

    config SOC_ACM32F403CCT7
    bool "SOC_ACM32F403CCT7"
    select RT_USING_COMPONENTS_INIT
    select RT_USING_USER_MAIN
    help
        Refer to ACM32F403 DataSheet

    config SOC_ACM32F403CET7
    bool "SOC_ACM32F403CET7"
    select RT_USING_COMPONENTS_INIT
    select RT_USING_USER_MAIN
    help
        Refer to ACM32F403 DataSheet

    config SOC_ACM32F403RCT7
    bool "SOC_ACM32F403RCT7"
    select RT_USING_COMPONENTS_INIT
    select RT_USING_USER_MAIN
    help
        Refer to ACM32F403 DataSheet

    config SOC_ACM32F403RET7
    bool "SOC_ACM32F403RET7"
    select RT_USING_COMPONENTS_INIT
    select RT_USING_USER_MAIN
    help
        Refer to ACM32F403 DataSheet

    config SOC_ACM32F403VCT7
    bool "SOC_ACM32F403VCT7"
    select RT_USING_COMPONENTS_INIT
    select RT_USING_USER_MAIN
    help
        Refer to ACM32F403 DataSheet

    config SOC_ACM32F403VET7
    bool "SOC_ACM32F403VET7"
    select RT_USING_COMPONENTS_INIT
    select RT_USING_USER_MAIN
    help
        Refer to ACM32F403 DataSheet
endchoice

menu "ACM32F403RET7"
    depends on SOC_ACM32F403RET7

    config SOC_SRAM_START_ADDR
        hex "sram start address"
        default 0x20000000

    config SOC_SRAM_SIZE
        hex "sram size(KBytes)"
        default 0xC0

    config SOC_FLASH_START_ADDR
        hex "EFlash Start Address"
        default 0x00000000

    config SOC_FLASH_SIZE
        hex "EFlash Size(KBytes)"
        default 0x8000
endmenu

menu "Onboard Peripheral Drivers"

endmenu

menu "On-chip Peripheral Drivers"

    menu "Hardware GPIO"
        config BSP_USING_GPIO1
            bool "Enable GPIOAB"
            default y
            select RT_USING_PIN
        config BSP_USING_GPIO2
            bool "Enable GPIOCD"
            default y
            select RT_USING_PIN
        config BSP_USING_GPIO3
            bool "Enable GPIOEF"
            default y
            select RT_USING_PIN
    endmenu

    config BSP_USING_ADC
        bool "Enable ADC"
        select RT_USING_ADC
        default n

    config BSP_USING_DAC
        bool "Enable DAC"
        select RT_USING_DAC
        default n

    menu "Hardware UART"
        config BSP_USING_UART1
            bool "Enable UART1 (PA9/PA10)"
            default y
            select RT_USING_SERIAL

        config BSP_USING_UART2
            bool "Enable UART2 (PA2/PA3)"
            default y
            select RT_USING_SERIAL

        if BSP_USING_UART2
            config BSP_UART2_RX_USING_DMA
                bool "Enable UART2 RX DMA"
                depends on BSP_USING_UART2
                select RT_SERIAL_USING_DMA
                default n

            config BSP_UART2_TX_USING_DMA
                bool "Enable UART2 TX DMA"
                depends on BSP_USING_UART2
                select RT_SERIAL_USING_DMA
                default n
        endif

        config BSP_USING_UART3
            bool "Enable UART3 (PC4/PC5)"
            default n
            select RT_USING_SERIAL

        if BSP_USING_UART3
            config BSP_UART3_RX_USING_DMA
                bool "Enable UART3 RX DMA"
                depends on BSP_USING_UART3
                select RT_SERIAL_USING_DMA
                default n

            config BSP_UART3_TX_USING_DMA
                bool "Enable UART3 TX DMA"
                depends on BSP_USING_UART3
                select RT_SERIAL_USING_DMA
                default n
        endif

        config BSP_USING_UART4
            bool "Enable UART4 (PC11/PC10)"
            default n
            select RT_USING_SERIAL

        if BSP_USING_UART4
            config BSP_UART4_RX_USING_DMA
                bool "Enable UART4 RX DMA"
                depends on BSP_USING_UART4
                select RT_SERIAL_USING_DMA
                default n

            config BSP_UART4_TX_USING_DMA
                bool "Enable UART4 TX DMA"
                depends on BSP_USING_UART4
                select RT_SERIAL_USING_DMA
                default n
        endif
    endmenu

    config BSP_USING_RTC
        bool "Enable RTC"
        select RT_USING_RTC
        default n

    config BSP_USING_LPUART
        bool "Enable LPUART"
        select RT_USING_UART
        default n

    menu "Hardware I2C"
        config BSP_USING_I2C1
            bool "Enable I2C1"
            default n
            select RT_USING_I2C
        config BSP_USING_I2C2
            bool "Enable I2C2"
            default n
            select RT_USING_I2C
    endmenu

    menu "Hardware I2S"
        config BSP_USING_I2S1
            bool "Enable I2S1"
            default n
            select RT_USING_I2S
    endmenu

    menu "Hardware CAN"
        config BSP_USING_CAN1
            bool "Enable CAN1"
            default n
            select RT_USING_CAN
        config BSP_USING_CAN2
            bool "Enable CAN2"
            default n
            select RT_USING_CAN
    endmenu

    menu "Hardware TIMER"
        config BSP_USING_TIM1
            bool "Enable Timer1"
            default n
            select RT_USING_HWTIMER
        config BSP_USING_TIM2
            bool "Enable Timer2"
            default n
            select RT_USING_HWTIMER
        config BSP_USING_TIM3
            bool "Enable Timer3"
            default n
            select RT_USING_HWTIMER
        config BSP_USING_TIM4
            bool "Enable Timer4"
            default n
            select RT_USING_HWTIMER
        config BSP_USING_TIM6
            bool "Enable Timer6"
            default n
            select RT_USING_HWTIMER
        config BSP_USING_TIM7
            bool "Enable Timer7"
            default n
            select RT_USING_HWTIMER
        config BSP_USING_TIM14
            bool "Enable Timer14"
            default n
            select RT_USING_HWTIMER
        config BSP_USING_TIM15
            bool "Enable Timer15"
            default n
            select RT_USING_HWTIMER
        config BSP_USING_TIM16
            bool "Enable Timer16"
            default n
            select RT_USING_HWTIMER
        config BSP_USING_TIM17
            bool "Enable Timer17"
            default n
            select RT_USING_HWTIMER
    endmenu

    menu "Hardware WDT"
        config BSP_USING_WDT
            bool "Enable Watch Dog Timer"
            default n
            select RT_USING_WDT
        config BSP_USING_IWDT
            bool "Enable Independent Watch Dog Timer"
            default n
            select RT_USING_WDT
    endmenu

    config BSP_USING_LCD
        bool "Enable LCD"
        default n

    menu "Hardware SPI"
        config BSP_USING_SPI1
            bool "Enable SPI1"
            select RT_USING_SPI
            default n

        if BSP_USING_SPI1
            config BSP_SPI1_RX_USING_DMA
                bool "Enable SPI1 RX DMA"
                default n

            config BSP_SPI1_TX_USING_DMA
                bool "Enable SPI1 TX DMA"
                default n
        endif

        config BSP_USING_SPI2
            bool "Enable SPI2"
            select RT_USING_SPI
            default n

        if BSP_USING_SPI2
            config BSP_SPI2_RX_USING_DMA
                bool "Enable SPI2 RX DMA"
                default n

            config BSP_SPI2_TX_USING_DMA
                bool "Enable SPI2 TX DMA"
                default n
        endif

        config BSP_USING_SPI3
            bool "Enable SPI3"
            select RT_USING_SPI
            default n

        if BSP_USING_SPI3
            config BSP_SPI3_RX_USING_DMA
                bool "Enable SPI3 RX DMA"
                default n

            config BSP_SPI3_TX_USING_DMA
                bool "Enable SPI3 TX DMA"
                default n
        endif

        config BSP_USING_SPI4
            bool "Enable SPI4"
            select RT_USING_SPI
            default n

        if BSP_USING_SPI4
            config BSP_SPI4_RX_USING_DMA
                bool "Enable SPI4 RX DMA"
                default n

            config BSP_SPI4_TX_USING_DMA
                bool "Enable SPI4 TX DMA"
                default n
        endif
    endmenu

    menu "Hardware CRYPTO"
        config BSP_USING_CRC
            select RT_HWCRYPTO_USING_CRC
            bool "Enable CRC"
            default n
            select RT_USING_HWCRYPTO
        config BSP_USING_AES
            select RT_HWCRYPTO_USING_AES
            bool "Enable AES"
            default n
            select RT_USING_HWCRYPTO

        config BSP_USING_HRNG
            select RT_HWCRYPTO_USING_RNG
            bool "Enable HRNG"
            default n
            select RT_USING_HWCRYPTO
    endmenu

    config BSP_USING_CMP
        bool "Enable Analog Voltage Comparer"
        default n

    config BSP_USING_OPA
        bool "Enable Operational Amplifier"
        default n

    config BSP_USING_TKEY
        bool "Enable Touch Key"
        select RT_USING_TOUCH
        default n

    config BSP_USING_RPMU
        bool "Enable RTC PMU"
        select RT_USING_PM
        default n

    config BSP_USING_USBD
        bool "Enable USB Device"
        select RT_USING_USB
        default n

endmenu

menu "Board extended module Drivers"

endmenu

endmenu
```

## bsp/airm2m/air105/Kconfig
```kconfig
mainmenu "RT-Thread Configuration"

config BSP_DIR
    string
    option env="BSP_ROOT"
    default "."

config RTT_DIR
    string
    option env="RTT_ROOT"
    default "../../.."

config PKGS_DIR
    string
    option env="PKGS_ROOT"
    default "packages"
 
source "$RTT_DIR/Kconfig"
source "$PKGS_DIR/Kconfig"
source "board/Kconfig"

menu "chip select"
    choice
        prompt "chip system type"
        default __AIR105_BSP__
        config __AIR105_BSP__
            bool "AIR105"
            select ARCH_ARM_CORTEX_M4
            select RT_USING_COMPONENTS_INIT
            select RT_USING_USER_MAIN
            default y
    endchoice
endmenu
```

## bsp/airm2m/air105/board/Kconfig
```kconfig
menu "Hardware Drivers Config"

config SOC_AIR105
    bool
    select ARCH_ARM_CORTEX_M4
    select RT_USING_COMPONENTS_INIT
    select RT_USING_USER_MAIN
    select BSP_USING_WDT
    default y

menu "Onboard Peripheral Drivers"

    config BSP_USING_SHELL_TO_USART
        bool "Enable SHELL TO USART (uart0)"
        select BSP_USING_UART
        select BSP_USING_UART0
        default y

    config BSP_USING_SPI_FLASH
        bool "Enable SPI FLASH (W25Q64 spi1)"
        select BSP_USING_SPI
        select RT_USING_SFUD
        select RT_SFUD_USING_SFDP
        default n

    config BSP_USING_ETH
        bool "Enable Ethernet Driver"
        select PKG_USING_WIZNET
        select BSP_USING_SPI
        default n
        if BSP_USING_ETH
            config EXTERNAL_PHY_ADDRESS
                hex
                default 0x00
            config WIZ_SPI_BUS
                string "WIZ SPI bus name"
                default "spi2"
            config WIZ_SPI_CS
                int "WIZ SPI bus cs pin"
                default 19
        endif

endmenu

menu "On-chip Peripheral Drivers"
    config BSP_USING_GPIO
        bool "Enable GPIO"
        select RT_USING_PIN
        default y

    menuconfig BSP_USING_UART
        bool "Enable UART"
        default y
        select RT_USING_SERIAL
        if BSP_USING_UART
            menuconfig BSP_USING_UART0
                bool "Enable UART0 (Debugger)"
                default n
                if BSP_USING_UART0
                    config BSP_UART0_RX_BUFSIZE
                        int "Set UART0 RX buffer size"
                        range 64 65535
                        depends on RT_USING_SERIAL_V2
                        default 256

                    config BSP_UART0_TX_BUFSIZE
                        int "Set UART0 TX buffer size"
                        range 0 65535
                        depends on RT_USING_SERIAL_V2
                        default 0
                endif

            menuconfig BSP_USING_UART1
                bool "Enable UART1"
                default n
                if BSP_USING_UART1
                    config BSP_UART1_RX_BUFSIZE
                        int "Set UART1 RX buffer size"
                        range 64 65535
                        depends on RT_USING_SERIAL_V2
                        default 256

                    config BSP_UART1_TX_BUFSIZE
                        int "Set UART1 TX buffer size"
                        range 0 65535
                        depends on RT_USING_SERIAL_V2
                        default 0
                endif

            menuconfig BSP_USING_UART2
                bool "Enable UART2"
                default n
                if BSP_USING_UART2
                    config BSP_UART2_RX_BUFSIZE
                        int "Set UART2 RX buffer size"
                        range 64 65535
                        depends on RT_USING_SERIAL_V2
                        default 256

                    config BSP_UART2_TX_BUFSIZE
                        int "Set UART2 TX buffer size"
                        range 0 65535
                        depends on RT_USING_SERIAL_V2
                        default 256
                endif

            menuconfig BSP_USING_UART3
                bool "Enable UART3"
                default n
                if BSP_USING_UART3
                    config BSP_UART3_RX_BUFSIZE
                        int "Set UART3 RX buffer size"
                        range 64 65535
                        depends on RT_USING_SERIAL_V2
                        default 256

                    config BSP_UART3_TX_BUFSIZE
                        int "Set UART3 TX buffer size"
                        range 0 65535
                        depends on RT_USING_SERIAL_V2
                        default 256
                endif
        endif

    config BSP_USING_I2C
        bool "Enable HW I2C"
        select RT_USING_I2C
        default n
        if BSP_USING_I2C
            config I2C_BUS_NAME
                string "HW I2C bus name"
                default "i2c"
        endif

    menuconfig BSP_USING_SPI
        bool "Enable SPI BUS"
        default n
        select RT_USING_SPI
        if BSP_USING_SPI
            config BSP_USING_HSPI0
                bool "Enable HSPI0 BUS"
                default n

            config BSP_USING_SPI0
                bool "Enable SPI0 BUS"
                default n

            config BSP_USING_SPI1
                bool "Enable SPI1 BUS"
                default n

            config BSP_USING_SPI2
                bool "Enable SPI2 BUS"
                default n

            config BSP_USING_SPI0S
                bool "Enable SPI0S BUS"
                default n
        endif

    config BSP_USING_ONCHIP_RTC
        bool "Enable HW onchip rtc"
        select RT_USING_ONCHIP_RTC
        default n

    config BSP_USING_WDT
        bool "Enable Watchdog Timer"
        select RT_USING_WDT
        select RT_USING_DEVICE_IPC
        select RT_USING_SYSTEM_WORKQUEUE
        default n

endmenu

endmenu
```
