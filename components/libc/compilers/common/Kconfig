## components/utilities/libadt/Kconfig
```kconfig
menuconfig RT_USING_ADT
    bool "Enable ADT(abstract data type)"
    default y if ARCH_MM_MMU
    default n
    help
        ADT(abstract data type) are a set of general interfaces that encapsulate commonly used data structures.
        
        ADT's Core Functions and Components:
        AVL Tree (RT_USING_ADT_AVL)
        Bitmap (RT_USING_ADT_BITMAP)
        Hash Table (RT_USING_ADT_HASHMAP)
        Reference Counting API (RT_USING_ADT_REF)        

        Features and Advantages of ADT:
        Abstract Interface: Hides the implementation details of data structures; only a unified interface needs to be called.
        Customizability: Reduces system resource consumption through Kconfig configuration.
        Generality: Applicable to various scenarios.

        Once enabled, you can use the AVL tree, bitmap, hash table, and reference counting APIs.

config RT_USING_ADT_AVL
    bool "AVL tree"
    depends on RT_USING_ADT
    default y
    help
        An AVL tree (RT_USING_ADT_AVL) is a self-balancing binary search tree.

        Core capabilities:
        Supports efficient insertion, deletion, and search operations; 
        Data is naturally ordered, facilitating range queries.

        Typical scenarios:
        Task priority sorting; 
        Log timestamp indexing; 
        Ordered management of dynamic configuration items.

        Once enabled, AVL trees can be used (ADT must be enabled).

config RT_USING_ADT_BITMAP
    bool "Bitmap"
    depends on RT_USING_ADT
    default y
    help
        A bitmap (RT_USING_ADT_BITMAP) represents a set of states using consecutive binary bits.

        Core capabilities: 
        Extreme memory efficiency;
        Fast set, clear, and query operations based on bitwise operations.

        Typical scenarios: 
        Resource allocation flags; 
        Permission switches; 
        State set management.

        Once enabled, bitmaps can be used (ADT must be enabled).

config RT_USING_ADT_HASHMAP
    bool "HashMap"
    depends on RT_USING_ADT
    default y
    help
        Hash Table (RT_USING_ADT_HASHMAP) is a storage structure based on key-value mapping. 

        Core capabilities: 
        Average lookup, insertion, and deletion times are close to O(1); 
        Supports custom hash functions and key comparison rules, adapting to different key types. 
        
        Typical scenarios: 
        Scenarios requiring fast object lookup using unique identifiers; 
        String key-value pair configuration; 
        High-frequency query scenarios.

        Once enabled, HashMap can be used (ADT must be enabled).

config RT_USING_ADT_REF
    bool "Reference API"
    depends on RT_USING_ADT
    default y
    help
        The Reference Counting API (RT_USING_ADT_REF) is a mechanism for managing object lifecycles through a counter.

        Core capabilities: 
        Simplifies the release logic of shared resources across multiple modules; 
        automatically maintains the lifecycle without requiring manual tracking of object users.

        Typical scenarios: 
        Multi-threaded/multi-module shared resources.

        Once enabled, Reference API can be used (ADT must be enabled).
```

## components/utilities/rt-link/Kconfig
```kconfig
# Kconfig file for rt_link
menuconfig RT_USING_RT_LINK
    bool "RT-Link"
    default n
    help
        RT-Link is a lightweight, portable data link layer transport protocol.

        Key Features:
        Supports data retransmission mechanism
        Frame sequence number and status synchronization
        Provides a unified API interface
        Supports adaptation to various underlying hardware
        Built-in CRC checksum

        Typical Application Scenarios:
        Short-range communication between low-power devices
        Device firmware upgrades, log feedback, etc.

        Not enabled by default,Once enabled, RT-Link components can be used (requires enabling UART or other related hardware transmission media).

if RT_USING_RT_LINK
    choice RT_LINK_USING_CRC
        prompt"use hw crc device or not"
        default RT_LINK_USING_SF_CRC
        help 
            In RT-Thread's RT-Link protocol:
            CRC check verifies whether the data has been tampered with or corrupted during transmission by calculating the CRC value of the data.

            Once enabled, CRC checksums in RT-Link can be used (software CRC checksums are enabled by default). 
            You can choose to enable either software CRC checksums or hardware CRC checksums.

        config RT_LINK_USING_SF_CRC
            bool "use software crc table"
            help
                Once enabled, software CRC checksums in RT-Link can be used.
        config RT_LINK_USING_HW_CRC
            bool "use hardware crc device"
            help
                Once enabled, hardware CRC checksums in RT-Link can be used.
    endchoice

    menu "rt link debug option"
        config USING_RT_LINK_DEBUG
            bool "Enable RT-Link debug"
            default n
            help
                USING_RT_LINK_DEBUG enables RT-Link core debugging. 
                Once enabled, it will output debugging information for the RT-Link protocol layer (disabled by default).
        config USING_RT_LINK_HW_DEBUG
            bool "Enable RT-Link hw debug"
            default n
            help
                USING_RT_LINK_HW_DEBUG enables RT-Link hardware debugging.
                Once enabled, it will output debugging information about the underlying RT-Link hardware (disabled by default).
    endmenu
endif
```

## components/utilities/utest/Kconfig
```kconfig
menu "RT-Thread Utestcases"

    config RT_USING_UTESTCASES
        bool "RT-Thread Utestcases"
        default n
        select RT_USING_UTEST
        select RT_USING_DEBUG if !RT_USING_ULOG

    if RT_USING_UTESTCASES

        rsource "../../../src/utest/Kconfig"

        menu "Kernel Components"

            menu "Drivers"
                rsource "../../../components/drivers/core/utest/Kconfig"
                rsource "../../../components/drivers/audio/utest/Kconfig"
                rsource "../../../components/drivers/ipc/utest/Kconfig"
                rsource "../../../components/drivers/pin/utest/Kconfig"
                rsource "../../../components/drivers/serial/utest/Kconfig"
                rsource "../../../components/drivers/smp_call/utest/Kconfig"
                rsource "../../../components/drivers/spi/utest/Kconfig"
            endmenu

            rsource "../../../components/dfs/utest/Kconfig"
            rsource "../../../components/dfs/dfs_v2/filesystems/tmpfs/utest/Kconfig"
            rsource "../../../components/libc/cplusplus/utest/Kconfig"
            rsource "../../../components/lwp/utest/Kconfig"
            rsource "../../../components/mm/utest/Kconfig"
            rsource "../../../components/net/utest/Kconfig"
            rsource "../../../components/utilities/utest/utest/Kconfig"

        endmenu

endif

endmenu
```

## components/utilities/utest/utest/Kconfig
```kconfig
menu "Utest Framework"

config RT_UTEST_SELF_PASS
    bool "UTEST Framework Test"
    select RT_USING_UTEST
    default n
    help
        RT_UTEST_SELF_PASS controls whether the Utest framework's self-test functionality is enabled.    
        Once enabled, RT_USING_UTEST will be enabled automatically, and the self-test code included with the Utest framework will also be compiled.

        Application scenario: 
        Verifying whether the Utest framework functions correctly.
endmenu
```
