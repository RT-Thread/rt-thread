## bsp/allwinner/libraries/sunxi-hal/hal/source/ccmu/Kconfig
```kconfig
menu "CCMU Devices"

config DRIVERS_CCMU
    bool "enable ccmu driver"
        default y

config DRIVERS_SUNXI_CLK
    bool "enable sunxi ccmu driver"
    depends on DRIVERS_CCMU
        default y

config DRIVERS_SUNXI_CCU
    bool "enable sunxi-ng ccmu driver"
    depends on DRIVERS_CCMU
        default n

config HAL_TEST_CLK
    bool "enable sunxi ccmu hal APIs test command"
    depends on DRIVERS_SUNXI_CLK
        default n

config HAL_TEST_CCU
    bool "enable sunxi-ng ccmu hal APIs test command"
    depends on DRIVERS_SUNXI_CCU
        default n

endmenu
```

## bsp/allwinner/libraries/sunxi-hal/hal/source/ce/Kconfig
```kconfig
menu "CE Devices"

config DRIVERS_CE
    bool "enable ce driver"
        default y

config HAL_TEST_CE
    bool "enable ce hal APIs test command"
	depends on DRIVERS_CE
        default n


endmenu
```

## bsp/allwinner/libraries/sunxi-hal/hal/source/cir/Kconfig
```kconfig
menu "CIR Devices"

config DRIVERS_CIR
    bool "enable CIR driver"
        default y

menu "CIR option features"

config DRIVERS_CIR_DEBUG
    bool "support CIR debug"
    select DRIVERS_CIR
    default n

config DRIVERS_CIR_TEST
    bool "CIR test case"
    select DRIVERS_CIR
    default n

config HAL_TEST_CIR
    bool "CIR TEST CASE"
    depends on DRIVERS_CIR
    default n

endmenu

endmenu
```

## bsp/allwinner/libraries/sunxi-hal/hal/source/common/Kconfig
```kconfig
menu "Common Option"

config DRVIER_SYSCONFIG
    bool "enable sysconfig"
    default y

endmenu
```

## bsp/allwinner/libraries/sunxi-hal/hal/source/disp2/Kconfig
```kconfig
#
# Video configuration for sunxi platform
#

menu "Video support for sunxi"

config DISP2_SUNXI
    tristate "DISP Driver Support(sunxi-disp2)"
    default n
    ---help---
      Display driver for sunxi based boards.

choice
    prompt "DISP2 Framebuffer rotation support"
    default SUNXI_DISP2_FB_DISABLE_ROTATE

config SUNXI_DISP2_FB_DISABLE_ROTATE
    bool "Disable rotation"
    depends on (DISP2_SUNXI)
    ---help---
      Do not use framebuffer rotation

config SUNXI_DISP2_FB_ROTATION_SUPPORT
    bool "Software rotation support"
    depends on (DISP2_SUNXI)
    ---help---
      Framebuffer software rotation on the top of disp2.

config SUNXI_DISP2_FB_HW_ROTATION_SUPPORT
    bool "Hardware(G2D) rotation support"
    depends on (DISP2_SUNXI && SUNXI_G2D)
    ---help---
      Framebuffer hardware(G2D) rotation on the top of disp2.

endchoice

config HAL_TEST_DISP
    bool "DISP2 hal APIs test"
    depends on (DISP2_SUNXI)
    default n
    ---help---
      Enable disp2 hal test command.
config FPGA_V7_PLATFORM
    bool "FPGA"
    depends on (DISP2_SUNXI)
    default n
    ---help---
      Enable fpga
config SUNXI_DISP2_FB_DECOMPRESS_LZMA
    bool "Framebuffer show bootlogo from lzma file"
    depends on (DISP2_SUNXI)
    default n
    select DECOMPRESS_LZMA
    ---help---
      Show bootlogo from lzma file.

config HDMI_DISP2_SUNXI
    tristate "HDMI Driver Support(sunxi-disp2)"
    depends on (DISP2_SUNXI)
    default n
    ---help---
      Hdmi driver for sunxi based boards.

menuconfig HDMI2_DISP2_SUNXI
  tristate "HDMI2.0 Driver Support(sunxi-disp2)"
  depends on (DISP2_SUNXI)
  default n
  ---help---
  Say Y here if you want to have support for HDMI2.0 controller
  on the sunxi based boards. The HDMI2.0 controller include edid,
  hdcp1.4,hdcp2.2,cec feature and is compatible with hdmi1.4,support
  HDR,4k@60Hz. If unsure, say N.

config HDMI_EP952_DISP2_SUNXI
    tristate "HDMI EP952 Driver Support(sunxi-disp2)"
    depends on (DISP2_SUNXI)
    default n
    ---help---
      Hdmi ep952 driver for sunxi based boards.
menuconfig HDMI2_HDCP_SUNXI
  tristate "HDMI2.0 HDCP"
  depends on (HDMI2_DISP2_SUNXI)
  default n
  ---help---
  Say Y here if you want to handle the cec message by User Space.
  Say N here if you want to handle the cec message by Kernel.
  If unsure, say N.

config HDMI2_HDCP22_SUNXI
  tristate "HDMI2.0 HDCP2.2"
  depends on (HDMI2_HDCP_SUNXI && HDMI2_DISP2_SUNXI)
  default n
  ---help---
  Say Y here if you want to handle the cec message by User Space.
  Say N here if you want to handle the cec message by Kernel.
  If unsure, say N.

menuconfig HDMI2_CEC_SUNXI
  tristate "HDMI2.0 CEC"
  depends on (HDMI2_DISP2_SUNXI)
  default n
  ---help---
  Say Y here if you want to handle the cec message by User Space.
  Say N here if you want to handle the cec message by Kernel.
  If unsure, say N.

config HDMI2_CEC_USER
  tristate "HDMI2.0 CEC handled by user space"
  depends on (HDMI2_CEC_SUNXI && HDMI2_DISP2_SUNXI)
  default n
  ---help---
  Say Y here if you want to handle the cec message by User Space.
  Say N here if you want to handle the cec message by Kernel.
  If unsure, say N.

config TV_DISP2_SUNXI
     tristate "TV Driver Support(sunxi-disp2)"
     depends on (DISP2_SUNXI)
     default n
     ---help---
      TV driver for sunxi based boards.
config VDPO_DISP2_SUNXI
     tristate "VDPO Driver Support(sunxi-disp2)"
     depends on (DISP2_SUNXI)
     default n
     ---help---
      VDPO driver for sunxi based boards.
config DISP2_TV_GM7121
    tristate "GM7121 TV module Support(sunxi-disp2)"
    depends on (DISP2_SUNXI && TV_DISP2_SUNXI)
    default n
    ---help---

config EDP_DISP2_SUNXI
    tristate "EDP Driver Support(sunxi-disp2)"
    depends on (DISP2_SUNXI)
    default n
    ---help---
      EDP 1.2 driver for sunxi. Embedded Display Port is
      a high speed display interface for embedded device.
      DisplayPort can be used to transmit audio and video
      simultaneously, but each one is optional and can be
      transmitted without the other.

config DISP2_TV_AC200
    tristate "AC200 TV module Support(sunxi-disp2)"
    depends on (DISP2_SUNXI && MFD_ACX00)
    default n
    ---help---

config EINK_PANEL_USED
    bool "Eink panel used"
    depends on (DISP2_SUNXI && (ARCH_SUN8IW10 || ARCH_SUN8IW15))
    default n
    ---help---

config EINK200_SUNXI
    bool "Eink Driver Version 2.0 Support"
    depends on (DISP2_SUNXI && ARCH_SUN50IW10)
    default n
    ---help---

config DISP2_SUNXI_BOOT_COLORBAR
    bool "boot colorbar Support for disp driver(sunxi-disp2)"
    depends on DISP2_SUNXI
    default n
    ---help---
      If true, the framebuffer will be filled by specified data
      to display vertical colorbar.

menu "LCD panels select"
    depends on DISP2_SUNXI

source "$BSP_DIR/../libraries/sunxi-hal/hal/source/disp2/disp/lcd/Kconfig"
endmenu


menu "Display engine feature select"
    depends on DISP2_SUNXI

source "$BSP_DIR/../libraries/sunxi-hal/hal/source/disp2/disp/Kconfig"
endmenu

menu "Soc and board select"
    depends on DISP2_SUNXI

source "$BSP_DIR/../libraries/sunxi-hal/hal/source/disp2/soc/Kconfig"
endmenu

endmenu
```

## bsp/allwinner/libraries/sunxi-hal/hal/source/disp2/disp/Kconfig
```kconfig
config DISP2_SUNXI_SUPPORT_SMBL
    bool "Support smart backlight"
    default n
    ---help---
        If you want to support smart backlight, select it.

config DISP2_SUNXI_SUPPORT_ENAHNCE
    bool "Support Video Enhance Process"
    default y
    ---help---
        If you want to support video enhance process, select it.
```

## bsp/allwinner/libraries/sunxi-hal/hal/source/disp2/disp/lcd/Kconfig
```kconfig
config LCD_SUPPORT_GG1P4062UTSW
    bool "LCD support cpu_gg1p4062utsw panel"
    default n
    ---help---
        If you want to support cpu_gg1p4062utsw panel for display driver, select it.

config LCD_SUPPORT_DX0960BE40A1
    bool "LCD support dx0960be40a1 panel"
    default n
    ---help---
        If you want to support dx0960be40a1 panel for display driver, select it.

config LCD_SUPPORT_TFT720X1280
    bool "LCD support dx0960be40a1 panel"
    default n
    ---help---
        If you want to support dx0960be40a1 panel for display driver, select it.

config LCD_SUPPORT_FD055HD003S
    bool "LCD support fd055hd003s panel"
    default n
    ---help---
        If you want to support fd055hd003s panel for display driver, select it.

config LCD_SUPPORT_HE0801A068
    bool "LCD support he0801a068 panel"
    default y
    ---help---
        If you want to support he0801a068 panel for display driver, select it.

config LCD_SUPPORT_ILI9341
    bool "LCD support ili9341 panel"
    default n
    ---help---
        If you want to support ili9341 panel for display driver, select it.

config LCD_SUPPORT_LH219WQ1
    bool "LCD support LH219WQ1 panel"
    default n
    ---help---
        If you want to support LH219WQ1 panel for display driver, select it.

config LCD_SUPPORT_LS029B3SX02
    bool "LCD support ls029b3sx02 panel"
    default n
    ---help---
        If you want to support ls029b3sx02 panel for display driver, select it.

config LCD_SUPPORT_LT070ME05000
    bool "LCD support lt070me05000 panel"
    default n
    ---help---
        If you want to support lt070me05000 panel for display driver, select it.


config LCD_SUPPORT_S6D7AA0X01
    bool "LCD support S6D7AA0X01 panel"
    default n
    ---help---
        If you want to support S6D7AA0X01 panel for display driver, select it.


config LCD_SUPPORT_T27P06
    bool "LCD support t27p06 panel"
    default n
    ---help---
        If you want to support t27p06 panel for display driver, select it.

config LCD_SUPPORT_TFT720_1280
    bool "LCD support tft720_1280 panel"
    default n
    ---help---
        If you want to support tft720_1280 panel for display driver, select it.

config LCD_SUPPORT_TFT08006
    bool "LCD support tft08006 panel"
    default n
    ---help---
        If you want to support tft08006 panel for display driver, select it.

config LCD_SUPPORT_TFTRGB
    bool "LCD support tft-RGB panel"
    default n
    ---help---
        If you want to support tft-rgb panel for display driver, select it.

config LCD_SUPPORT_WTQ05027D01
    bool "LCD support wtq05027d01 panel"
    default n
    ---help---
        If you want to support wtq05027d01 panel for display driver, select it.

config LCD_SUPPORT_H245QBN02
    bool "LCD support H245QBN02 panel"
    default n
    ---help---
        If you want to support H245QBN02 panel for display driver, select it.

config LCD_SUPPORT_ST7789V
    bool "LCD support ST7789V panel"
    default n
    ---help---
        If you want to support ST7789V panel for display driver, select it.

config LCD_SUPPORT_ST7796S
    bool "LCD support ST7796S panel"
    default n
    ---help---
        If you want to support ST7796S panel for display driver, select it.

config LCD_SUPPORT_ST7701S
    bool "LCD support ST7701S panel"
    default n
    ---help---
        If you want to support ST7701S panel for display driver, select it.

config LCD_SUPPORT_T30P106
    bool "LCD support T30P106 panel"
    default n
    ---help---
        If you want to support T30P106 panel for display driver, select it.

config LCD_SUPPORT_TO20T20000
    bool "LCD support TO20T20000 panel"
    default n
    ---help---
        If you want to support TO20T20000 panel for display driver, select it.

config LCD_SUPPORT_FRD450H40014
    bool "LCD support FRD450H40014 panel"
    default n
    ---help---
        If you want to support FRD450H40014 panel for display driver, select it.

config LCD_SUPPORT_S2003T46G
    bool "LCD support S2003T46G panel"
    default n
    ---help---
        If you want to support S2003T46G panel for display driver, select it.

config LCD_SUPPORT_WILLIAMLCD
    bool "LCD support WilliamLcd panel"
    default y
    ---help---
        If you want to support WilliamLcd panel for display driver, select it.

config LCD_SUPPORT_LQ101R1SX03
    bool "LCD support lq101r1sx03 panel"
    default y
    ---help---
        If you want to support lq101r1sx03 panel for display driver, select it.

config LCD_SUPPORT_INET_DSI_PANEL
    bool "LCD support inet_dsi_panel panel"
    default y
    ---help---
        If you want to support inet_dsi_panel panel for display driver, select it.

config LCD_SUPPORT_WTL096601G03
    bool "LCD support WTL096601G03 panel"
    default n
    ---help---
        If you want to support WTL096601G03 panel for display driver, select it.

config LCD_SUPPORT_RT13QV005D
    bool "LCD support rt13qv005d panel"
    default n
    ---help---
        If you want to support rt13qv005d panel for display driver, select it.
config LCD_SUPPORT_ST7789V_CPU
    bool "LCD support st7789v_cpu panel"
    default n
    ---help---
        If you want to support st7789v_cpu panel for display driver, select it.

config LCD_SUPPORT_VVX07H005A10
    bool "LCD support VVX07H005A10 panel"
    default n
    ---help---
        If you want to support VVX07H005A10 panel for display driver, select it.
```

## bsp/allwinner/libraries/sunxi-hal/hal/source/disp2/soc/Kconfig
```kconfig
#

menu "Board Select"

config V459_PERF1
    bool "board v459 perf1"
    default n
    ---help---
      board v459 perf1

config F133_FPGA
    bool "board fpga f133"
    default n
    ---help---
      board f133 fpga

config VVX07H005A10_MIPI
    bool "board, disp with VVX07H005A10_mipi"
    default n
    ---help---
      board, disp with VVX07H005A10_mipi
config TFT08006_MIPI
    bool "board, disp with TFT08006_mipi"
    default n
    ---help---
      board, disp with TFT08006_mipi

config TFT_RGB
    bool "board, disp with TFT RGB"
    default n
    ---help---
      board, disp with TFT RGB

config HE0801A068_MIPI
    bool "EVB board, disp with HE0801A068_MIPI"
    default n
    ---help---
      EVB board, disp with HE0801A068_MIPI
config DEFAULT_LVDS
    bool "board, disp with lvds"
    default n
    ---help---
      board, disp with lvds

endmenu

menu "Soc Select"

config ARCH_SUN8IW19
    bool "soc sun8iw19 "
    default n
    ---help---
      soc sun8iw19

config ARCH_SUN20IW1
    bool "soc sun20iw1 "
    default n
    ---help---
      soc sun20iw1

endmenu
```

## bsp/allwinner/libraries/sunxi-hal/hal/source/dma/Kconfig
```kconfig
menu "DMA Devices"

config DRIVERS_DMA
    bool "enable dma driver"
        default y

config HAL_TEST_DMA
    bool "enable dma hal APIs test command"
	depends on DRIVERS_DMA
        default n

endmenu
```

## bsp/allwinner/libraries/sunxi-hal/hal/source/efuse/Kconfig
```kconfig
menu "EFUSE Devices"

config DRIVERS_EFUSE
    bool "enable efuse driver"
        default y

config HAL_TEST_EFUSE
    bool "enable efuse hal APIs test command"
    depends on DRIVERS_EFUSE
        default n

endmenu
```

## bsp/allwinner/libraries/sunxi-hal/hal/source/eise/Kconfig
```kconfig
menu "EISE Devices"

config DRIVERS_EISE
    bool "enable eise driver"
        default y

endmenu
```

## bsp/allwinner/libraries/sunxi-hal/hal/source/g2d_rcq/Kconfig
```kconfig
menu "G2D Devices"

config DRIVERS_G2D
    bool "enable g2d driver"
        default y

config HAL_TEST_G2D
    bool "enable g2d hal APIs test command"
    depends on DRIVERS_G2D
        default n

endmenu
```

## bsp/allwinner/libraries/sunxi-hal/hal/source/gmac/Kconfig
```kconfig
menu "GMAC Devices"

config DRIVERS_GMAC
    bool "enable GMAC driver"
    default n
    if DRIVERS_GMAC
        choice BSP_ALLWINNER_LIBRARIES_SUNXI_HAL_HAL_SOURCE_GMAC_USING_R_CHOICE
            prompt "GMAC media independent interface"
            default GMAC_USING_RMII if BOARD_allwinnerd1s
            default GMAC_USING_RGMII if BOARD_allwinnerd1

            config GMAC_USING_RGMII
                bool "RGMII"
            config GMAC_USING_RMII
                bool "RMII"
        endchoice
        choice BSP_ALLWINNER_LIBRARIES_SUNXI_HAL_HAL_SOURCE_GMAC_USING_GPIO_CHOICE
            prompt "GMAC GPIO GROUP"
            default GMAC_USING_GPIOG if BOARD_allwinnerd1s
            default GMAC_USING_GPIOE if BOARD_allwinnerd1

            config GMAC_USING_GPIOE
                bool "GPIOE GROUP"

            config GMAC_USING_GPIOG
                bool "GPIOG GROUP"
        endchoice
    endif
endmenu
```
