## components/finsh/KConfig
```kconfig
menu "Command shell"

config RT_USING_FINSH
    bool "finsh shell"
    default y

if RT_USING_FINSH

config FINSH_USING_HISTORY
    bool "Enable command history feature"
    default y

config FINSH_USING_SYMTAB
    bool "Using symbol table for commands"
    default y

config FINSH_USING_DESCRIPTION
    bool "Keeping description in symbol table"
    default y

config FINSH_THREAD_PRIORITY
    int "The priority level value of finsh thread"
    default 20

config FINSH_THREAD_STACK_SIZE
    int "The stack size for finsh thread"
    default 4096

config FINSH_CMD_SIZE
    int "The command line size for shell"
    default 80

config FINSH_USING_AUTH
    bool "shell support authentication"
    default n

if FINSH_USING_AUTH
config FINSH_DEFAULT_PASSWORD
    string "The default password for shell authentication"
    default "rtthread"
endif

config FINSH_USING_MSH
    bool "Using module shell"
    default y

if FINSH_USING_MSH
config FINSH_USING_MSH_DEFAULT
    bool "Using module shell in default"
    default y

config FINSH_USING_MSH_ONLY
    bool "Only using module shell"
    default n
endif

endif

endmenu
```

## components/finsh/Kconfig
```kconfig
menuconfig RT_USING_MSH
    bool "MSH: command shell"
    default n if RT_USING_NANO
    default y
    select RT_USING_SEMAPHORE

if RT_USING_MSH

    config RT_USING_FINSH
        bool
        default y

    config FINSH_USING_MSH
        bool
        default y

    config FINSH_THREAD_NAME
        string "The msh thread name"
        default "tshell"

    config FINSH_THREAD_PRIORITY
        int "The priority level value of thread"
        default 20

    config FINSH_THREAD_STACK_SIZE
        int "The stack size for thread"
        default 4096

    config FINSH_USING_HISTORY
        bool "Enable command history feature"
        default y
        if FINSH_USING_HISTORY
            config FINSH_HISTORY_LINES
                int "The command history line number"
                default 5
        endif

    config FINSH_USING_SNAPSHOT
        bool "Enable command Ctrl+Z/Ctrl+Y snapshot feature"
        default n
        help
            Enable snapshot feature for command history. Ctrl+Z undoes recent edits,
            Ctrl+Y redoes undone edits. This feature requires additional memory
            based on FINSH_SNAPSHOT_DEPTH settings.
        if FINSH_USING_SNAPSHOT
            config FINSH_SNAPSHOT_DEPTH
                int "The command snapshot depth"
                default 10
                help
                    The number of command snapshots to keep.
        endif

    config FINSH_USING_WORD_OPERATION
        bool "Enable Ctrl+W/Backspace/Ctrl+Left/Right word-based cursor operations"
        default n
        help
            Enable word-based cursor operations in the shell:
            - Ctrl+Backspace: delete previous word
            - Ctrl+Left/Right Arrow: move cursor by word
            - Ctrl+W: delete word before cursor
            This feature improves command line editing efficiency.
    
    config FINSH_USING_EXTEND_FEATURE
        bool "Enable insert/delete/home/end extend feature"
        default n
        help
            Enable insert/delete/home/end extend feature in the shell:
            - Insert: toggle insert mode
            - Delete: delete character backward
            - Home: move cursor to the beginning of the command
            - End: move cursor to the end of the command
            This feature improves command line editing efficiency.

    config FINSH_USING_FUNC_EXT
        bool "DEPRECATED: Use FINSH_USING_EXTEND_FEATURE instead"
        default n
        select FINSH_USING_EXTEND_FEATURE
        help
            This option is deprecated and will be removed in future releases.
            Please migrate to FINSH_USING_EXTEND_FEATURE.

    config FINSH_USING_SYMTAB
        bool "Using symbol table for commands"
        default y

    config FINSH_CMD_SIZE
        int "The command line size for shell"
        default 80

    config MSH_USING_BUILT_IN_COMMANDS
        bool "Enable built-in commands, such as list_thread"
        default y

    config FINSH_USING_DESCRIPTION
        bool "Keeping description in symbol table"
        default y

    config FINSH_ECHO_DISABLE_DEFAULT
        bool "Disable the echo mode in default"
        default n
    
    config FINSH_PROMPT_ENABLE_DEFAULT
        bool "Enable the prompt mode in default"
        default y

    config FINSH_PROMPT_TEXT_DEFAULT
        string "The default prompt text"
        default "msh "

    config FINSH_USING_AUTH
        bool "shell support authentication"
        default n
        if FINSH_USING_AUTH
            config FINSH_DEFAULT_PASSWORD
                string "The default password for shell authentication"
                default "rtthread"

            config FINSH_PASSWORD_MIN
                int "The password min length"
                default 6

            config FINSH_PASSWORD_MAX
                int "The password max length"
                default RT_NAME_MAX
        endif

    config FINSH_ARG_MAX
        int "The number of arguments for a shell command"
        default 10

    config FINSH_USING_OPTION_COMPLETION
        bool "command option completion enable"
        default y

endif
```

## components/gui/Kconfig
```kconfig
menu "RT-Thread UI Engine"

config RT_USING_GUIENGINE
    bool "Enable UI Engine"
    default n

if RT_USING_GUIENGINE

config RTGUI_NAME_MAX
    int "The maximal size of name in GUI engine"
    default 16

config RTGUI_USING_TTF
    bool "Support TrueType font"
    default n

config UTF8_TO_UNICODE
    depends on RTGUI_USING_TTF
    bool "Support UTF8 to UNICODE"
    default n

config RTGUI_USING_FONT16
    bool "Support 16 height font"
    default y

config RTGUI_USING_FONT12
    bool "Support 12 height font"
    default y

config RTGUI_USING_FONTHZ
    bool "Support Chinese font"
    default n

config RTGUI_USING_HZ_BMP
    depends on RTGUI_USING_FONTHZ
    bool "Use bitmap Chinese font"
    default n

config RTGUI_IMAGE_XPM
    bool "Support XPM image format"
    default n

config RTGUI_USING_JPG
    bool "Support JPG image format"
    default n

if RTGUI_USING_JPG
    choice
        prompt "JPEG image format"
        default RTGUI_IMAGE_JPEG

        config RTGUI_IMAGE_TJPGD
            bool "with TJpgDec(Tiny JPEG Decompressor)"

        config RTGUI_IMAGE_JPEG
            bool "with Libjpeg"
    endchoice
endif

config RTGUI_USING_PNG
    bool "Support PNG image format"
    default y

if RTGUI_USING_PNG
    choice
        prompt "PNG image format"
        default RTGUI_IMAGE_LODEPNG

        config RTGUI_IMAGE_LODEPNG
            bool "with LodePNG"

        config RTGUI_IMAGE_PNG
            bool "with LibPNG"
    endchoice
endif

config RTGUI_IMAGE_BMP
    bool "Support BMP image format"
    default n

config RTGUI_IMAGE_CONTAINER
    bool "Use image container"
    default y

config RTGUI_USING_DEMO
    bool "Enable the example of UI Engine"
    default n

endif

endmenu
```

## components/legacy/fdt/Kconfig
```kconfig
config RT_USING_FDT
    bool "Using fdt legacy version"
    default n
    if RT_USING_FDT
        config RT_USING_FDTLIB
            bool "Using fdt lib for device drivers"
            default y
        config RT_USING_FDT_FWNODE
            bool "Using fdt fwnode for device drivers"
            default n
        config FDT_USING_DEBUG
            bool "Using fdt debug function"
            default n

    endif
```
