## bsp/zynqmp-a53-dfzu2eg/drivers/serial/Kconfig
```kconfig
config RT_SERIAL_XILINX_PS
    bool "Cadence (Xilinx Zynq) UART"
    depends on RT_USING_CLK
    depends on RT_USING_RESET
    default y
```

## bsp/zynqmp-r5-axu4ev/Kconfig
```kconfig
mainmenu "RT-Thread Project Configuration"

BSP_DIR := .

RTT_DIR := ../..

PKGS_DIR := packages

source "$(RTT_DIR)/Kconfig"
osource "$PKGS_DIR/Kconfig"

config SOC_ZYNQMP_R5
    bool
    select RT_USING_CACHE
    select RT_USING_COMPONENTS_INIT
    select RT_USING_USER_MAIN
    default y

source "$(BSP_DIR)/drivers/Kconfig"
```

## bsp/zynqmp-r5-axu4ev/drivers/Kconfig
```kconfig
menu "Hardware Drivers Config"

    menu "Onboard Peripheral Drivers"

    endmenu

    menu "On-chip Peripheral Drivers"

    menuconfig BSP_USING_UART
        bool "Enable UART"
        default y
        select RT_USING_SERIAL
        if BSP_USING_UART
            config BSP_USING_UART0
                bool "Enable UART0"
                default y
        endif

    menuconfig BSP_USING_SDIO
        bool "Enable SDIO"
        default y
        if BSP_USING_SDIO
            config BSP_USING_SD0
                bool "Enable SD0 EMMC"
                default y
        endif
    comment "Please set RT_LWIP_PBUF_NUM is at least 256 if Enable Ethernet!"
    comment "Please set RT_LWIP_MEM_ALIGNMENT is at 32 if Enable Ethernet!"
    menuconfig BSP_USING_ETH
        bool "Enable Ethernet"
        default n
        select RT_USING_NETDEV
        select RT_USING_LWIP
        if BSP_USING_ETH
            config RT_LWIP_PBUF_POOL_BUFSIZE
                int "The size of each pbuf in the pbuf pool"
                range 1500 2000
                default 1700
        endif

    endmenu

    menu "Board extended module Drivers"

    endmenu

endmenu
```

## components/CMSIS/Kconfig
```kconfig
if ARCH_ARM_CORTEX_M

menu "ARM CMSIS"

config RT_USING_CMSIS_OS
    bool "Using CMSIS RTOS API"
    default n
    help
        Enable CMSIS RTOS API, which is implemented above RT-Thread.

config RT_USING_RTT_CMSIS
    bool "Using CMSIS Header files in RT-Thread"
    default n
    help
        Use CMSIS header files in RT-Thread/components/CMSIS. Otherwise, use the
        CMSIS header files in BSP.

endmenu

endif
```

## components/KConfig
```kconfig
menu "RT-Thread Components"

config RT_USING_COMPONENTS_INIT
    bool "Use components automatically initialization"
    default y

if RT_USING_COMPONENTS_INIT
    config RT_USING_USER_MAIN
        bool "The main() function as user entry function"
        default y
endif

source "$RTT_DIR/components/cplusplus/KConfig"

source "$RTT_DIR/components/finsh/KConfig"

source "$RTT_DIR/components/dfs/KConfig"

source "$RTT_DIR/components/drivers/KConfig"

source "$RTT_DIR/components/libc/KConfig"

source "$RTT_DIR/components/net/KConfig"

source "$RTT_DIR/components/gui/Kconfig"

source "$RTT_DIR/components/vbus/Kconfig"

endmenu
```

## components/Kconfig
```kconfig
menu "RT-Thread Components"

config RT_USING_COMPONENTS_INIT
    bool
    default n
    help
        Enable automatic component initialization framework.
        
        When enabled, components marked with INIT_EXPORT() macros will be
        automatically initialized during system startup in proper order.
        
        Initialization levels (in order):
        - INIT_BOARD_EXPORT: Board-level initialization (pins, clocks)
        - INIT_PREV_EXPORT: Early driver initialization
        - INIT_DEVICE_EXPORT: Device driver initialization
        - INIT_COMPONENT_EXPORT: Component initialization
        - INIT_ENV_EXPORT: Environment initialization
        - INIT_APP_EXPORT: Application initialization
        
        Benefits:
        - Automatic dependency ordering
        - Cleaner code (no manual init function calls)
        - Consistent initialization across components
        
        Note: Most RT-Thread components rely on this. Usually enabled automatically
        by build system.

config RT_USING_USER_MAIN
    bool
    default n
    help
        Use user-defined main() function as entry point.
        
        When enabled, RT-Thread creates a main thread that calls your main() function,
        allowing traditional C programming style entry point.
        
        Without this option: You must manually create threads from application
        With this option: Your main() function runs in a dedicated main thread
        
        The main thread:
        - Runs after system initialization
        - Has configurable stack size and priority
        - Can use RT-Thread APIs like any other thread
        - Can create additional threads
        
        Enable this for easier application development and familiar entry point.

    if RT_USING_USER_MAIN
        config RT_MAIN_THREAD_STACK_SIZE
            int "Set main thread stack size"
            default 6144 if ARCH_CPU_64BIT
            default 2048
            help
                Stack size in bytes for the main thread.
                
                Default values:
                - 64-bit architectures: 6144 bytes (6KB)
                - 32-bit architectures: 2048 bytes (2KB)
                
                Increase if:
                - Deep recursion in main()
                - Large local variables
                - Stack overflow in main thread
                - Complex initialization requiring more stack
                
                Decrease for memory-constrained systems if main() is simple.
                
                Note: Each thread's stack is separate. This only affects main thread.

        config RT_MAIN_THREAD_PRIORITY
            int "Set main thread priority"
            default 4   if RT_THREAD_PRIORITY_8
            default 10  if RT_THREAD_PRIORITY_32
            default 85  if RT_THREAD_PRIORITY_256
            help
                Priority of the main thread (lower number = higher priority).
                
                Default values scale with priority levels:
                - 8 levels: Priority 4 (middle-low priority)
                - 32 levels: Priority 10 (medium priority)
                - 256 levels: Priority 85 (medium-low priority)
                
                Lower values (higher priority) if:
                - Main thread needs to preempt other tasks
                - Time-critical initialization in main()
                
                Higher values (lower priority) if:
                - Main thread is just coordination/monitoring
                - Other threads need priority over main
                
                Note: Priority 0 is highest, maximum is configured by RT_THREAD_PRIORITY_MAX.
    endif

config RT_USING_LEGACY
    bool "Support legacy version for compatibility"
    default n
    help
        Enable compatibility layer for legacy RT-Thread versions.
        
        Provides deprecated APIs and compatibility shims for older code,
        allowing gradual migration to newer RT-Thread versions.
        
        Includes:
        - Deprecated API wrappers
        - Legacy component interfaces
        - Backward-compatible behavior
        
        Enable if:
        - Porting code from older RT-Thread versions
        - Using third-party libraries requiring legacy APIs
        - Gradual migration strategy
        
        Disable for:
        - New projects (use modern APIs)
        - Smaller code size
        - Better performance (no compatibility overhead)
        
        Note: Legacy support may be removed in future versions.
        Plan to migrate to current APIs.

if RT_USING_CONSOLE
rsource "finsh/Kconfig"
endif

if !RT_USING_NANO
rsource "dfs/Kconfig"
rsource "fal/Kconfig"
rsource "drivers/Kconfig"
rsource "libc/Kconfig"
rsource "net/Kconfig"
rsource "mprotect/Kconfig"
rsource "utilities/Kconfig"
endif

if ARCH_MM_MMU
rsource "mm/Kconfig"
endif

if RT_USING_SMART
rsource "lwp/Kconfig"
endif

rsource "legacy/Kconfig"
rsource "rust/Kconfig"
endmenu
```

## components/arduino/Kconfig
```kconfig
menuconfig RT_USING_ARDUINO
    bool "Compatible with Arduino ecology"
    select RT_USING_CPLUSPLUS
    select RT_USING_PIN
    default n

if RT_USING_ARDUINO
    config RT_USING_ARDUINO_UNO_LAYOUT
        bool "Support Arduino UNO layout"
        default n

    config RT_USING_ARDUINO_THREAD_SIZE
        int "arduino thread's size"
        default 1024

    config RT_USING_ARDUINO_THREAD_PRIO
        int "arduino thread's priority"
        default 20
endif
```

## components/cplusplus/KConfig
```kconfig
menu "C++ features"

config RT_USING_CPLUSPLUS
    bool "Support C++ features"
    default n

endmenu
```

## components/cplusplus/Kconfig
```kconfig
menu "C++ features"

config RT_USING_CPLUSPLUS
    bool "Support C++ features"
    default n

if RT_USING_CPLUSPLUS

    config RT_USING_CPLUSPLUS11
        bool "Enable c++11 threading feature support"
        default n
        select RT_USING_LIBC
        select RT_LIBC_USING_FILEIO
        select RT_USING_PTHREADS
        select RT_USING_RTC

endif

endmenu
```

## components/custom_fee/Kconfig
```kconfig
config COMPONENT_USING_CUSTOM_FEE
    bool "using component custom fee"
    default n

if COMPONENT_USING_CUSTOM_FEE

config CUSTOM_FEE_MOCK_FLASH_SIZE
    hex "RAM mock flash size"
    default 0xA0000

endif
```

## components/dfs/KConfig
```kconfig
menu "Device virtual file system"

config RT_USING_DFS
    bool "Using device virtual file system"
    default y
    help
        The device file system is a light weight virtual file system.

if RT_USING_DFS
    config DFS_USING_WORKDIR
        bool "Using working directory"
        default y

    config DFS_FILESYSTEMS_MAX
        int "The maximal number of mounted file system"
        default 2
    
    config DFS_FD_MAX
        int "The maximal number of opened files"
        default 4
    
    config RT_USING_DFS_ELMFAT
        bool "Enable elm-chan fatfs"
        default y
        help
            FatFs is a generic FAT/exFAT file system module for small embedded systems.
    if RT_USING_DFS_ELMFAT
        config RT_DFS_ELM_CODE_PAGE
            int "OEM code page"
            default 437
        
        config RT_DFS_ELM_MAX_LFN
            int "Maximal size of file name length"
            default 256
        
        config RT_DFS_ELM_DRIVES
            int "Number of volumes (logical drives) to be used."
            default 2
        
        config RT_DFS_ELM_MAX_SECTOR_SIZE
            int "Maximum sector size to be handled."
            default 512
            help
                if you use some spi nor flash for fatfs, please set this the erase sector size, for example 4096.

        config RT_DFS_ELM_USE_ERASE
            bool "Enable sector erase feature"
            default n
        
        config RT_DFS_ELM_REENTRANT
            bool "Enable the reentrancy (thread safe) of the FatFs module"
            default y
    endif

    config RT_USING_DFS_DEVFS
        bool "Using devfs for device objects"
        default y
    
    config RT_USING_DFS_NET
        bool "Enable BSD socket operated by file system API"
        default n
        help
            Let BSD socket operated by file system API, such as read/write and involveed in select/poll POSIX APIs.

    config RT_USING_DFS_NFS
        bool "Using NFS v3 client file system"
        default n

    if RT_USING_DFS_NFS
        config RT_NFS_HOST_EXPORT
            string "NFSv3 host export"
            default "192.168.1.5:/"
    endif

endif

endmenu
```

## components/dfs/dfs_v2/Kconfig
```kconfig
if RT_USING_DFS_V2
    config RT_USING_DFS_DEVFS
        bool "Using devfs for device objects"
        default y

    config RT_USING_DFS_ROMFS
        bool "Enable ReadOnly file system on flash"
        default n

    config RT_USING_DFS_CROMFS
        bool "Enable ReadOnly compressed file system on flash"
        default n
        # select PKG_USING_ZLIB

    config RT_USING_DFS_RAMFS
        bool "Enable RAM file system"
        select RT_USING_MEMHEAP
        default n

    config RT_USING_DFS_TMPFS
        bool "Enable TMP file system"
        default n

    config RT_USING_DFS_NFS
        bool "Using NFS v3 client file system"
        depends on RT_USING_LWIP
        default n

    if RT_USING_DFS_NFS
        config RT_NFS_HOST_EXPORT
            string "NFSv3 host export"
            default "192.168.1.5:/"
    endif

endif
```

## components/dfs/utest/Kconfig
```kconfig
if RT_USING_DFS
    menu "File System"

    config RT_UTEST_TC_USING_DFS_API
        bool "DFS API Test"
        default n
        help
            Enable DFS native API unit tests including file operations like open, 
            read, write, close, stat, unlink and rename

        if RT_UTEST_TC_USING_DFS_API

            config RT_UTEST_TC_USING_POSIX_API
                bool "POSIX API Test"
                default n
                depends on RT_USING_POSIX_FS
                help
                    Enable POSIX filesystem API unit tests including file operations,
                    directory operations, and file permission tests

            config RT_UTEST_DFS_MNT_PATH
                string "Mount Path for DFS Test"
                default ""
                help
                    Configure the mount point path where the test filesystem will be mounted.
                    All test files and directories will be created under this path

            config RT_UTEST_DFS_FS_TYPE
                string "Filesystem Type for Test"
                default "elm"
                help
                    Configure the filesystem type for unit test (e.g., elm, fat).
                    This will be used for dfs_mkfs() and dfs_mount() operations

            config RT_UTEST_DFS_BLOCK_DEV
                string "Block Device Name for Test"
                default "sd0"
                help
                    Configure the block device name for unit test (e.g., sd0, sd1).
                    This device will be formatted and mounted during testing

        endif
    endmenu
endif
```
