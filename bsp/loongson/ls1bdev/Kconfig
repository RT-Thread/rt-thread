## bsp/microchip/samc21/board/Kconfig
```kconfig
menu "Hardware Drivers Config"

choice
    prompt "select chip type"
    default SOC_SAMC21J18

    config SOC_SAMC21J18
    bool "SOC_SAMC21J18"
    help
        Refer to SAMC21 DataSheet

    config SOC_SAMC21G18
    bool "SOC_SAMC21G18"
    help
        Refer to SAMC21 DataSheet

    config SOC_SAMC21E18
    bool "SOC_SAMC21E18"
    help
        Refer to SAMC21 DataSheet

endchoice
endmenu

menu "Onboard Peripheral Drivers"
    depends on SOC_SAMC21J18

    config SAMC21_CAN0
        bool "Enable CAN0"
        default false

    config SAMC21_ADC0
        bool "Enable ADC0"
        default false

    config SAMC21_I2C0
        bool "Enable I2C0"
        default false

endmenu

menu "Application Demo Config"
    config SAM_CAN_EXAMPLE
        bool "Enable SAM CAN Example"
        depends on SAMC21_CAN0
        default true
        help
            Add CAN example task to project

    config SAM_ADC_EXAMPLE
        bool "Enable SAM ADC Example"
        depends on SAMC21_ADC0
        default true
        help
            Add ADC example task to project

    config SAM_I2C_EXAMPLE
        bool "Enable SAM I2C Example"
        depends on SAMC21_I2C0
        default true
        help
            Add I2C example task to project
endmenu
```

## bsp/microchip/samd51-seeed-wio-terminal/board/Kconfig
```kconfig
menu "Hardware Drivers Config"

choice
    prompt "select chip type"
    default SOC_SAMD51P19

    config SOC_SAMD51J19
    bool "SOC_SAMD51J19"
    help
        Refer to SAMD51 DataSheet

    config SOC_SAMD51P19
    bool "SOC_SAMD51P19"
    help
        Refer to SAMD51 DataSheet

    config SOC_SAME54P20
    bool "SOC_SAME54P20"
    help
        Refer to SAME54 DataSheet

    config SOC_SAME54N20
    bool "SOC_SAME54N20"
    help
        Refer to SAME54 DataSheet

    config SOC_SAME53J20
    bool "SOC_SAME53J20"
    help
        Refer to SAME54 DataSheet

endchoice
endmenu

menu "Onboard Peripheral Drivers"
    depends on SOC_SAMD51J19 || SOC_SAMD51P19

    config SAMD5X_ADC0
        bool "Enable ADC0"
        default false

    config SAMD5X_I2C0
        bool "Enable I2C0"
        default false
endmenu

menu "Application Demo Config"
    config SAM_ADC_EXAMPLE
        bool "Enable SAM ADC Example"
        depends on SAMD5X_ADC0
        default false
        help
            Add ADC example task to project

    config SAM_I2C_EXAMPLE
        bool "Enable SAM I2C Example"
        depends on SAMD5X_I2C0
        default false
        help
            Add I2C example task to project

endmenu
```

## bsp/microchip/same54/board/Kconfig
```kconfig
menu "Hardware Drivers Config"

choice
    prompt "select chip type"
    default SOC_SAME54P20

    config SOC_SAME54P20
    bool "SOC_SAME54P20"
    help
        Refer to SAME54 DataSheet

    config SOC_SAME54N20
    bool "SOC_SAME54N20"
    help
        Refer to SAME54 DataSheet

    config SOC_SAME53J20
    bool "SOC_SAME53J20"
    help
        Refer to SAME54 DataSheet

endchoice
endmenu

menu "Onboard Peripheral Drivers"
    depends on SOC_SAME54P20 || SOC_SAME54N20

    config SAME5X_CAN0
        bool "Enable CAN0"
        default false

    config SAME5X_ADC0
        bool "Enable ADC0"
        default false

    config SAME5X_I2C0
        bool "Enable I2C0"
        default false

    config SAME5X_GMAC
        bool "Enable GMAC"
        default false
endmenu

menu "Application Demo Config"
    config SAM_CAN_EXAMPLE
        bool "Enable SAM CAN Example"
        depends on SAME5X_CAN0
        default true
        help
            Add CAN example task to project

    config SAM_ADC_EXAMPLE
        bool "Enable SAM ADC Example"
        depends on SAME5X_ADC0
        default true
        help
            Add ADC example task to project

    config SAM_I2C_EXAMPLE
        bool "Enable SAM I2C Example"
        depends on SAME5X_I2C0
        default true
        help
            Add I2C example task to project

    config SAM_LWIP_EXAMPLE
        bool "Enable SAM LWIP Example"
        depends on SAME5X_GMAC
        default false
        help
            Add GMAC LWIP example task to project

endmenu
```
