## bsp/n32/n32g45xvl-stb/board/Kconfig
```kconfig
menu "Hardware Drivers Config"

config SOC_SERIES_N32G45X
    bool
    default y

config SOC_N32G45X
    bool
    select SOC_SERIES_N32G45X
    select RT_USING_COMPONENTS_INIT
    select RT_USING_USER_MAIN
    default y

menu "Onboard Peripheral Drivers"

endmenu

menu "On-chip Peripheral Drivers"

    config BSP_USING_GPIO
        bool "Enable GPIO"
        select RT_USING_PIN
        default y

    menuconfig BSP_USING_UART
        bool "Enable UART"
        default y
        select RT_USING_SERIAL
        if BSP_USING_UART
            menuconfig BSP_USING_USART1
                bool "Enable USART1"
                default y
                if BSP_USING_USART1
                    choice
                        prompt "Set usart1 afio mode"
                        default BSP_USART1_AFIO_MODE_PA9_PA10

                        config BSP_USART1_AFIO_MODE_PA9_PA10
                            bool
                            prompt "PA9 PA10"

                        config BSP_USART1_AFIO_MODE_PB6_PB7
                            bool
                            prompt "PB6 PB7"
                    endchoice
                    
                    config BSP_UART1_RX_USING_DMA
                        bool "Enable usart1 rx dma"
                        depends on BSP_USING_USART1 && RT_SERIAL_USING_DMA
                        default n

                    config BSP_UART1_TX_USING_DMA
                        bool "Enable usart1 tx dma"
                        depends on BSP_USING_USART1 && RT_SERIAL_USING_DMA
                        default n

                    config BSP_UART1_DMA_PING_BUFSIZE
                        int "Set UART1 RX DMA ping-pong buffer size"
                        range 16 65535
                        depends on RT_USING_SERIAL_V2 && BSP_UART1_RX_USING_DMA
                        default 32

                    config BSP_UART1_RX_BUFSIZE
                        int "Set rx buffer size"
                        range 0 16384
                        depends on RT_USING_SERIAL_V2
                        default 256

                    config BSP_UART1_TX_BUFSIZE
                        int "Set tx buffer size"
                        range 0 16384
                        depends on RT_USING_SERIAL_V2
                        default 0
                endif

            menuconfig BSP_USING_USART2
                bool "Enable USART2"
                default n
                if BSP_USING_USART2
                    choice
                        prompt "Set usart2 afio mode"
                        default BSP_USART2_AFIO_MODE_PA2_PA3

                        config BSP_USART2_AFIO_MODE_PA2_PA3
                            bool
                            prompt "PA2 PA3"

                        config BSP_USART2_AFIO_MODE_PD5_PD6
                            bool
                            prompt "PD5 PD6"

                        config BSP_USART2_AFIO_MODE_PC8_PC9
                            bool
                            prompt "PC8 PC9"

                        config BSP_USART2_AFIO_MODE_PB4_PB5
                            bool
                            prompt "PB4 PB5"
                    endchoice
        
                    config BSP_UART2_RX_USING_DMA
                        bool "Enable usart2 rx dma"
                        depends on BSP_USING_USART2 && RT_SERIAL_USING_DMA
                        default n

                    config BSP_UART2_TX_USING_DMA
                        bool "Enable usart2 tx dma"
                        depends on BSP_USING_USART2 && RT_SERIAL_USING_DMA
                        default n

                    config BSP_UART2_DMA_PING_BUFSIZE
                        int "Set UART2 RX DMA ping-pong buffer size"
                        range 16 65535
                        depends on RT_USING_SERIAL_V2 && BSP_UART2_RX_USING_DMA
                        default 32

                    config BSP_UART2_RX_BUFSIZE
                        int "Set rx buffer size"
                        range 256 16384
                        depends on RT_USING_SERIAL_V2
                        default 256

                    config BSP_UART2_TX_BUFSIZE
                        int "Set tx buffer size"
                        range 0 16384
                        depends on RT_USING_SERIAL_V2
                        default 0
                endif

            menuconfig BSP_USING_USART3
                bool "Enable USART3"
                default n
                if BSP_USING_USART3
                    choice
                        prompt "Set usart3 afio mode"
                        default BSP_USART3_AFIO_MODE_PB10_PB11

                        config BSP_USART3_AFIO_MODE_PB10_PB11
                            bool
                            prompt "PB10 PB11"

                        config BSP_USART3_AFIO_MODE_PC10_PC11
                            bool
                            prompt "PC10 PC11"

                        config BSP_USART3_AFIO_MODE_PD8_PD9
                            bool
                            prompt "PD8 PD9"
                    endchoice
        
                    config BSP_UART3_RX_USING_DMA
                        bool "Enable usart3 rx dma"
                        depends on BSP_USING_USART3 && RT_SERIAL_USING_DMA
                        default n

                    config BSP_UART3_TX_USING_DMA
                        bool "Enable usart3 tx dma"
                        depends on BSP_USING_USART3 && RT_SERIAL_USING_DMA
                        default n

                    config BSP_UART3_DMA_PING_BUFSIZE
                        int "Set UART3 RX DMA ping-pong buffer size"
                        range 16 65535
                        depends on RT_USING_SERIAL_V2 && BSP_UART3_RX_USING_DMA
                        default 32

                    config BSP_UART3_RX_BUFSIZE
                        int "Set rx buffer size"
                        range 256 16384
                        depends on RT_USING_SERIAL_V2
                        default 256

                    config BSP_UART3_TX_BUFSIZE
                        int "Set tx buffer size"
                        range 0 16384
                        depends on RT_USING_SERIAL_V2
                        default 0
                endif

            menuconfig BSP_USING_UART4
                bool "Enable UART4"
                default n
                if BSP_USING_UART4
                    choice
                        prompt "Set uart4 afio mode"
                        default BSP_UART4_AFIO_MODE_PC10_PC11

                        config BSP_UART4_AFIO_MODE_PC10_PC11
                            bool
                            prompt "PC10 PC11"

                        config BSP_UART4_AFIO_MODE_PB2_PE7
                            bool
                            prompt "PB2 PE7"

                        config BSP_UART4_AFIO_MODE_PA13_PA14
                            bool
                            prompt "PA13 PA14"

                        config BSP_UART4_AFIO_MODE_PD0_PD1
                            bool
                            prompt "PD0 PD1"
                    endchoice
        
                    config BSP_UART4_RX_USING_DMA
                        bool "Enable uart4 rx dma"
                        depends on BSP_USING_UART4 && RT_SERIAL_USING_DMA
                        default n

                    config BSP_UART4_TX_USING_DMA
                        bool "Enable uart4 tx dma"
                        depends on BSP_USING_UART4 && RT_SERIAL_USING_DMA
                        default n

                    config BSP_UART4_DMA_PING_BUFSIZE
                        int "Set UART4 RX DMA ping-pong buffer size"
                        range 16 65535
                        depends on RT_USING_SERIAL_V2 && BSP_UART4_RX_USING_DMA
                        default 32
                        
                    config BSP_UART4_RX_BUFSIZE
                        int "Set rx buffer size"
                        range 256 16384
                        depends on RT_USING_SERIAL_V2
                        default 256

                    config BSP_UART4_TX_BUFSIZE
                        int "Set tx buffer size"
                        range 0 16384
                        depends on RT_USING_SERIAL_V2
                        default 0
                endif

            menuconfig BSP_USING_UART5
                bool "Enable UART5"
                default n
                if BSP_USING_UART5
                    choice
                        prompt "Set uart5 afio mode"
                        default BSP_UART5_AFIO_MODE_PC12_PD2

                        config BSP_UART5_AFIO_MODE_PC12_PD2
                            bool
                            prompt "PC12 PD2"

                        config BSP_UART5_AFIO_MODE_PB13_PB14
                            bool
                            prompt "PB13 PB14"

                        config BSP_UART5_AFIO_MODE_PE8_PE9
                            bool
                            prompt "PE8 PE9"

                        config BSP_UART5_AFIO_MODE_PB8_PB9
                            bool
                            prompt "PB8 PB9"
                    endchoice
        
                    config BSP_UART5_RX_USING_DMA
                        bool "Enable uart5 rx dma"
                        depends on BSP_USING_UART5 && RT_SERIAL_USING_DMA
                        default n

                    config BSP_UART5_TX_USING_DMA
                        bool "Enable uart5 tx dma"
                        depends on BSP_USING_UART5 && RT_SERIAL_USING_DMA
                        default n

                    config BSP_UART5_DMA_PING_BUFSIZE
                        int "Set UART5 RX DMA ping-pong buffer size"
                        range 16 65535
                        depends on RT_USING_SERIAL_V2 && BSP_UART5_RX_USING_DMA
                        default 32
                        
                    config BSP_UART5_RX_BUFSIZE
                        int "Set rx buffer size"
                        range 256 16384
                        depends on RT_USING_SERIAL_V2
                        default 256

                    config BSP_UART5_TX_BUFSIZE
                        int "Set tx buffer size"
                        range 0 16384
                        depends on RT_USING_SERIAL_V2
                        default 0
                endif

            menuconfig BSP_USING_UART6
                bool "Enable UART6"
                default n
                if BSP_USING_UART6
                    choice
                        prompt "Set uart6 afio mode"
                        default BSP_UART6_AFIO_MODE_PE2_PE3

                        config BSP_UART6_AFIO_MODE_PE2_PE3
                            bool
                            prompt "PE2 PE3"

                        config BSP_UART6_AFIO_MODE_PC0_PC1
                            bool
                            prompt "PC0 PC1"

                        config BSP_UART6_AFIO_MODE_PB0_PB1
                            bool
                            prompt "PB0 PB1"
                    endchoice
        
                    config BSP_UART6_RX_USING_DMA
                        bool "Enable uart6 rx dma"
                        depends on BSP_USING_UART6 && RT_SERIAL_USING_DMA
                        default n

                    config BSP_UART6_TX_USING_DMA
                        bool "Enable uart6 tx dma"
                        depends on BSP_USING_UART6 && RT_SERIAL_USING_DMA
                        default n

                    config BSP_UART6_DMA_PING_BUFSIZE
                        int "Set UART6 RX DMA ping-pong buffer size"
                        range 16 65535
                        depends on RT_USING_SERIAL_V2 && BSP_UART6_RX_USING_DMA
                        default 32

                    config BSP_UART6_RX_BUFSIZE
                        int "Set rx buffer size"
                        range 256 16384
                        depends on RT_USING_SERIAL_V2
                        default 256

                    config BSP_UART6_TX_BUFSIZE
                        int "Set tx buffer size"
                        range 0 16384
                        depends on RT_USING_SERIAL_V2
                        default 0
                endif

            menuconfig BSP_USING_UART7
                bool "Enable UART7"
                default n
                if BSP_USING_UART7
                    choice
                        prompt "Set uart7 afio mode"
                        default BSP_UART7_AFIO_MODE_PC4_PC5

                        config BSP_UART7_AFIO_MODE_PC4_PC5
                            bool
                            prompt "PC4 PC5"

                        config BSP_UART7_AFIO_MODE_PC2_PC3
                            bool
                            prompt "PC2 PC3"

                        config BSP_UART6_AFIO_MODE_PG0_PG1
                            bool
                            prompt "PG0 PG1"
                    endchoice
        
                    config BSP_UART7_RX_USING_DMA
                        bool "Enable uart7 rx dma"
                        depends on BSP_USING_UART7 && RT_SERIAL_USING_DMA
                        default n

                    config BSP_UART7_TX_USING_DMA
                        bool "Enable uart7 tx dma"
                        depends on BSP_USING_UART7 && RT_SERIAL_USING_DMA
                        default n

                    config BSP_UART7_DMA_PING_BUFSIZE
                        int "Set UART7 RX DMA ping-pong buffer size"
                        range 16 65535
                        depends on RT_USING_SERIAL_V2 && BSP_UART7_RX_USING_DMA
                        default 32

                    config BSP_UART7_RX_BUFSIZE
                        int "Set rx buffer size"
                        range 256 16384
                        depends on RT_USING_SERIAL_V2
                        default 256

                    config BSP_UART7_TX_BUFSIZE
                        int "Set tx buffer size"
                        range 0 16384
                        depends on RT_USING_SERIAL_V2
                        default 0
                endif
        endif

    menuconfig BSP_USING_SPI
        bool "Enable SPI BUS"
        default n
        select RT_USING_SPI
        if BSP_USING_SPI
            config BSP_USING_SPI1
                bool "Enable SPI1 BUS"
                default n

            config BSP_USING_SPI2
                bool "Enable SPI2 BUS"
                default n

            config BSP_USING_SPI3
                bool "Enable SPI3 BUS"
                default n

        endif

    menuconfig BSP_USING_I2C1
        bool "Enable I2C1 BUS (software simulation)"
        default n
        select RT_USING_I2C
        select RT_USING_I2C_BITOPS
        select RT_USING_PIN
        if BSP_USING_I2C1
            config BSP_I2C1_SCL_PIN
                int "i2c1 scl pin number"
                range 0 111
                default 22
            config BSP_I2C1_SDA_PIN
                int "I2C1 sda pin number"
                range 0 111
                default 23
        endif

    menuconfig BSP_USING_RTC
        bool "Enable RTC"
        select RT_USING_RTC
        default n
        if BSP_USING_RTC
            choice
                prompt "Select clock source"
                default BSP_RTC_USING_LSE

                config BSP_RTC_USING_LSE
                    bool "RTC USING LSE"

                config BSP_RTC_USING_HSE
                    bool "RTC USING HSE"

                config BSP_RTC_USING_LSI
                    bool "RTC USING LSI"
            endchoice
        endif

    config BSP_USING_WDT
        bool "Enable Watchdog Timer"
        select RT_USING_WDT
        default n

    menuconfig BSP_USING_HWTIMER
        bool "Enable hwtimer"
        default n
        select RT_USING_HWTIMER
        if BSP_USING_HWTIMER
            config BSP_USING_HWTIMER1
                bool "using hwtimer1"
                default n
            config BSP_USING_HWTIMER2
                bool "using hwtimer2"
                default n
            config BSP_USING_HWTIMER3
                bool "using hwtimer3"
                default n
            config BSP_USING_HWTIMER4
                bool "using hwtimer4"
                default n
            config BSP_USING_HWTIMER5
                bool "using hwtimer5"
                default n
            config BSP_USING_HWTIMER6
                bool "using hwtimer6"
                default n
            config BSP_USING_HWTIMER7
                bool "using hwtimer7"
                default n
            config BSP_USING_HWTIMER8
                bool "using hwtimer8"
                default n
        endif

    menuconfig BSP_USING_ADC
        bool "Enable ADC"
        default n
        select RT_USING_ADC
        if BSP_USING_ADC
            config BSP_USING_ADC1
                bool "using adc1"
                default n
            config BSP_USING_ADC2
                bool "using adc2"
                default n
            config BSP_USING_ADC3
                bool "using adc3"
                default n
            config BSP_USING_ADC4
                bool "using adc4"
                default n
        endif

    menuconfig BSP_USING_DAC
        bool "Enable DAC"
        default n
        select RT_USING_DAC
        if BSP_USING_DAC
            config BSP_USING_DAC1
                bool "using dac1"
                default n
            config BSP_USING_DAC2
                bool "using dac2"
                default n
        endif

    menuconfig BSP_USING_CAN
        bool "Enable CAN"
        default n
        select RT_USING_CAN
        if BSP_USING_CAN
            config BSP_USING_CAN1
                bool "using can1"
                default n
            config BSP_USING_CAN2
                bool "using can2"
                default n
        endif

    rsource "../../libraries/n32_drivers/Kconfig"

endmenu

menu "Board extended module Drivers"

endmenu

endmenu
```
