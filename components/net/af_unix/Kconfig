## components/net/af_unix/Kconfig
```kconfig
menuconfig RT_USING_AF_UNIX
    bool "AF_UNIX local sockets"
    depends on RT_USING_SAL
    depends on SAL_USING_POSIX
    depends on RT_USING_DFS_V2
    default n
    help
        Enable pathname-based AF_UNIX SOCK_DGRAM and SOCK_STREAM sockets.

if RT_USING_AF_UNIX

config AF_UNIX_DGRAM_MAX_SIZE
    int "Maximum datagram size"
    range 128 65535
    default 4096

config AF_UNIX_DGRAM_QUEUE_LEN
    int "Datagram receive queue length"
    range 1 256
    default 16

config AF_UNIX_STREAM_BUFFER_SIZE
    int "Stream receive buffer size"
    range 256 65535
    default 4096

config AF_UNIX_LISTEN_BACKLOG_MAX
    int "Maximum stream listen backlog"
    range 1 128
    default 16

config AF_UNIX_RIGHTS_MAX
    int "Maximum file descriptors per SCM_RIGHTS message"
    range 1 253
    default 16

config RT_AF_UNIX_USING_TESTCASES
    bool "Build AF_UNIX test cases"
    depends on RT_USING_UTESTCASES
    default n

endif
```

## components/utilities/asan/Kconfig
```kconfig
menuconfig RT_USING_ASAN
    bool "Enable AddressSanitizer (heap overflow & use-after-free check)"
    default n
    depends on RT_USING_HEAP && !RT_USING_USERHEAP
    depends on RT_USING_SMALL_MEM_AS_HEAP || RT_USING_MEMHEAP_AS_HEAP || RT_USING_SLAB_AS_HEAP
    depends on !RT_USING_SMP || RT_USING_MUTEX || RT_USING_HEAP_ISR
    help
        Enable runtime AddressSanitizer (kernel-address) support. It
        instruments memory accesses to detect heap buffer overflow and
        use-after-free at runtime.

        It requires the toolchain to support '-fsanitize=kernel-address'
        (GCC 8+, verified on ARM and RISC-V).

        The shadow memory is a static array of RT_ASAN_SHADOW_SIZE bytes
        and covers the first RT_ASAN_SHADOW_SIZE * 8 bytes of the heap.
        Accesses beyond that range are not checked.

        Each allocation reserves a size header, alignment padding and at least
        8 bytes of right redzone. Realloc grows within its reserved capacity or
        allocates and copies the requested user bytes; shrinking keeps capacity.
        Aligned allocations also use the requested size for their redzones.
        Only the system heap APIs are wrapped; direct allocator/page APIs and
        accesses in prebuilt, uninstrumented libraries are not checked.

        The component overrides the weak system heap interfaces and owns
        the underlying allocator, heap lock and allocation hooks. Do not
        combine it with another implementation overriding the same APIs.

        SMP requires a mutex or the interrupt-safe heap spinlock to
        serialize allocator access across CPUs.

        Heap algorithm support:
          - small mem (RT_USING_SMALL_MEM_AS_HEAP): full support, detects
            both heap-buffer-overflow and use-after-free.
          - slab (RT_USING_SLAB_AS_HEAP) and memheap
            (RT_USING_MEMHEAP_AS_HEAP): detects heap-buffer-overflow only.
            Their allocators reuse freed blocks for internal metadata written
            through instrumented rt_memset/rt_memcpy, so poisoning a whole
            freed block would raise false positives; use-after-free is
            therefore disabled for these two.
          - userheap (RT_USING_USERHEAP): not supported (mutually exclusive).

    if RT_USING_ASAN
        config RT_ASAN_SHADOW_SIZE
            int "ASan shadow memory size (bytes)"
            default 65536
            help
                Size of the static shadow memory array. Each byte maps 8
                bytes of the heap, so the checked heap range is
                RT_ASAN_SHADOW_SIZE * 8 bytes.

        config RT_ASAN_TRACK_MAX
            int "Max number of tracked active allocations"
            default 512
            help
                Size of the allocation tracking table. Each entry records
                one live block (ptr, size, owner thread). Reduce this on
                memory-constrained MCUs (e.g. 128 or 64). When the table
                is full, further allocations still get redzones and free/realloc
                handling, but reports may lack allocation/owner details.

        config RT_ASAN_BACKTRACE
            bool "Print full backtrace on report"
            default y
            help
                When a violation is reported, also dump the full call stack
                of the faulting thread via rt_backtrace(). This requires the
                target architecture to implement a backtrace backend (unwind
                table or frame pointer chain). Architectures without one
                print nothing extra.
    endif
```

## components/utilities/asan/utest/Kconfig
```kconfig
menu "AddressSanitizer"

config RT_UTEST_ASAN
    bool "AddressSanitizer Test"
    default n
    depends on RT_USING_ASAN

config RT_UTEST_ASAN_LIBC
    bool "ASan string and formatting boundary tests"
    default n
    depends on RT_UTEST_ASAN
    help
        Verify library accesses to the instrumented system heap. Known
        coverage gaps are printed as observations, rather than required
        behavior. Valid operations must not report violations. This suite
        can expose existing library bugs and is enabled separately.

endmenu
```

## libcpu/Kconfig
```kconfig
if ARCH_ARMV8 && ARCH_CPU_64BIT
    orsource "./aarch64/Kconfig"
endif

config ARCH_CPU_64BIT
    bool

config RT_USING_CACHE
    bool
    default n

config RT_USING_HW_ATOMIC
    bool
    default n

config ARCH_USING_HW_ATOMIC_8
    bool
    default n

config ARCH_USING_HW_ATOMIC_16
    bool
    default n

config ARCH_CPU_BIG_ENDIAN
    bool

orsource "arm/Kconfig"

config ARCH_CPU_STACK_GROWS_UPWARD
    bool
    default n

config RT_USING_CPU_FFS
    bool
    default n

config ARCH_MM_MMU
    bool

config ARCH_MM_MPU
    bool

if RT_USING_SMART
    config KERNEL_VADDR_START
        hex "The virtural address of kernel start"
        default 0xffff000000000000 if ARCH_ARMV8
        default 0xc0000000 if ARCH_ARM
        default 0xffffffc000000000 if ARCH_RISCV && ARCH_REMAP_KERNEL
        default 0x80000000 if ARCH_RISCV
        depends on ARCH_MM_MMU
endif

config ARCH_MIPS
    bool

config ARCH_MIPS64
    bool
    select ARCH_CPU_64BIT

config ARCH_MIPS_XBURST
    bool
    select ARCH_MIPS

config ARCH_ANDES
    bool

config ARCH_CSKY
    bool

config ARCH_POWERPC
    bool

config ARCH_RISCV
    bool

config ARCH_RISCV_FPU
    bool

config ARCH_RISCV_VECTOR
    bool

    if ARCH_RISCV_VECTOR
        choice ARCH_VECTOR_VLEN
            prompt "RISCV Vector Vlen"
            default ARCH_VECTOR_VLEN_128

            config ARCH_VECTOR_VLEN_128
                bool "128"
            config ARCH_VECTOR_VLEN_256
                bool "256"
            config ARCH_VECTOR_VLEN_512
                bool "512"
            config ARCH_VECTOR_VLEN_1024
                bool "1024"
            config ARCH_VECTOR_VLEN_2048
                bool "2048"
            config ARCH_VECTOR_VLEN_4096
                bool "4096"
        endchoice
    endif

config ARCH_RISCV_FPU_S
    select ARCH_RISCV_FPU
    bool

config ARCH_RISCV_FPU_D
    select ARCH_RISCV_FPU
    bool

config ARCH_RISCV32
    select ARCH_RISCV
    bool

config ARCH_RISCV64
    select ARCH_RISCV
    select ARCH_CPU_64BIT
    bool

config ARCH_RISCV_XUANTIE
    select ARCH_RISCV
    bool

if ARCH_RISCV
    orsource "./risc-v/Kconfig"
endif

if ARCH_RISCV64
    config ARCH_USING_NEW_CTX_SWITCH
        bool
        default y

    config ARCH_USING_RISCV_COMMON64
        bool
        depends on ARCH_RISCV64
        select RT_USING_CLOCK_TIME
        select ARCH_USING_NEW_CTX_SWITCH
        help
            Using the common64 implementation under ./libcpu/risc-v

if RT_USING_SMART
    config CONFIG_XUANTIE_SVPBMT
        int
        depends on ARCH_RISCV_XUANTIE
        default 1
endif

endif

config ARCH_REMAP_KERNEL
    bool
    depends on RT_USING_SMART
    help
        Remapping kernel image to high virtual address region

config ARCH_USING_ASID
    bool
    depends on RT_USING_SMART
    help
        Using ASID support from architecture

config ARCH_IA32
    bool

config ARCH_TIDSP
    bool

config ARCH_TIDSP_C28X
    bool
    select ARCH_TIDSP
    select ARCH_CPU_STACK_GROWS_UPWARD

config ARCH_HOST_SIMULATOR
    bool

config ARCH_CPU_STACK_GROWS_UPWARD
    bool
    default n

config ARCH_USING_HW_THREAD_SELF
    bool
    default n

config ARCH_USING_IRQ_CTX_LIST
    bool
    default n
```

## libcpu/arm/Kconfig
```kconfig
config ARCH_ARM_BOOTWITH_FLUSH_CACHE
    bool
    default n

config ARCH_ARM
    bool

config ARCH_ARM_CORTEX_M
    bool
    select ARCH_ARM

config ARCH_ARM_CORTEX_R
    bool
    select ARCH_ARM

config ARCH_ARM_CORTEX_FPU
    bool

config ARCH_ARM_CORTEX_SECURE
    bool

config ARCH_ARM_CORTEX_M0
    bool
    select ARCH_ARM_CORTEX_M

config ARCH_ARM_CORTEX_M3
    bool
    select ARCH_ARM_CORTEX_M
    select RT_USING_CPU_FFS
    select RT_USING_HW_ATOMIC
    select ARCH_USING_HW_ATOMIC_8
    select ARCH_USING_HW_ATOMIC_16

config ARCH_ARM_MPU
    bool
    depends on ARCH_ARM
    select ARCH_MM_MPU

config ARCH_ARM_CORTEX_M4
    bool
    select ARCH_ARM_CORTEX_M
    select RT_USING_CPU_FFS
    select RT_USING_HW_ATOMIC
    select ARCH_USING_HW_ATOMIC_8
    select ARCH_USING_HW_ATOMIC_16

config ARCH_ARM_CORTEX_M7
    bool
    select ARCH_ARM_CORTEX_M
    select RT_USING_CPU_FFS
    select RT_USING_CACHE
    select RT_USING_HW_ATOMIC
    select ARCH_USING_HW_ATOMIC_8
    select ARCH_USING_HW_ATOMIC_16

config ARCH_ARM_CORTEX_M85
    bool
    select ARCH_ARM_CORTEX_M
    select RT_USING_CPU_FFS
    select RT_USING_HW_ATOMIC
    select ARCH_USING_HW_ATOMIC_8
    select ARCH_USING_HW_ATOMIC_16

config ARCH_ARM_CORTEX_M23
    bool
    select ARCH_ARM_CORTEX_M
    select RT_USING_HW_ATOMIC
    select ARCH_USING_HW_ATOMIC_8
    select ARCH_USING_HW_ATOMIC_16

config ARCH_ARM_CORTEX_M33
    bool
    select ARCH_ARM_CORTEX_M
    select RT_USING_CPU_FFS
    select RT_USING_HW_ATOMIC
    select ARCH_USING_HW_ATOMIC_8
    select ARCH_USING_HW_ATOMIC_16

config ARCH_ARM_CORTEX_R
    bool
    select ARCH_ARM
    select RT_USING_HW_ATOMIC
    select ARCH_USING_HW_ATOMIC_8
    select ARCH_USING_HW_ATOMIC_16

config ARCH_ARM_CORTEX_R52
    bool
    select ARCH_ARM_CORTEX_R

config ARCH_ARM_MMU
    bool
    select RT_USING_CACHE
    select ARCH_MM_MMU
    depends on ARCH_ARM

if RT_USING_SMART
    config RT_IOREMAP_LATE
        bool "Support to create IO mapping in the kernel address space after system initlalization."
        default n
        depends on ARCH_ARM_CORTEX_A
        depends on ARCH_MM_MMU
endif

config ARCH_ARM_ARM9
    bool
    select ARCH_ARM

config ARCH_ARM_ARM11
    bool
    select ARCH_ARM

config ARCH_ARM_CORTEX_A
    bool
    select ARCH_ARM
    select ARCH_ARM_MMU
    select RT_USING_CPU_FFS
    select RT_USING_HW_ATOMIC
    select ARCH_USING_HW_ATOMIC_8
    select ARCH_USING_HW_ATOMIC_16

    if ARCH_ARM_CORTEX_A
        config RT_SMP_AUTO_BOOT
            bool
            default n

        config RT_USING_GIC_V2
            bool
            default n

        config RT_USING_GIC_V3
            bool
            default n

        config RT_NO_USING_GIC
            bool
            default y if !RT_USING_GIC_V2 && !RT_USING_GIC_V3
    endif

config ARCH_ARM_CORTEX_A5
    bool
    select ARCH_ARM_CORTEX_A

config ARCH_ARM_CORTEX_A7
    bool
    select ARCH_ARM_CORTEX_A

config ARCH_ARM_CORTEX_A8
    bool
    select ARCH_ARM_CORTEX_A

config ARCH_ARM_CORTEX_A9
    bool
    select ARCH_ARM_CORTEX_A

config ARCH_ARM_CORTEX_A55
    bool
    select ARCH_ARM_CORTEX_A

config ARCH_ARM_SECURE_MODE
    bool "Running in secure mode [ARM Cortex-A]"
    default n
    depends on ARCH_ARM_CORTEX_A

config RT_BACKTRACE_FUNCTION_NAME
    bool "To show function name when backtrace."
    default n
    depends on ARCH_ARM_CORTEX_A

config ARCH_ARMV8
    bool
    select ARCH_ARM
    select ARCH_ARM_MMU
    select RT_USING_CPU_FFS
    select ARCH_USING_ASID
    select ARCH_USING_IRQ_CTX_LIST
```

## libcpu/rh850/common/Kconfig
```kconfig
menu "RT-Thread RH850 CPU"

    config RT_USING_FPU
        bool "Using Float Point Unit"
        default y
        help
            Build for the hardware FPU and save its context.
            If disabled, the code is built with -msoft-float.

endmenu
```

## libcpu/risc-v/Kconfig
```kconfig
menu "RISC-V Architecture Configuration"

config RT_USING_RISCV_NEW_COMMON
    bool
    select RT_USING_CPU_FFS
    select RT_USING_HW_ATOMIC if RT_USING_SMP
    select RT_PAGE_MPR_SIZE_DYNAMIC if ARCH_MM_MMU
    help
      Select the unified RISC-V architecture implementation. BSPs that do
      not select this option continue to use the legacy implementation while
      the architecture migration is in progress.

if RT_USING_RISCV_NEW_COMMON

config ARCH_HAVE_EFFICIENT_UNALIGNED_ACCESS
    bool
    default n

config ARCH_RISCV_DISABLE_FENCE_I
    bool
    default n

config ARCH_RISCV_DISABLE_SFENCE_VMA_ASID
    bool
    default n

config ARCH_RISCV_M_MODE
    bool
    depends on !ARCH_MM_MMU
    default n

config ARCH_RISCV_32E
    bool
    depends on ARCH_RISCV32
    depends on !ARCH_MM_MMU
    depends on !RT_USING_DM

config ARCH_RISCV_USING_IRQ_STACK
    bool "Use a dedicated interrupt stack"
    depends on !RT_USING_SMART
    default y if ARCH_RISCV_M_MODE || !RT_USING_DM
    help
      Keep the saved exception frame on the interrupted thread stack, then
      run C-level trap and interrupt handlers on a per-CPU interrupt stack.
      This is recommended for MCU ports.

config ARCH_RISCV_IRQ_STACK_SIZE
    int "Interrupt stack size per CPU"
    depends on ARCH_RISCV_USING_IRQ_STACK
    range 256 65536
    default 1024

config RT_USING_USERSPACE_32BIT_LIMIT
    bool "Enable userspace 32bit limit"
    depends on ARCH_RISCV64
    default n

    config ARCH_TEXT_OFFSET
    hex "Kernel image offset from RAM base"
    default 0x200000 if ARCH_RISCV64
    default 0x400000

config ARCH_RAM_OFFSET
    hex "RAM base address"
    default 0

config ARCH_SECONDARY_CPU_STACK_SIZE
    int "Secondary CPU stack size"
    depends on RT_USING_SMP
    default 4096

config ARCH_HEAP_SIZE
    hex "Size of system heap"
    depends on RT_USING_DM

config ARCH_INIT_PAGE_SIZE
    hex "Size of init page region"
    depends on RT_USING_DM && ARCH_MM_MMU
    default 0x200000

endif

endmenu
```

## libcpu/risc-v/common/Kconfig
```kconfig
config ARCH_TEXT_OFFSET
    hex "Kernel image offset from RAM base"
    default 0x200000 if ARCH_RISCV64
    default 0x400000

config ARCH_RAM_OFFSET
    hex "RAM base address"
    default 0

config ARCH_SECONDARY_CPU_STACK_SIZE
    int "Secondary CPU stack size"
    depends on RT_USING_SMP
    default 4096

config ARCH_HEAP_SIZE
    hex "Size of system heap"
    depends on RT_USING_DM && ARCH_MM_MMU
    default 0x4000000

config ARCH_INIT_PAGE_SIZE
    hex "Size of init page region"
    depends on RT_USING_DM && ARCH_MM_MMU
    default 0x200000
```

## src/utest/perf/Kconfig
```kconfig
config RT_UTEST_SYS_PERF
    bool "Performance Test"
    default n
    select RT_USING_CLOCK_TIME
    help
        Enable kernel performance tests using a clock timer device.
        Enable a hardware timer driver in the BSP and set
        RT_UTEST_CLOCK_TIMER_DEV_NAME to its registered device name.

config RT_UTEST_SYS_PERF_TC_COUNT
    int "PerfTest: Number of cycles"
    default 1000
    depends on RT_UTEST_SYS_PERF

config RT_UTEST_CLOCK_TIMER_DEV_NAME
    string "PerfTest: Clock time timer device name"
    default "timer0"
    depends on RT_USING_CLOCK_TIME && RT_UTEST_SYS_PERF
    help
        Specify the hardware timer device name used for context switch testing (e.g., timer0).
```
