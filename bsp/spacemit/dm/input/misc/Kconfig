## bsp/spacemit/dm/input/misc/Kconfig
```kconfig
config RT_INPUT_MISC_PWRKEY_SPACEMIT_PMIC
    bool "Spacemit PMIC power key support"
    depends on RT_INPUT_MISC
    depends on RT_MFD_SPACEMIT_PMIC
    default n
```

## bsp/spacemit/dm/mfd/Kconfig
```kconfig
config RT_MFD_SPACEMIT_PMIC
    bool "Spacemit Power Management Chip"
    depends on RT_USING_PIC
    depends on RT_USING_I2C
    depends on RT_USING_OFW
    select RT_MFD_SYSCON
    default y
```

## bsp/spacemit/dm/pin/Kconfig
```kconfig
config RT_PIN_K1X
    bool "Spacemit K1X GPIO GPIO support"
    depends on RT_USING_OFW
    depends on RT_USING_ADT_BITMAP
    default y
```

## bsp/spacemit/dm/pinctrl/Kconfig
```kconfig
config RT_PINCTRL_SPACEMIT_PMIC
    bool "Pinctrl and GPIO driver for Spacemit PMIC"
    depends on RT_USING_PINCTRL
    depends on RT_MFD_SPACEMIT_PMIC
    default n
```

## bsp/spacemit/dm/pmdomain/Kconfig
```kconfig
config RT_PMDOMAIN_K1X
    bool "Spacemit k1x"
    depends on RT_MFD_SYSCON
    depends on RT_USING_CLK
    depends on RT_USING_REGULATOR
    default y
```

## bsp/spacemit/dm/pwm/Kconfig
```kconfig
config RT_PWM_PXA
    bool "PXA PWM support"
    depends on RT_USING_PWM
    default n
```

## bsp/spacemit/dm/regulator/Kconfig
```kconfig
config RT_REGULATOR_SPACEMIT_PMIC
    bool "Spacemit PMIC Power regulators"
    depends on RT_MFD_SPACEMIT_PMIC
    depends on RT_USING_PIN
    default y
```

## bsp/spacemit/dm/reset/Kconfig
```kconfig
config RT_RESET_SPACEMIT_K1
    bool "Reset controller driver for Spacemit K1"
    depends on RT_USING_RESET
    default y
```

## bsp/spacemit/dm/rtc/Kconfig
```kconfig
config RT_RTC_SPACEMIT_PMIC
    bool "Spacemit PMIC RTC"
    depends on RT_MFD_SPACEMIT_PMIC
    default y
```

## bsp/spacemit/dm/serial/Kconfig
```kconfig
config RT_SERIAL_PXA
    bool "PXA serial"
    depends on RT_USING_DMA
    depends on RT_SERIAL_8250
    default n

source "$(RTT_DIR)/libcpu/risc-v/common64/serial/Kconfig"
```

## bsp/spacemit/dm/spi/Kconfig
```kconfig
config RT_SPI_K1X_QSPI
    bool "K1X QuadSPI"
    depends on RT_USING_DM
    depends on RT_USING_SPI
    depends on RT_USING_QSPI
    depends on RT_USING_DMA
    depends on RT_USING_PIN
    depends on RT_USING_PINCTRL
    default n

config RT_SPI_K1X
    bool "K1X SPI"
    depends on RT_USING_DM
    depends on RT_USING_SPI
    depends on RT_USING_DMA
    depends on RT_USING_PIN
    depends on RT_USING_PINCTRL
    default n
```

## bsp/spacemit/dm/watchdog/Kconfig
```kconfig
config RT_WDT_SPACEMIT_WATCHDOG
    bool "Spacemit-k1x SoC Watchdog"
    default n
```

## bsp/spacemit/k1/drivers/Kconfig
```kconfig
menu "Drivers Configuration"
   
    menuconfig BSP_USING_UART
        bool "Enable UART"
        select RT_USING_UART
        default y

        if BSP_USING_UART
            # config BSP_UART_USING_DMA
            #     bool "Enable UART with DMA"
            #     default n
        
            config BSP_USING_UART0
                bool "Enable UART0"
                default y              
        endif

endmenu
```

## bsp/stm32/art_pi_blink_led/Kconfig
```kconfig
mainmenu "RT-Thread Configuration"

config BSP_DIR
    string
    option env="BSP_ROOT"
    default "."

config RTT_DIR
    string
    option env="RTT_ROOT"
    default "rt-thread"

config PKGS_DIR
    string
    option env="PKGS_ROOT"
    default "packages"

source "$RTT_DIR/Kconfig"
source "$PKGS_DIR/Kconfig"
source "$RTT_DIR/../libraries/Kconfig"

config RT_STUDIO_BUILT_IN
    bool
    select ARCH_ARM_CORTEX_M7
    select RT_USING_COMPONENTS_INIT
    select RT_USING_USER_MAIN
    default y
```

## bsp/stm32/libraries/HAL_Drivers/Kconfig
```kconfig
if BSP_USING_USBD
    config BSP_USBD_TYPE_FS
        bool
        # "USB Full Speed (FS) Core"
    config BSP_USBD_TYPE_HS
        bool
        # "USB High Speed (HS) Core"

    config BSP_USBD_SPEED_HS
        bool 
        # "USB High Speed (HS) Mode"
    config BSP_USBD_SPEED_HSINFS
        bool 
        # "USB High Speed (HS) Core in FS mode"

    config BSP_USBD_PHY_EMBEDDED
        bool 
        # "Using Embedded phy interface"
    config BSP_USBD_PHY_UTMI
        bool 
        # "UTMI: USB 2.0 Transceiver Macrocell Interace"
    config BSP_USBD_PHY_ULPI
        bool 
        # "ULPI: UTMI+ Low Pin Interface"
endif

config BSP_USING_CRC
    bool "Enable CRC (CRC-32 0x04C11DB7 Polynomial)"
    select RT_USING_HWCRYPTO
    select RT_HWCRYPTO_USING_CRC
    # "Crypto device frame dose not support above 8-bits granularity"
    # "Reserve progress, running well, about 32-bits granularity, such as stm32f1, stm32f4"
    depends on (SOC_SERIES_STM32L4 || SOC_SERIES_STM32F0 || SOC_SERIES_STM32F7 || SOC_SERIES_STM32H7 || SOC_SERIES_STM32MP1)
    default n 

config BSP_USING_RNG
    bool "Enable RNG (Random Number Generator)"
    select RT_USING_HWCRYPTO
    select RT_HWCRYPTO_USING_RNG
    depends on (SOC_SERIES_STM32L4 || SOC_SERIES_STM32F4 || SOC_SERIES_STM32F7 || \
                SOC_SERIES_STM32H7 || SOC_SERIES_STM32MP1)
    default n

config BSP_USING_HASH
    bool "Enable HASH (Hash House Harriers)"
    select RT_USING_HWCRYPTO
    select RT_HWCRYPTO_USING_HASH
    depends on (SOC_SERIES_STM32MP1)
    default n

config BSP_USING_CRYP
    bool "Enable CRYP (Encrypt And Decrypt Data)"
    select RT_USING_HWCRYPTO
    select RT_HWCRYPTO_USING_CRYP
    depends on (SOC_SERIES_STM32MP1)
    default n

config BSP_USING_UDID
    bool "Enable UDID (Unique Device Identifier)"
    select RT_USING_HWCRYPTO
    default n
```

## bsp/stm32/libraries/HAL_Drivers/Kconfig.crypto
```kconfig
config BSP_USING_CRC
    bool "Enable CRC (CRC-32 0x04C11DB7 Polynomial)"
    select RT_USING_HWCRYPTO
    select RT_HWCRYPTO_USING_CRC
    default n 

config BSP_USING_RNG
    bool "Enable RNG (Random Number Generator)"
    select RT_USING_HWCRYPTO
    select RT_HWCRYPTO_USING_RNG
    depends on (SOC_SERIES_STM32L4 || SOC_SERIES_STM32F4 || SOC_SERIES_STM32F7 || \
                SOC_SERIES_STM32H7)
    default n
    
config BSP_USING_UDID
    bool "Enable UDID (Unique Device Identifier)"
    select RT_USING_HWCRYPTO
    default n
```

## bsp/stm32/libraries/Kconfig
```kconfig
config SOC_FAMILY_STM32
    bool

config SOC_SERIES_STM32F0
    bool
    select ARCH_ARM_CORTEX_M0
    select SOC_FAMILY_STM32
    select PKG_USING_STM32F0_HAL_DRIVER

config SOC_SERIES_STM32F1
    bool
    select ARCH_ARM_CORTEX_M3
    select SOC_FAMILY_STM32
    select PKG_USING_STM32F1_HAL_DRIVER

config SOC_SERIES_STM32F2
    bool
    select ARCH_ARM_CORTEX_M3
    select SOC_FAMILY_STM32
    select PKG_USING_STM32F2_HAL_DRIVER

config SOC_SERIES_STM32F3
    bool
    select ARCH_ARM_CORTEX_M4
    select SOC_FAMILY_STM32
    select PKG_USING_STM32F3_HAL_DRIVER

config SOC_SERIES_STM32F4
    bool
    select ARCH_ARM_CORTEX_M4
    select SOC_FAMILY_STM32
    select PKG_USING_STM32F4_HAL_DRIVER

config SOC_SERIES_STM32F7
    bool
    select ARCH_ARM_CORTEX_M7
    select SOC_FAMILY_STM32
    select PKG_USING_STM32F7_HAL_DRIVER

config SOC_SERIES_STM32L0
    bool
    select ARCH_ARM_CORTEX_M0
    select SOC_FAMILY_STM32
    select PKG_USING_STM32L0_HAL_DRIVER

config SOC_SERIES_STM32L1
    bool
    select ARCH_ARM_CORTEX_M3
    select SOC_FAMILY_STM32

config SOC_SERIES_STM32L4
    bool
    select ARCH_ARM_CORTEX_M4
    select SOC_FAMILY_STM32
    select PKG_USING_STM32L4_HAL_DRIVER

config SOC_SERIES_STM32L5
    bool
    select ARCH_ARM_CORTEX_M33
    select SOC_FAMILY_STM32
    select PKG_USING_STM32L5_HAL_DRIVER

config SOC_SERIES_STM32G0
    bool
    select ARCH_ARM_CORTEX_M0
    select SOC_FAMILY_STM32
    select PKG_USING_STM32G0_HAL_DRIVER

config SOC_SERIES_STM32G4
    bool
    select ARCH_ARM_CORTEX_M4
    select SOC_FAMILY_STM32
    select PKG_USING_STM32G4_HAL_DRIVER

config SOC_SERIES_STM32H7
    bool
    select ARCH_ARM_CORTEX_M7
    select SOC_FAMILY_STM32
    select PKG_USING_STM32H7_HAL_DRIVER

config SOC_SERIES_STM32H7RS
    bool
    select ARCH_ARM_CORTEX_M7
    select SOC_FAMILY_STM32
    select PKG_USING_STM32H7RS_HAL_DRIVER

config SOC_SERIES_STM32U5
    bool
    select ARCH_ARM_CORTEX_M33
    select SOC_FAMILY_STM32
    select PKG_USING_STM32U5_HAL_DRIVER

config SOC_SERIES_STM32H5
    bool
    select ARCH_ARM_CORTEX_M33
    select SOC_FAMILY_STM32
    select PKG_USING_STM32H5_HAL_DRIVER

config SOC_SERIES_STM32MP1
    bool
    select ARCH_ARM_CORTEX_M4
    select SOC_FAMILY_STM32
    select PKG_USING_STM32MP1_M4_HAL_DRIVER

config SOC_SERIES_STM32WL
    bool
    select ARCH_ARM_CORTEX_M4
    select SOC_FAMILY_STM32
    select PKG_USING_STM32WL_HAL_DRIVER

config SOC_SERIES_STM32WB
    bool
    select ARCH_ARM_CORTEX_M4
    select SOC_FAMILY_STM32
    select PKG_USING_STM32WB_HAL_DRIVER

config BOARD_SERIES_STM32_NUCLEO_32
    bool

config BOARD_SERIES_STM32_NUCLEO_64
    bool

config BOARD_SERIES_STM32_NUCLEO_144
    bool
```

## bsp/stm32/libraries/templates/stm32f0xx/board/Kconfig
```kconfig
menu "Hardware Drivers Config"

config SOC_STM32F091RC
    bool
    select SOC_SERIES_STM32F0
    default y

menu "Onboard Peripheral Drivers"

endmenu

menu "On-chip Peripheral Drivers"

    config BSP_USING_GPIO
        bool "Enable GPIO"
        select RT_USING_PIN
        default y

    menuconfig BSP_USING_UART
        bool "Enable UART"
        default y
        select RT_USING_SERIAL
        if BSP_USING_UART
            config BSP_USING_UART1
                bool "Enable UART1"
                default y

            config BSP_UART1_RX_USING_DMA
                bool "Enable UART1 RX DMA"
                depends on BSP_USING_UART1 && RT_SERIAL_USING_DMA
                default n
        endif

    menuconfig BSP_USING_SPI
        bool "Enable SPI BUS"
        default n
        select RT_USING_SPI
        if BSP_USING_SPI
            config BSP_USING_SPI1
                bool "Enable SPI1 BUS"
                default n

            config BSP_SPI1_TX_USING_DMA
                bool "Enable SPI1 TX DMA"
                depends on BSP_USING_SPI1
                default n
                
            config BSP_SPI1_RX_USING_DMA
                bool "Enable SPI1 RX DMA"
                depends on BSP_USING_SPI1
                select BSP_SPI1_TX_USING_DMA
                default n
        endif

    menuconfig BSP_USING_I2C1
        bool "Enable I2C1 BUS (software simulation)"
        default n
        select RT_USING_I2C
        select RT_USING_I2C_BITOPS
        select RT_USING_PIN
        if BSP_USING_I2C1
            config BSP_I2C1_SCL_PIN
                int "i2c1 scl pin number"
                range 1 216
                default 15
            config BSP_I2C1_SDA_PIN
                int "I2C1 sda pin number"
                range 1 216
                default 16
        endif

endmenu

menu "Board extended module Drivers"

endmenu

endmenu
```

## bsp/stm32/libraries/templates/stm32f2xx/Kconfig
```kconfig
mainmenu "RT-Thread Configuration"

config BSP_DIR
    string
    option env="BSP_ROOT"
    default "."

config RTT_DIR
    string
    option env="RTT_ROOT"
    default "../../.."

config PKGS_DIR
    string
    option env="PKGS_ROOT"
    default "packages"
 
source "$RTT_DIR/Kconfig"
source "$PKGS_DIR/Kconfig"
source "../libraries/Kconfig"
source "board/Kconfig"
```
