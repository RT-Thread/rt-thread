## bsp/stm32/stm32f412-st-nucleo/board/Kconfig
```kconfig
menu "Hardware Drivers Config"

config SOC_STM32F412ZG
    bool
    select SOC_SERIES_STM32F4
    select RT_USING_COMPONENTS_INIT
    select RT_USING_USER_MAIN
    default y


menu "Onboard Peripheral Drivers"

    config BSP_USING_STLINK_TO_USART
        bool "Enable STLINK TO USART (uart3)"
        select BSP_USING_UART
        select BSP_USING_UART3
        default y

    config BSP_USING_ARDUINO
        bool "Compatible with Arduino Ecosystem (RTduino)"
        select PKG_USING_RTDUINO
        select BSP_USING_STLINK_TO_USART
        select BSP_USING_GPIO
        select BSP_USING_ADC
        select BSP_USING_ADC1
        select BSP_USING_PWM
        select BSP_USING_PWM14
        select BSP_USING_PWM4
        select BSP_USING_PWM1
        select BSP_USING_PWM1_CH3
        select BSP_USING_PWM1_CH2
        select BSP_USING_PWM1_CH1
        select BSP_USING_PWM4_CH4
        select BSP_USING_PWM4_CH3
        select BSP_USING_PWM14_CH1
        select BSP_USING_I2C
        select BSP_USING_I2C1
        imply RTDUINO_USING_SERVO
        imply RTDUINO_USING_WIRE
        default n

endmenu

menu "On-chip Peripheral Drivers"

    config BSP_USING_GPIO
        bool "Enable GPIO"
        select RT_USING_PIN
        default y

    menuconfig BSP_USING_UART
        bool "Enable UART"
        default y
        select RT_USING_SERIAL
        if BSP_USING_UART
            config BSP_USING_UART2
                bool "Enable UART2"
                default y
            config BSP_UART2_RX_USING_DMA
                bool "Enable UART2 RX DMA"
                depends on BSP_USING_UART2 && RT_SERIAL_USING_DMA
                default n

            config BSP_USING_UART3
                bool "Enable UART3"
                default y
            config BSP_UART3_RX_USING_DMA
                bool "Enable UART3 RX DMA"
                depends on BSP_USING_UART3 && RT_SERIAL_USING_DMA
                default n
        endif

    menuconfig BSP_USING_ADC
        bool "Enable ADC"
        default n
        select RT_USING_ADC
        if BSP_USING_ADC
            config BSP_USING_ADC1
                bool "Enable ADC1"
                default n
        endif

    menuconfig BSP_USING_PWM
        bool "Enable PWM"
        default n
        select RT_USING_PWM

        if BSP_USING_PWM
            menuconfig BSP_USING_PWM1
                bool "Enable timer1 output PWM"
                default n
                if BSP_USING_PWM1
                    config BSP_USING_PWM1_CH1
                        bool "Enable PWM1 channel1"
                        default n

                    config BSP_USING_PWM1_CH2
                        bool "Enable PWM1 channel2"
                        default n

                    config BSP_USING_PWM1_CH3
                        bool "Enable PWM1 channel3"
                        default n
                endif

            menuconfig BSP_USING_PWM4
                bool "Enable timer4 output PWM"
                default n
                if BSP_USING_PWM4
                    config BSP_USING_PWM4_CH3
                        bool "Enable PWM3 channel3"
                        default n

                    config BSP_USING_PWM4_CH4
                        bool "Enable PWM4 channel4"
                        default n
                endif

            menuconfig BSP_USING_PWM14
                bool "Enable timer14 output PWM"
                default n
                if BSP_USING_PWM14
                    config BSP_USING_PWM14_CH1
                        bool "Enable PWM14 channel1"
                        default n
                endif
        endif

    menuconfig BSP_USING_I2C
        bool "Enable I2C BUS"
        default n
        select RT_USING_I2C
        select RT_USING_I2C_BITOPS
        select RT_USING_PIN

        if BSP_USING_I2C
            config BSP_USING_I2C1
                bool "Enable I2C1 Bus (User I2C)"
                default n
                if BSP_USING_I2C1
                    comment "Notice: PB9 --> 25; PB8 --> 24"
                    config BSP_I2C1_SCL_PIN
                        int "i2c1 SCL pin number"
                        range 1 176
                        default 24
                    config BSP_I2C1_SDA_PIN
                        int "i2c1 SDA pin number"
                        range 1 176
                        default 25
                endif
        endif

    config BSP_USING_ON_CHIP_FLASH
        bool "Enable on-chip FLASH"
        default n

    config BSP_USING_USBD
        bool "Enable OTGFS as USB device"
        select RT_USING_USB_DEVICE
        select BSP_USBD_TYPE_FS
        default n

endmenu

menu "Board extended module Drivers"

endmenu

endmenu
```

## bsp/stm32/stm32f413-st-nucleo/Kconfig
```kconfig
mainmenu "RT-Thread Configuration"

BSP_DIR := .

RTT_DIR := ../../..

PKGS_DIR := packages


config SOC_STM32F413ZH
    bool
    select SOC_SERIES_STM32F4
    select RT_USING_COMPONENTS_INIT
    select RT_USING_USER_MAIN
    default y

config BOARD_STM32F413_NUCLEO
    bool
    select BOARD_SERIES_STM32_NUCLEO_144
    default y

source "$(RTT_DIR)/Kconfig"
osource "$PKGS_DIR/Kconfig"
rsource "../libraries/Kconfig"

if !RT_USING_NANO
rsource "board/Kconfig"
endif
```

## bsp/stm32/stm32f413-st-nucleo/board/Kconfig
```kconfig
menu "Hardware Drivers Config"

config SOC_STM32F413ZH
    bool
    select SOC_SERIES_STM32F4
    select RT_USING_COMPONENTS_INIT
    select RT_USING_USER_MAIN
    default y

menu "Onboard Peripheral Drivers"

    config BSP_USING_STLINK_TO_USART
        bool "Enable STLINK TO USART (uart3)"
        select BSP_USING_UART
        select BSP_USING_UART3
        default y
endmenu

menu "On-chip Peripheral Drivers"

    config BSP_USING_GPIO
        bool "Enable GPIO"
        select RT_USING_PIN
        default y

    menuconfig BSP_USING_UART
        bool "Enable UART"
        default y
        select RT_USING_SERIAL
        if BSP_USING_UART
            config BSP_USING_UART2
                bool "Enable UART2"
                default y
            config BSP_UART2_RX_USING_DMA
                bool "Enable UART2 RX DMA"
                depends on BSP_USING_UART2 && RT_SERIAL_USING_DMA
                default n
                
            config BSP_USING_UART3
                bool "Enable UART3"
                default y
            config BSP_UART3_RX_USING_DMA
                bool "Enable UART3 RX DMA"
                depends on BSP_USING_UART3 && RT_SERIAL_USING_DMA
                default n
        endif
        
    menuconfig BSP_USING_SPI
        bool "Enable SPI BUS"
        default n
        select RT_USING_SPI
        if BSP_USING_SPI
            config BSP_USING_SPI2
                bool "Enable SPI2 BUS"
                default n  
                
            config BSP_SPI2_TX_USING_DMA
                bool "Enable SPI2 TX DMA"
                depends on BSP_USING_SPI2
                default n
                
            config BSP_SPI2_RX_USING_DMA
                bool "Enable SPI2 RX DMA"
                depends on BSP_USING_SPI2
                select BSP_SPI2_TX_USING_DMA
                default n
                 
        endif

    menuconfig BSP_USING_I2C1
        bool "Enable I2C1 BUS (software simulation)"
        default n
        select RT_USING_I2C
        select RT_USING_I2C_BITOPS
        select RT_USING_PIN
        if BSP_USING_I2C1
            comment "Notice: PB6 --> 136; PB9 --> 140"
            config BSP_I2C1_SCL_PIN
                int "I2C1 scl pin number"
                range 1 144
                default 136
            config BSP_I2C1_SDA_PIN
                int "I2C1 sda pin number"
                range 1 144
                default 140
        endif
    
    menuconfig BSP_USING_TIM
        bool "Enable timer"
        default n
        select RT_USING_HWTIMER
        if BSP_USING_TIM
            config BSP_USING_TIM11
                bool "Enable TIM11"
                default n

            config BSP_USING_TIM13
                bool "Enable TIM13"
                default n

            config BSP_USING_TIM14
                bool "Enable TIM14"
                default n
        endif

    menuconfig BSP_USING_PWM
        bool "Enable pwm"
        default n
        select RT_USING_PWM
        if BSP_USING_PWM
        menuconfig BSP_USING_PWM2
            bool "Enable timer2 output pwm"
            default n
            if BSP_USING_PWM2
                config BSP_USING_PWM2_CH4
                    bool "Enable PWM2 channel4"
                    default n
            endif
        endif

    menuconfig BSP_USING_ADC
        bool "Enable ADC"
        default n
        select RT_USING_ADC
        if BSP_USING_ADC
            config BSP_USING_ADC1
                bool "Enable ADC1"
                default n
        endif

    menuconfig BSP_USING_ONCHIP_RTC
        bool "Enable RTC"
        select RT_USING_RTC
        default n
        if BSP_USING_ONCHIP_RTC
            choice
                prompt "Select clock source"
                default BSP_RTC_USING_LSE

                config BSP_RTC_USING_LSE
                    bool "RTC USING LSE"

                config BSP_RTC_USING_LSI
                    bool "RTC USING LSI"
            endchoice
        endif

    config BSP_USING_WDT
        bool "Enable Watchdog Timer"
        select RT_USING_WDT
        default n
        
    config BSP_USING_ON_CHIP_FLASH
        bool "Enable on-chip FLASH"
        default n

    config BSP_USING_USBD
        bool "Enable OTGFS as USB device"
        select RT_USING_USB_DEVICE
        select BSP_USBD_TYPE_FS
        default n
        
    source "../libraries/HAL_Drivers/Kconfig"    
    
endmenu

menu "Board extended module Drivers"

endmenu
 
endmenu
```

## bsp/stm32/stm32f427-robomaster-a/board/Kconfig
```kconfig
menu "Hardware Drivers Config"

config SOC_STM32F427II
    bool
    select SOC_SERIES_STM32F4
    select RT_USING_COMPONENTS_INIT
    select RT_USING_USER_MAIN
    default y

menu "Onboard Peripheral Drivers"
    config BSP_USING_SDCARD
        bool "Enable SDCARD (sdio)"
        select BSP_USING_SDIO
        select RT_USING_DFS
        select RT_USING_DFS_ELMFAT
        default n
endmenu

menu "On-chip Peripheral Drivers"

    config BSP_USING_GPIO
        bool "Enable GPIO"
        select RT_USING_PIN
        default y

    menuconfig BSP_USING_UART
        bool "Enable UART"
        default y
        select RT_USING_SERIAL
        if BSP_USING_UART
            config BSP_USING_UART6
                bool "Enable UART6 (debug usart)"
                default y
            config BSP_UART6_RX_USING_DMA
                bool "Enable UART6 RX DMA"
                depends on BSP_USING_UART6 && RT_SERIAL_USING_DMA
                default n

            config BSP_USING_UART3
                bool "Enable UART3"
                default n
            config BSP_UART3_RX_USING_DMA
                bool "Enable UART3 RX DMA"
                depends on BSP_USING_UART3 && RT_SERIAL_USING_DMA
                default n

            config BSP_USING_UART7
                bool "Enable UART7"
                default n
            config BSP_UART7_RX_USING_DMA
                bool "Enable UART7 RX DMA"
                depends on BSP_USING_UART7 && RT_SERIAL_USING_DMA
                default n

            config BSP_USING_UART8
                bool "Enable UART8"
                default n
            config BSP_UART8_RX_USING_DMA
                bool "Enable UART8 RX DMA"
                depends on BSP_USING_UART8 && RT_SERIAL_USING_DMA
                default n

            config BSP_USING_UART1
                bool "Enable UART1 (DBUS)"
                default n
            config BSP_UART1_RX_USING_DMA
                bool "Enable UART1 RX DMA"
                depends on BSP_USING_UART1 && RT_SERIAL_USING_DMA
                default n
        endif

    menuconfig BSP_USING_CAN
            bool "Enable CAN"
            default n
            select RT_USING_CAN
            if BSP_USING_CAN
                config BSP_USING_CAN1
                    bool "using CAN1"
                    default n
                config BSP_USING_CAN2
                    bool "using CAN2"
                    default n
        endif

    config BSP_USING_SDIO
        bool "Enable SDIO"
        select RT_USING_SDIO
        select RT_USING_DFS
        default n

    menuconfig BSP_USING_PWM
        bool "Enable pwm"
        default n
        select RT_USING_PWM
        if BSP_USING_PWM
            menuconfig BSP_USING_PWM12
                bool "Enable timer12 output pwm"
                default n
                if BSP_USING_PWM12
                    config BSP_USING_PWM12_CH1
                        bool "Enable PWM12 channel1(buzzer) "
                        default n
                endif

            menuconfig BSP_USING_PWM4
                bool "Enable timer4 output pwm"
                default n
                if BSP_USING_PWM4
                    config BSP_USING_PWM4_CH1
                        bool "Enable PWM4 channel1"
                        default n
                    config BSP_USING_PWM4_CH2
                        bool "Enable PWM4 channel2"
                        default n
                    config BSP_USING_PWM4_CH3
                        bool "Enable PWM4 channel3"
                        default n
                    config BSP_USING_PWM4_CH4
                        bool "Enable PWM4 channel4"
                        default n
                endif

            menuconfig BSP_USING_PWM5
                bool "Enable timer5 output pwm"
                default n
                if BSP_USING_PWM5
                    config BSP_USING_PWM5_CH1
                        bool "Enable PWM5 channel1"
                        default n
                    config BSP_USING_PWM5_CH2
                        bool "Enable PWM5 channel2"
                        default n
                    config BSP_USING_PWM5_CH3
                        bool "Enable PWM5 channel3"
                        default n
                    config BSP_USING_PWM5_CH4
                        bool "Enable PWM5 channel4"
                        default n
                endif
        endif

    source "../libraries/HAL_Drivers/Kconfig"    

endmenu

menu "Board extended module Drivers"

endmenu
endmenu
```
