## bsp/x1000/Kconfig
```kconfig
mainmenu "RT-Thread Configuration"

config BSP_DIR
    string
    option env="BSP_ROOT"
    default "."

config RTT_DIR
    string
    option env="RTT_ROOT"
    default "../.."

# you can change the RTT_ROOT default "../.." to your rtthread_root,
# example : default "F:/git_repositories/rt-thread"

config PKGS_DIR
    string
    option env="PKGS_ROOT"
    default "packages"

source "$RTT_DIR/Kconfig"
source "$PKGS_DIR/Kconfig"

config BOARD_X1000_REALBOARD
    bool 
    select ARCH_MIPS_XBURST
    select RT_USING_COMPONENTS_INIT
    select RT_USING_USER_MAIN
    default y

config RT_USING_HARD_FLOAT
    bool "Enable Hardware Float Unit"
    default y

source "$BSP_DIR/drivers/Kconfig"
```

## bsp/x1000/drivers/Kconfig
```kconfig
choice
    prompt "Board Type"
    default BOARD_HALLEY2_REALBOARD_V2

    config BOARD_PHOENIX
        bool "Phoenix board"

    config BOARD_HALLEY2
        bool "Halley2 board"

    config BOARD_HALLEY2_FIR
        bool "Fir board"

    config BOARD_HALLEY2_REALBOARD
        bool "RealBoard board"

    config BOARD_HALLEY2_REALBOARD_V2
        bool "RealBoard v2 board"
endchoice

if RT_USING_SERIAL
    config RT_USING_UART0
        bool "Using UART0"
        default n

    config RT_USING_UART1
        bool "Using UART1"
        default n

    config RT_USING_UART2
        bool "Using UART2"
        default y

    if RT_USING_UART2
        choice
            prompt "GPIO function pins select"
            default CONFIG_SYS_UART2_PC

            config CONFIG_SYS_UART2_PC
                bool "PORT C"

            config CONFIG_SYS_UART2_PD
                bool "PORT D"
        endchoice
    endif
endif

if RT_USING_SDIO
    config RT_USING_MSC0
        bool "Using MMC/SD 0"
        default y

    config RT_USING_MSC1
        bool "Using MMC/SD 1"
        default y

    config RT_MMCSD_STACK_SIZE
        int "Set MMC/SD thread stack size"
        default 2048
endif

if RT_USING_I2C
    config RT_USING_I2C0
        bool "Using iic0 bus"
        default y
        
    config RT_USING_I2C1
        bool "Using iic1 bus"
        default n

    config RT_USING_I2C2
        bool "Using iic2 bus"
        default n
endif

if PKG_USING_GUIENGINE
    config RT_USING_SLCD
        bool "Using LCD display"
        default y

    if RT_USING_SLCD
        choice
            prompt "Choice LCD controller"
            default RT_USING_ILI9488

            config RT_USING_ILI9488
                bool "Using ILI9488 controller"

            config RT_USING_ILI9341
                bool "Using ILI9341 controller"

            config RT_USING_OTM4802
                bool "Using OTM4802 controller"

            config RT_USING_TRULY_TFT240240
                bool "Using TFT240240 controller"
        endchoice
    endif

    if RT_USING_I2C0
        config RT_USING_TOUCH
            bool "Using LCD touch"
            default y

        if RT_USING_TOUCH
            choice
                prompt "Choice touch controller"
                default RT_USING_GT9XX

                config RT_USING_GT9XX
                    bool "Using  GT9XX controller"

                config RT_USING_FT6x06
                    bool "Using  FT6x06 controller"
            endchoice

            config RT_TOUCH_THREAD_PRIORITY
                int "Set touch thread priority"
                range 2 30
                default 10
        endif
    endif
endif

config RT_USING_AUDIO
    bool "Using audio"
    select RT_USING_ICODEC
    default n

if RT_USING_AUDIO
    config RT_USING_ICODEC
        bool "Using internal codec for audio"
        default y if BOARD_HALLEY2_REALBOARD_V2
        default n
endif

config RT_USING_CPU_FFS
    bool "Using CPU FFS"
    default y

if PKG_USING_WLAN_WICED
    choice
        prompt "Broadcom Wi-Fi module"
        default WIFI_USING_AP6212

        config WIFI_USING_AP6212
            bool "AP6212A module(bcm43438)"

        config WIFI_USING_AP6181
            bool "AP6181 module(bcm43362)"
    endchoice
endif
```

## bsp/x86/Kconfig
```kconfig
mainmenu "RT-Thread Configuration"

BSP_DIR := .

RTT_DIR := ../..

PKGS_DIR := packages

source "$(RTT_DIR)/Kconfig"
osource "$PKGS_DIR/Kconfig"

config IA32
    bool
    select ARCH_IA32
    select RT_USING_COMPONENTS_INIT
    select RT_USING_USER_MAIN
    default y

menu "X86 Features"

choice C_LIB_TYPE_SEL
    prompt "C Library type"
    default X86_BSP_USING_LIBC

config X86_BSP_USING_LIBC
    bool "Newlib"
    help
      Use the standard Newlib implementation.

config X86_BSP_USING_PICOLIBC_PORT
    bool "Picolibc (tinystdio)"
    select RT_USING_COMPONENTS_INIT
    help
      Use Picolibc with tinystdio for a smaller footprint.
endchoice

endmenu
```

## bsp/xiangshan-verilator-xiangshan/driver/Kconfig
```kconfig
menu "XiangShan configs"

config BSP_USING_VIRTIO
    bool "Using VirtIO"
    default n
    depends on RT_USING_DEVICE_OPS

config BSP_USING_VIRTIO_BLK
    bool "Using VirtIO BLK"
    select RT_USING_VIRTIO
    select RT_USING_VIRTIO_BLK
    default n
    depends on BSP_USING_VIRTIO

config BSP_USING_VIRTIO_NET
    bool "Using VirtIO NET"
    select RT_USING_VIRTIO
    select RT_USING_VIRTIO_NET
    default n
    depends on BSP_USING_VIRTIO

config BSP_USING_VIRTIO_CONSOLE
    bool "Using VirtIO Console"
    select RT_USING_VIRTIO
    select RT_USING_VIRTIO_CONSOLE
    default n
    depends on BSP_USING_VIRTIO

config BSP_USING_VIRTIO_GPU
    bool "Using VirtIO GPU"
    select RT_USING_VIRTIO
    select RT_USING_VIRTIO_GPU
    default n
    depends on BSP_USING_VIRTIO

config BSP_USING_VIRTIO_INPUT
    bool "Using VirtIO Input"
    select RT_USING_VIRTIO
    select RT_USING_VIRTIO_INPUT
    default n
    depends on BSP_USING_VIRTIO

endmenu
```

## bsp/xplorer4330/M4/Kconfig
```kconfig
mainmenu "RT-Thread Project Configuration"

BSP_DIR := .

RTT_DIR := ../../..

PKGS_DIR := packages

source "$(RTT_DIR)/Kconfig"
osource "$PKGS_DIR/Kconfig"

config SOC_XPLORER4330_M4
    bool
    select ARCH_ARM_CORTEX_M4
    default y
```

## bsp/xuantie/smartl/e901/Kconfig
```kconfig
mainmenu "RT-Thread Configuration"

BSP_DIR := .

RTT_DIR := ../../../../

PKGS_DIR := packages

config XUANTIAN_SMARTL_E901
    bool
    select ARCH_RISCV32
    select RT_USING_COMPONENTS_INIT
    select RT_USING_USER_MAIN
    default y

source "$(RTT_DIR)/Kconfig"
source "$PKGS_DIR/Kconfig"
source "$BSP_DIR/board/Kconfig"
```

## bsp/xuantie/smartl/e901plus/board/Kconfig
```kconfig
menu "Hardware Drivers Config"

config SOC_XUANTIE
    bool
    select RT_USING_COMPONENTS_INIT
    select RT_USING_USER_MAIN
    default y


menu "On-chip Peripheral Drivers"

    menuconfig BSP_USING_UART
        bool "Enable UART"
        select RT_USING_SERIAL
        default n

        if BSP_USING_UART
            config BSP_USING_UART0
                bool "Enable UART0"
                default n
        endif

endmenu

endmenu
```

## bsp/xuantie/smartl/e902/board/Kconfig
```kconfig
menu "Hardware Drivers Config"

config SOC_XUANTIE
    bool
    select RT_USING_COMPONENTS_INIT
    select RT_USING_USER_MAIN
    default y


menu "On-chip Peripheral Drivers"

    menuconfig BSP_USING_UART
        bool "Enable UART"
        select RT_USING_SERIAL
        default n

        if BSP_USING_UART
            config BSP_USING_UART0
                bool "Enable UART0"
                default n
        endif

    menuconfig ENABLE_FPU
        bool "Enable FPU"
        select ARCH_RISCV_FPU
        default n
          
endmenu

endmenu
```

## bsp/xuantie/smartl/e906/Kconfig
```kconfig
mainmenu "RT-Thread Configuration"

BSP_DIR := .

RTT_DIR := ../../../../

PKGS_DIR := packages

config XUANTIAN_SMARTL_E906
    bool
    select ARCH_RISCV32
    select RT_USING_COMPONENTS_INIT
    select RT_USING_USER_MAIN
    default y

menu "CPU Architecture Features"

    menuconfig ENABLE_FPU
        bool "Enable FPU"
        select ARCH_RISCV_FPU
        default y

    if ENABLE_FPU
        choice
            prompt "FPU Configuration"
            default ARCH_RISCV_FPU_D

            config ARCH_RISCV_FPU_S
                bool "Enable [F] Extension"

            config ARCH_RISCV_FPU_D
                bool "Enable [F][D] Extension"
        endchoice
    endif

    menuconfig ENABLE_DSP
        bool "Enable DSP"
        select ARCH_RISCV_DSP
        default y

config ARCH_RISCV_DSP
    bool

endmenu

source "$(RTT_DIR)/Kconfig"
source "$PKGS_DIR/Kconfig"
source "$BSP_DIR/board/Kconfig"
```

## bsp/xuantie/virt64/c906/Kconfig
```kconfig
mainmenu "RT-Thread Project Configuration"

RTT_DIR := ../../../..
PKGS_DIR := packages

source "$(RTT_DIR)/Kconfig"
osource "$PKGS_DIR/Kconfig"
rsource "board/Kconfig"

config BOARD_QEMU_VIRT_RV64
    bool
    select ARCH_RISCV64
    select ARCH_USING_RISCV_COMMON64
    select RT_USING_COMPONENTS_INIT
    select RT_USING_USER_MAIN
    select RT_USING_CACHE
    select ARCH_MM_MMU
    select ARCH_REMAP_KERNEL
    default y

config ENABLE_FPU
    bool "Enable FPU"
    select ARCH_RISCV_FPU
    default y

config __STACKSIZE__
    int "stack size for interrupt"
    default 8192
```

## bsp/xuantie/virt64/c906/board/Kconfig
```kconfig
menu "RISC-V QEMU virt64 configs"

config BSP_USING_VIRTIO_BLK
    bool "Using VirtIO BLK"
    select RT_USING_LEGACY_VIRTIO
    select RT_USING_VIRTIO_BLK
    default y

endmenu
```

## bsp/xuantie/virt64/c908/board/Kconfig
```kconfig
menu "RISC-V QEMU virt64 configs"

config BSP_USING_VIRTIO
    bool "Using VirtIO"
    default y
    depends on RT_USING_DEVICE_OPS

config BSP_USING_VIRTIO_BLK
    bool "Using VirtIO BLK"
    select RT_USING_VIRTIO
    select RT_USING_VIRTIO_BLK
    default y
    depends on BSP_USING_VIRTIO

endmenu
```

## bsp/xuantie/xiaohui/c906/Kconfig
```kconfig
mainmenu "RT-Thread Configuration"

BSP_DIR := .

RTT_DIR := ../../../../

PKGS_DIR := packages

config XUANTIAN_XIAOHUI_C906
    bool
    select ARCH_RISCV64
    select RT_USING_COMPONENTS_INIT
    select RT_USING_USER_MAIN
    default y

menu "CPU Architecture Features"

    menuconfig ENABLE_FPU
        bool "Enable FPU"
        select ARCH_RISCV_FPU
        select ARCH_RISCV_FPU_D
        default y

    menuconfig ENABLE_VECTOR
        bool "Enable VECTOR"
        select ARCH_RISCV_VECTOR
        select ENABLE_FPU
        default n

endmenu

source "$(RTT_DIR)/Kconfig"
source "$PKGS_DIR/Kconfig"
source "$BSP_DIR/board/Kconfig"
```

## bsp/xuantie/xiaohui/c907/Kconfig
```kconfig
mainmenu "RT-Thread Configuration"

BSP_DIR := .

RTT_DIR := ../../../..

PKGS_DIR := packages

config XUANTIAN_XIAOHUI_C907
    bool
    select ARCH_RISCV64
    select RT_USING_COMPONENTS_INIT
    select RT_USING_USER_MAIN
    default y

source "$(RTT_DIR)/Kconfig"
osource "$PKGS_DIR/Kconfig"
rsource "board/Kconfig"
```

## bsp/xuantie/xiaohui/c908x/Kconfig
```kconfig
mainmenu "RT-Thread Configuration"

BSP_DIR := .

RTT_DIR := ../../../../

PKGS_DIR := packages

 config XUANTIAN_XIAOHUI_C908X
    bool
    select ARCH_RISCV64
    select RT_USING_COMPONENTS_INIT
    select RT_USING_USER_MAIN
    default y

source "$(RTT_DIR)/Kconfig"
source "$PKGS_DIR/Kconfig"
source "$BSP_DIR/board/Kconfig"
```

## bsp/xuantie/xiaohui/c920/board/Kconfig
```kconfig
menu "Hardware Drivers Config"

config SOC_XUANTIE
    bool
    select RT_USING_COMPONENTS_INIT
    select RT_USING_USER_MAIN
    select RT_USING_HW_ATOMIC
    default y


menu "On-chip Peripheral Drivers"

    menuconfig BSP_USING_UART
        bool "Enable UART"
        select RT_USING_SERIAL
        default n

        if BSP_USING_UART
            config BSP_USING_UART0
                bool "Enable UART0"
                default n
        endif

endmenu

endmenu
```

## bsp/xuantie/xiaohui/r908/board/Kconfig
```kconfig
menu "Hardware Drivers Config"

config SOC_XUANTIE
    bool
    select RT_USING_COMPONENTS_INIT
    select RT_USING_USER_MAIN
    default y


menu "On-chip Peripheral Drivers"

    menuconfig BSP_USING_UART
        bool "Enable UART"
        select RT_USING_SERIAL
        default n

        if BSP_USING_UART
            config BSP_USING_UART0
                bool "Enable UART0"
                default n
        endif

    menuconfig ENABLE_FPU
        bool "Enable FPU"
        select ARCH_RISCV_FPU
        default n

    if ENABLE_FPU
        choice
            prompt "FPU Configuration"
            default ARCH_RISCV_FPU_S

            config ARCH_RISCV_FPU_S
                bool "Enable [F] Extension"

            config ARCH_RISCV_FPU_D
                bool "Enable [F][D] Extension"
        endchoice
    endif   
endmenu

endmenu
```

## bsp/yichip/yc3121-pos/Kconfig
```kconfig
mainmenu "RT-Thread Configuration"

BSP_DIR := .

RTT_DIR := ../../..

PKGS_DIR := packages

source "$(RTT_DIR)/Kconfig"
osource "$PKGS_DIR/Kconfig"

config SOC_SWM320VET7
    bool
    select RT_USING_COMPONENTS_INIT
    select RT_USING_USER_MAIN
    default y

rsource "drivers/Kconfig"
```

## bsp/yichip/yc3121-pos/drivers/Kconfig
```kconfig
menu "Hardware Drivers Config"

    menu "On-chip Peripheral Drivers"
        config BSP_USING_GPIO
            bool "Enable GPIO"
            select RT_USING_PIN
            default y

        menu "UART Drivers"
            config BSP_USING_UART0
                bool "Enable UART0 PA2/3(R/T)"
                select RT_USING_SERIAL
                default y

            config BSP_USING_UART1
                bool "Enable UART1 PC2/3(R/T)"
                select RT_USING_SERIAL
                default n
        endmenu
    endmenu

endmenu
```

## bsp/yichip/yc3122-pos/Kconfig
```kconfig
mainmenu "RT-Thread Configuration"

BSP_DIR := .

RTT_DIR := ../../..

PKGS_DIR := packages

source "$(RTT_DIR)/Kconfig"
osource "$PKGS_DIR/Kconfig"

config SOC_YC3122
    bool
    select RT_USING_COMPONENTS_INIT
    select RT_USING_USER_MAIN
    default y

rsource "drivers/Kconfig"
```

## bsp/yichip/yc3122-pos/drivers/Kconfig
```kconfig
menu "Hardware Drivers Config"

    menu "On-chip Peripheral Drivers"
        config BSP_USING_GPIO
            bool "Enable GPIO"
            select RT_USING_PIN
            default y

        menu "UART Drivers"
            config BSP_USING_UART0
                bool "Enable UART0 PC6/5(R/T)"
                select RT_USING_SERIAL
                default y

            config BSP_USING_UART1
                bool "Enable UART1 PC2/3(R/T)"
                select RT_USING_SERIAL
                default n
        endmenu
		
		config BSP_USING_INTER_FLASH
			bool "Enable inter flash"
			default n
    endmenu

endmenu
```

## bsp/zynq/zynq7000/drivers/Kconfig
```kconfig
menu "Hardware Drivers Config"

menu "On-chip Peripheral Drivers"
    config BSP_USING_GPIO
        bool "Enable zynq MIO"
        select RT_USING_PIN
        default y

    menuconfig BSP_USING_UART
        bool "Enable UART"
        default y
        select RT_USING_SERIAL
        if BSP_USING_UART
            config BSP_USING_UART0
                bool "Enable UART0"
                default y

            config BSP_USING_UART1
                bool "Enable UART1"
                default n
        endif
    
    config BSP_USING_SPIFLASH
        bool "Enable spi flash"
        select RT_USING_FAL
        default n

    menuconfig BSP_USING_SDIO
        bool "Enable sdio (emmc)"
        default n

        if BSP_USING_SDIO
            config BSP_USING_SDIO0
                bool "Enable sdio0"
                default n

            config BSP_USING_SDIO1
                bool "Enable sdio1"
                default n
        endif
endmenu

endmenu
```
