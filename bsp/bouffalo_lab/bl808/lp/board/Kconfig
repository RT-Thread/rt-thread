## bsp/bouffalo_lab/bl808/lp/board/Kconfig
```kconfig
config BSP_USING_BL808
    bool
    select RT_USING_COMPONENTS_INIT
    select RT_USING_USER_MAIN
    select ARCH_RISCV32
    select BL808_CORE_LP
    default y

config BL808_CORE_LP
    bool
    default y
```

## bsp/bouffalo_lab/bl808/m0/board/Kconfig
```kconfig
config BSP_USING_BL808
    bool
    select RT_USING_COMPONENTS_INIT
    select RT_USING_USER_MAIN
    select ARCH_RISCV32
    select ARCH_RISCV_FPU_S
    select BL808_CORE_M0
    default y

config BL808_CORE_M0
    bool
    default y

config BSP_USING_TRIPLECORE
    bool "Enable Triplecore"
    default y
    select BSP_USING_PSRAM

config BSP_USING_PSRAM
    bool "Enable PSRAM"
    default n

config BSP_USING_WIFI
    bool "Enable Wi-Fi"
    default y
    select PKG_USING_WLAN_BL808
    select RT_USING_WIFI
    select RT_WLAN_PROT_LWIP_PBUF_FORCE
    select BSP_USING_PSRAM
    select RT_USING_LWIP
    
    config LWIP_SUPPORT_CUSTOM_PBUF
        int
        default 1
    
    config PBUF_LINK_ENCAPSULATION_HLEN
        int
        default 128
```

## bsp/ck802/Kconfig
```kconfig
mainmenu "RT-Thread Configuration"

BSP_DIR := .

RTT_DIR := ../..

# you can change the RTT_ROOT default "../.." to your rtthread_root,
# example : default "F:/git_repositories/rt-thread"

PKGS_DIR := packages

source "$(RTT_DIR)/Kconfig"
osource "$PKGS_DIR/Kconfig"

config SOC_CK802
    bool
    select RT_USING_COMPONENTS_INIT
    select RT_USING_USER_MAIN
    default y

if RT_USING_SERIAL

    config RT_USING_UART1
        bool "Using uart1"
        default y

endif
```

## bsp/core-v-mcu/Libraries/Kconfig
```kconfig
config SOC_RISCV_FAMILY_Core_V
    bool

config SOC_RISCV_SERIES_Core_V
    bool
    select ARCH_RISCV
    select SOC_RISCV_FAMILY_Core_V
```

## bsp/core-v-mcu/core-v-cv32e40p/board/Kconfig
```kconfig
menu "Hardware Drivers Config"

config SOC_Core_V_MCU
    bool
    select SOC_RISCV_SERIES_Core_V
    select RT_USING_COMPONENTS_INIT
    select RT_USING_USER_MAIN
    default y

menu "On-chip Peripheral Drivers"
    config BSP_USING_GPIO
        bool "Enable GPIO"
        select RT_USING_PIN
        default y

    menuconfig BSP_USING_UART
        bool "Enable UART"
        select RT_USING_SERIAL
        default y

        if BSP_USING_UART
           config BSP_USING_UART1
               bool "Enable UART1"
               default y
        endif

endmenu

menu "Onboard Peripheral Drivers"

endmenu

menu "Board extended module Drivers"

endmenu

menu "Onboard System Settings"
    config DEFAULT_SYSTEM_CLOCK
        int "IDEFAULT_SYSTEM_CLOCK"
        range 1 10000000
        default 5000000u

endmenu

endmenu
```

## bsp/cv1800b/Kconfig
```kconfig
mainmenu "RT-Thread Project Configuration"

config BSP_DIR
    string
    option env="BSP_ROOT"
    default "."

config RTT_DIR
    string
    option env="RTT_ROOT"
    default "../.."

config PKGS_DIR
    string
    option env="PKGS_ROOT"
    default "packages"

source "$RTT_DIR/Kconfig"
source "$PKGS_DIR/Kconfig"
source "drivers/Kconfig"

config BSP_USING_CV1800B
    bool
    select ARCH_RISCV64
    select RT_USING_COMPONENTS_INIT
    select RT_USING_USER_MAIN
    select RT_USING_CACHE
    select ARCH_MM_MMU
    default y

config C906_PLIC_PHY_ADDR
    hex
    default 0x70000000

config IRQ_MAX_NR
    int 
    default 64

config TIMER_CLK_FREQ
    int
    default 25000000

config __STACKSIZE__
    int "stack size for interrupt"
    default 4096
```

## bsp/cv1800b/drivers/Kconfig
```kconfig
menu "General Drivers Configuration"

    menuconfig BSP_USING_UART
        bool "Using UART"
        select RT_USING_SERIAL
        default y

        if BSP_USING_UART
            config RT_USING_UART0
            bool "Enable UART 0"
            default y

            config RT_USING_UART1
            bool "Enable UART 1"
            default n

            config RT_USING_UART2
            bool "Enable UART 2"
            default n

            config RT_USING_UART3
            bool "Enable UART 3"
            default n

            config RT_USING_UART4
            bool "Enable UART 4"
            default n

        endif

endmenu
```

## bsp/cvitek/c906_little/Kconfig
```kconfig
mainmenu "RT-Thread Project Configuration"

BSP_DIR := .

RTT_DIR := ../../..

PKGS_DIR := packages

source "$(RTT_DIR)/Kconfig"
osource "$PKGS_DIR/Kconfig"
rsource "board/Kconfig"

config BSP_USING_C906_LITTLE
    bool
    select ARCH_RISCV64
    select ARCH_RISCV_FPU_D
    select RT_USING_COMPONENTS_INIT
    select RT_USING_USER_MAIN
    default y

config BSP_PLIC_PHY_ADDR
    hex
    default 0x70000000

config IRQ_MAX_NR
    int 
    default 61

config BSP_TIMER_CLK_FREQ
    int
    default 25000000

config BSP_GPIO_IRQ_BASE
    int
    default 41

config BSP_SYS_GPIO_IRQ_BASE
    int
    default 47

config SOC_TYPE_CV180X
    bool
    default n

config SOC_TYPE_SG2000
    bool
    default n

config SOC_TYPE_SG2002
    bool
    default n

choice
    prompt "Board Type"
    default BOARD_TYPE_MILKV_DUO256M

    config BOARD_TYPE_MILKV_DUO
        select SOC_TYPE_CV180X
        bool "milkv-duo"

    config BOARD_TYPE_MILKV_DUO_SPINOR
        select SOC_TYPE_CV180X
        bool "milkv-duo-spinor"

    config BOARD_TYPE_MILKV_DUO256M
        select SOC_TYPE_SG2002
        bool "milkv-duo256m"

    config BOARD_TYPE_MILKV_DUO256M_SPINOR
        select SOC_TYPE_SG2002
        bool "milkv-duo256m-spinor"

    config BOARD_TYPE_MILKV_DUOS
        select SOC_TYPE_SG2000
        bool "milkv-duos"

endchoice
```
