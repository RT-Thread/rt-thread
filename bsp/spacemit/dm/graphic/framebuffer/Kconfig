## bsp/spacemit/dm/graphic/framebuffer/Kconfig
```kconfig
config RT_GRAPHIC_FB_SPACEMIT
    bool "Spacemit K1 Saturn framebuffer"
    depends on RT_USING_GRAPHIC
    depends on RT_USING_OFW
    depends on RT_USING_CLK
    depends on RT_USING_RESET
    default n
    help
        RT-Thread framebuffer and HDMI output drivers for the Spacemit K1
        Saturn DPU. The display clock, reset, HDMI PHY and DPU scanout are
        initialized by RT-Thread without relying on a bootloader handoff.

        Supported primary-plane formats are ARGB8888, ABGR8888, RGB565 and
        BGR565. HDMI currently uses the board's known-good 1920x1080p60 mode.
```

## bsp/spacemit/dm/graphic/logo/Kconfig
```kconfig
config RT_GRAPHIC_LOGO_BIANBU_CLUT224
    bool "Standard 224-color Bianbu logo"

config RT_GRAPHIC_LOGO_SPACEMIT_CLUT224
    bool "Standard 224-color Spacemit logo"
```

## bsp/spacemit/dm/graphic/logo/Kconfig.path
```kconfig
if RT_GRAPHIC_LOGO_BIANBU_CLUT224
    config RT_GRAPHIC_LOGO_BIANBU_CLUT224_PATH
        string
        default "../dm/graphic/logo/logo-bianbu-clut224.ppm"
endif
if RT_GRAPHIC_LOGO_SPACEMIT_CLUT224
    config RT_GRAPHIC_LOGO_SPACEMIT_CLUT224_PATH
        string
        default "../dm/graphic/logo/logo-spacemit-clut224.ppm"
endif
```

## bsp/spacemit/dm/nvmem/Kconfig
```kconfig
config RT_NVMEM_SPACEMIT_EFUSE
    bool "Spacemit SoCs efuse support"
    depends on RT_USING_NVMEM
    depends on RT_USING_CLK
    depends on RT_USING_RESET
    default n
```

## bsp/spacemit/dm/pci/Kconfig
```kconfig
config RT_PCI_DW_SPACEMIT_K1X
    bool "Spacemit k1x DesignWare PCIe"
    depends on RT_PCI_DW
    depends on RT_USING_PIN
    depends on RT_USING_PINCTRL
    depends on RT_USING_RESET
    depends on RT_USING_REGULATOR
    select RT_PCI_DW_HOST
    select RT_PCI_DW_EP
    default n
```

## bsp/spacemit/dm/sdio/Kconfig
```kconfig
config RT_SDIO_SDHCI_SPACEMIT_K1X
    bool "Spacemit k1x MSHC SDHCI"
    depends on RT_USING_OFW
    select RT_USING_SDHCI
    default n
```

## bsp/spacemit/dm/soc/Kconfig
```kconfig
config RT_SOC_SPACEMIT_K1X_RPROC
    bool "Spacemit K1X remote processor"
    depends on RT_USING_OFW
    depends on RT_USING_DMA
    depends on RT_USING_CLK
    depends on RT_USING_RESET
    depends on RT_USING_MBOX
    depends on RT_USING_VIRTIO
    depends on RT_USING_RPMSG
    depends on RT_VIRTIO_RPMSG
    default n
    help
      Load and control the K1X RCPU firmware and provide its VirtIO RPMsg
      transport. The remote processor is started on demand by a client.

config RT_SOC_CHIP_MEDIA_JPU
    bool "Chip media JPU Driver"
    default n

config RT_SOC_SPACEMIT_V2D
    bool "Spacemit V2D Engine Driver"
    depends on RT_USING_OFW && RT_USING_DMA && RT_USING_CLK && RT_USING_RESET
    default n

config RT_SOC_SPACEMIT_K1X_TCM
    bool "Spacemit k1x generic TCM alloc management Driver"
    depends on RT_USING_MEMHEAP
    default n

config RT_SOC_SPACEMIT_SOCINFO
    bool "Spacemit SoC information Driver"
    depends on RT_USING_NVMEM
    default n
```

## bsp/spacemit/k1/Kconfig
```kconfig
mainmenu "RT-Thread Project Configuration"

BSP_DIR := .

RTT_DIR := ../../..

PKGS_DIR := packages

SOC_DM_DIR := $BSP_DIR/../dm/

source "$(SOC_DM_DIR)/Kconfig"
source "$(RTT_DIR)/Kconfig"
osource "$PKGS_DIR/Kconfig"

config SOC_SPACEMIT_K1
    bool
    select ARCH_RISCV64
    select RT_USING_RISCV_NEW_COMMON
    select RT_USING_COMPONENTS_INIT
    select RT_USING_USER_MAIN
    select RT_USING_CACHE
    select ARCH_MM_MMU
    select ARCH_REMAP_KERNEL if RT_USING_SMART
    select ARCH_RISCV_FPU_D
    select RT_USING_CPU_FFS
    select RT_USING_STDC_ATOMIC
    default y
```

## bsp/stm32/libraries/HAL_Drivers/drivers/Kconfig
```kconfig
if BSP_USING_USBD
    config BSP_USBD_TYPE_FS
        bool
        # "USB Full Speed (FS) Core"
    config BSP_USBD_TYPE_HS
        bool
        # "USB High Speed (HS) Core"

    config BSP_USBD_SPEED_HS
        bool
        # "USB High Speed (HS) Mode"
    config BSP_USBD_SPEED_HSINFS
        bool
        # "USB High Speed (HS) Core in FS mode"

    config BSP_USBD_PHY_EMBEDDED
        bool
        # "Using Embedded phy interface"
    config BSP_USBD_PHY_UTMI
        bool
        # "UTMI: USB 2.0 Transceiver Macrocell Interace"
    config BSP_USBD_PHY_ULPI
        bool
        # "ULPI: UTMI+ Low Pin Interface"
endif

menuconfig BSP_USING_ADC_V2
    bool "Enable ADC V2"
    select RT_USING_ADC
    select RT_USING_ADC_V2
    default n

if BSP_USING_ADC_V2
    config BSP_USING_ADC1
        bool "Enable ADC1"
        default n

    config BSP_USING_ADC2
        bool "Enable ADC2"
        depends on (SOC_SERIES_STM32F1 || SOC_SERIES_STM32F2 || SOC_SERIES_STM32F3 || \
                    SOC_SERIES_STM32F4 || SOC_SERIES_STM32G4 || SOC_SERIES_STM32F7 || \
                    SOC_SERIES_STM32H5 || SOC_SERIES_STM32H7 || SOC_SERIES_STM32H7RS || \
                    SOC_SERIES_STM32L4 || SOC_SERIES_STM32L5 || SOC_SERIES_STM32MP1 || \
                    SOC_SERIES_STM32U5)
        default n

    config BSP_USING_ADC3
        bool "Enable ADC3"
        depends on (SOC_SERIES_STM32F1 || SOC_SERIES_STM32F2 || SOC_SERIES_STM32F3 || \
                    SOC_SERIES_STM32F4 || SOC_SERIES_STM32G4 || SOC_SERIES_STM32F7 || \
                    SOC_SERIES_STM32H7 || SOC_SERIES_STM32L4 || SOC_SERIES_STM32MP1)
        default n

    config BSP_USING_ADC4
        bool "Enable ADC4"
        depends on (SOC_SERIES_STM32F3 || SOC_SERIES_STM32G4 || SOC_SERIES_STM32U5)
        default n

    config BSP_ADC_USING_TRIGGER
        bool "Enable ADC V2 trigger backend"
        select RT_ADC_USING_TRIGGER
        default n
        help
            Enable STM32 ADC V2 trigger selector validation and backend
            encoding. The ADC backend maps the framework-cached trigger to STM32
            HAL ADC selector fields. Trigger-source frequency and lifecycle are
            owned by the ADC trigger framework and timer trigger backend.

    config BSP_ADC_USING_TIMER_TRIGGER
        bool "Enable ADC V2 timer trigger selector backend"
        depends on BSP_ADC_USING_TRIGGER
        depends on BSP_USING_TIM
        depends on RT_USING_CLOCK_TIME
        select RT_ADC_TRIGGER_USING_TIMER
        select RT_USING_CLOCK_TIMER_TRIGGER
        default n
        help
            Enable STM32 TIMx update/TRGO and compare event to ADC external
            trigger selector mapping for ADC V2 stream pacing. Timer frequency,
            TRGO/compare setup, and lifecycle are handled through the clock
            timer trigger backend during ADC stream start and stop.

    config BSP_ADC_USING_ANALOG_COMPARE_TRIGGER
        bool "Enable ADC V2 analog comparator trigger selector backend"
        depends on BSP_ADC_USING_TRIGGER
        select RT_ADC_TRIGGER_USING_COMPARE
        default n
        help
            Enable STM32 COMPx_OUT to ADC external trigger selector mapping for
            ADC V2. Comparator input, threshold, polarity, and enable state are
            owned by board code, application code, or a comparator driver.

    config BSP_ADC_USING_STREAM_DMA
        bool

    config BSP_ADC1_USING_DMA
        bool "Enable ADC1 stream DMA backend"
        depends on BSP_USING_ADC1
        select RT_ADC_USING_STREAM
        select BSP_ADC_USING_STREAM_DMA
        default n
        help
            Enable the STM32 ADC1 DMA backend for ADC V2 stream sessions.

            This option only enables the board-level DMA backend. The stream
            framework and buffering policies are controlled by RT_ADC_USING_STREAM,
            RT_ADC_STREAM_USING_LATEST, and RT_ADC_STREAM_USING_FIFO.

    config BSP_ADC2_USING_DMA
        bool "Enable ADC2 stream DMA backend"
        depends on BSP_USING_ADC2
        select RT_ADC_USING_STREAM
        select BSP_ADC_USING_STREAM_DMA
        default n
        help
            Enable the STM32 ADC2 DMA backend for ADC V2 stream sessions.

    config BSP_ADC3_USING_DMA
        bool "Enable ADC3 stream DMA backend"
        depends on BSP_USING_ADC3
        select RT_ADC_USING_STREAM
        select BSP_ADC_USING_STREAM_DMA
        default n
        help
            Enable the STM32 ADC3 DMA backend for ADC V2 stream sessions.

    config BSP_ADC4_USING_DMA
        bool "Enable ADC4 stream DMA backend"
        depends on BSP_USING_ADC4
        select RT_ADC_USING_STREAM
        select BSP_ADC_USING_STREAM_DMA
        default n
        help
            Enable the STM32 ADC4 DMA backend for ADC V2 stream sessions.
endif

config BSP_USING_CRC
    bool "Enable CRC (CRC-32 0x04C11DB7 Polynomial)"
    select RT_USING_HWCRYPTO
    select RT_HWCRYPTO_USING_CRC
    # "Crypto device frame dose not support above 8-bits granularity"
    # "Reserve progress, running well, about 32-bits granularity, such as stm32f1, stm32f4"
    depends on (SOC_SERIES_STM32L4 || SOC_SERIES_STM32F0 || SOC_SERIES_STM32F7 || SOC_SERIES_STM32H7 || SOC_SERIES_STM32MP1)
    default n

config BSP_USING_RNG
    bool "Enable RNG (Random Number Generator)"
    select RT_USING_HWCRYPTO
    select RT_HWCRYPTO_USING_RNG
    depends on (SOC_SERIES_STM32L4 || SOC_SERIES_STM32F4 || SOC_SERIES_STM32F7 || \
                SOC_SERIES_STM32H7 || SOC_SERIES_STM32MP1)
    default n

config BSP_USING_HASH
    bool "Enable HASH (Hash House Harriers)"
    select RT_USING_HWCRYPTO
    select RT_HWCRYPTO_USING_HASH
    depends on (SOC_SERIES_STM32MP1)
    default n

config BSP_USING_CRYP
    bool "Enable CRYP (Encrypt And Decrypt Data)"
    select RT_USING_HWCRYPTO
    select RT_HWCRYPTO_USING_CRYP
    depends on (SOC_SERIES_STM32MP1)
    default n

config BSP_USING_UDID
    bool "Enable UDID (Unique Device Identifier)"
    select RT_USING_HWCRYPTO
    default n

if SOC_SERIES_STM32H7
    config BSP_USING_BDMA
        bool

    config BSP_SPI6_TX_USING_BDMA
        bool "Enable SPI6 TX BDMA"
        depends on BSP_USING_SPI6
        depends on !BSP_SPI6_TX_USING_DMA
        select BSP_USING_BDMA
        default n

    config BSP_SPI6_RX_USING_BDMA
        bool "Enable SPI6 RX BDMA"
        depends on BSP_USING_SPI6
        depends on !BSP_SPI6_RX_USING_DMA
        select BSP_USING_BDMA
        default n
endif

menu "STM32 Input Capture BSP"

    config BSP_USING_INPUT_CAPTURE
        bool "Enable STM32 timer Input Capture devices"
        default n
        select RT_USING_INPUT_CAPTURE
        help
            Registers selected STM32 hardware timer Input Capture devices.
            F1 and H7 have configuration headers; additional series need a
            matching configuration header before enabling this option.
            GPIO, clock and interrupt setup are owned by CubeMX HAL IC MSP.

    if BSP_USING_INPUT_CAPTURE
        config BSP_INPUT_CAPTURE_COUNTER_HZ
            int "Capture timer counter frequency (Hz)"
            range 100000 1000000
            default 1000000

        config BSP_USING_INPUT_CAPTURE_TIM1
            bool "Enable TIM1 Input Capture"
            default n

        if BSP_USING_INPUT_CAPTURE_TIM1
            config BSP_INPUT_CAPTURE_TIM1_NAME
                string "TIM1 Input Capture device name"
                default "ic1"

            config BSP_INPUT_CAPTURE_TIM1_CHANNEL
                int "TIM1 Input Capture channel (1-4)"
                range 1 4
                default 1

            config BSP_INPUT_CAPTURE_TIM1_FILTER
                int "TIM1 Input Capture digital filter (0-15)"
                range 0 15
                default 0

            config BSP_INPUT_CAPTURE_TIM1_INITIAL_RISING
                int "TIM1 initial capture edge (1 rising, 0 falling)"
                range 0 1
                default 1
        endif

        config BSP_USING_INPUT_CAPTURE_TIM2
            bool "Enable TIM2 Input Capture"
            default n

        if BSP_USING_INPUT_CAPTURE_TIM2
            config BSP_INPUT_CAPTURE_TIM2_NAME
                string "TIM2 Input Capture device name"
                default "ic2"

            config BSP_INPUT_CAPTURE_TIM2_CHANNEL
                int "TIM2 Input Capture channel (1-4)"
                range 1 4
                default 1

            config BSP_INPUT_CAPTURE_TIM2_FILTER
                int "TIM2 Input Capture digital filter (0-15)"
                range 0 15
                default 0

            config BSP_INPUT_CAPTURE_TIM2_INITIAL_RISING
                int "TIM2 initial capture edge (1 rising, 0 falling)"
                range 0 1
                default 1
        endif

        config BSP_USING_INPUT_CAPTURE_TIM3
            bool "Enable TIM3 Input Capture"
            default y

        if BSP_USING_INPUT_CAPTURE_TIM3
            config BSP_INPUT_CAPTURE_TIM3_NAME
                string "TIM3 Input Capture device name"
                default "ic3"

            config BSP_INPUT_CAPTURE_TIM3_CHANNEL
                int "TIM3 Input Capture channel (1-4)"
                range 1 4
                default 1

            config BSP_INPUT_CAPTURE_TIM3_FILTER
                int "TIM3 Input Capture digital filter (0-15)"
                range 0 15
                default 0

            config BSP_INPUT_CAPTURE_TIM3_INITIAL_RISING
                int "TIM3 initial capture edge (1 rising, 0 falling)"
                range 0 1
                default 1
        endif

        config BSP_USING_INPUT_CAPTURE_TIM4
            bool "Enable TIM4 Input Capture"
            default n

        if BSP_USING_INPUT_CAPTURE_TIM4
            config BSP_INPUT_CAPTURE_TIM4_NAME
                string "TIM4 Input Capture device name"
                default "ic4"

            config BSP_INPUT_CAPTURE_TIM4_CHANNEL
                int "TIM4 Input Capture channel (1-4)"
                range 1 4
                default 1

            config BSP_INPUT_CAPTURE_TIM4_FILTER
                int "TIM4 Input Capture digital filter (0-15)"
                range 0 15
                default 0

            config BSP_INPUT_CAPTURE_TIM4_INITIAL_RISING
                int "TIM4 initial capture edge (1 rising, 0 falling)"
                range 0 1
                default 1
        endif

    endif

endmenu
```

## bsp/stm32/stm32f103-blue-pill/Kconfig
```kconfig
mainmenu "RT-Thread Configuration"

BSP_DIR := .

RTT_DIR := ../../..

PKGS_DIR := packages
choice
    prompt "Select SOC"
    default SOC_STM32F103C8
    config SOC_STM32F103C8
        bool "STM32F103C8"
        select SOC_SERIES_STM32F1
        select RT_USING_COMPONENTS_INIT
        select RT_USING_USER_MAIN


    config SOC_STM32F103C6
        bool "STM32F103C6"
        select SOC_SERIES_STM32F1
        select RT_USING_COMPONENTS_INIT
        select RT_USING_USER_MAIN
        select RT_USING_SMALL_MEM              
        select RT_USING_SMALL_MEM_AS_HEAP      
        select RT_KLIBC_USING_LIBC_VSSCANF 
endchoice

source "$(RTT_DIR)/Kconfig"
osource "$PKGS_DIR/Kconfig"
rsource "../libraries/Kconfig"

if !RT_USING_NANO
rsource "board/Kconfig"
endif
```

## bsp/stm32/stm32f407-rt-spark/Kconfig
```kconfig
mainmenu "RT-Thread Configuration"

BSP_DIR := .

RTT_DIR := ../../..

PKGS_DIR := packages

config SOC_STM32F407ZG
    bool
    select SOC_SERIES_STM32F4
    select RT_USING_COMPONENTS_INIT
    select RT_USING_USER_MAIN
    select RT_USING_OFW if RT_USING_DM
    select RT_USING_BUILTIN_FDT if RT_USING_DM
    select RT_USING_PIC if RT_USING_DM
    select RT_PIC_ARM_NVIC if RT_USING_DM
    select RT_USING_PIN if RT_USING_DM
    default y

config BOARD_STM32F407_SPARK
    bool
    default y

config RT_BUILTIN_FDT_PATH
    string
    default "board/dts/stm32f407-rt-spark.dtb" if RT_USING_DM

source "$(RTT_DIR)/Kconfig"

osource "$PKGS_DIR/Kconfig"
rsource "../libraries/Kconfig"

if !RT_USING_NANO
rsource "board/Kconfig"
endif
```
