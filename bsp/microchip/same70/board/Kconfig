## bsp/n32/n32g45xvl-stb/defconfig
```kconfig
# CONFIG_RT_USING_TIMER_SOFT is not set
CONFIG_RT_USING_MEMHEAP=y
CONFIG_RT_CONSOLE_DEVICE_NAME="usart1"
# CONFIG_RT_USING_DFS is not set
CONFIG_RT_USING_SYSTEM_WORKQUEUE=y
CONFIG_RT_USING_CAN=y
CONFIG_RT_USING_I2C=y
CONFIG_RT_USING_ADC=y
CONFIG_RT_USING_DAC=y
CONFIG_RT_USING_RTC=y
CONFIG_RT_USING_SPI=y
CONFIG_RT_USING_WDT=y
CONFIG_RT_USING_HWTIMER=y
```

## bsp/n32/n32gxx_lxx/libraries/Kconfig
```kconfig
config SOC_FAMILY_N32
    bool

config SOC_SERIES_N32G45X
    bool
    select ARCH_ARM_CORTEX_M4
    select SOC_FAMILY_N32

config SOC_SERIES_N32G4FR
    bool
    select ARCH_ARM_CORTEX_M4
    select SOC_FAMILY_N32

config SOC_SERIES_N32WB452
    bool
    select ARCH_ARM_CORTEX_M4
    select SOC_FAMILY_N32

config SOC_SERIES_N32G4FR
    bool
    select ARCH_ARM_CORTEX_M4
    select SOC_FAMILY_N32
```

## bsp/n32/n32gxx_lxx/libraries/n32_drivers/Kconfig
```kconfig
if BSP_USING_USBD
    config BSP_USBD_TYPE_FS
        bool
        # "USB Full Speed (FS) Core"
endif
```

## bsp/n32/n32gxx_lxx/n32l40xcl-stb/board/Kconfig
```kconfig
menu "Hardware Drivers Config"

config SOC_SERIES_N32L40X
    bool
    default y

config SOC_N32L40X
    bool
    select SOC_SERIES_N32L40X
    select RT_USING_COMPONENTS_INIT
    select RT_USING_USER_MAIN
    default y

menu "Onboard Peripheral Drivers"

endmenu

menu "On-chip Peripheral Drivers"

    config BSP_USING_GPIO
        bool "Enable GPIO"
        select RT_USING_PIN
        default y

    menuconfig BSP_USING_UART
        bool "Enable UART"
        default y
        select RT_USING_SERIAL
        if BSP_USING_UART
            config BSP_USING_USART1
                bool "Enable USART1"
                default y

            config BSP_USING_USART2
                bool "Enable USART2"
                default n

            config BSP_USING_USART3
                bool "Enable USART3"
                default n

            config BSP_USING_UART4
                bool "Enable UART4"
                default n

            config BSP_USING_UART5
                bool "Enable UART5"
                default n

        endif

    menuconfig BSP_USING_SPI
        bool "Enable SPI BUS"
        default n
        select RT_USING_SPI
        if BSP_USING_SPI
            config BSP_USING_SPI1
                bool "Enable SPI1 BUS"
                default n

            config BSP_USING_SPI2
                bool "Enable SPI2 BUS"
                default n

        endif

    menuconfig BSP_USING_I2C1
        bool "Enable I2C1 BUS (software simulation)"
        default n
        select RT_USING_I2C
        select RT_USING_I2C_BITOPS
        select RT_USING_PIN
        if BSP_USING_I2C1
            config BSP_I2C1_SCL_PIN
                int "i2c1 scl pin number"
                range 0 64
                default 22

            config BSP_I2C1_SDA_PIN
                int "I2C1 sda pin number"
                range 0 64
                default 23
        endif

    menuconfig BSP_USING_RTC
        bool "Enable RTC"
        select RT_USING_RTC
        default n
        if BSP_USING_RTC
            choice
                prompt "Select clock source"
                default BSP_RTC_USING_LSE

                config BSP_RTC_USING_LSE
                    bool "RTC USING LSE"

                config BSP_RTC_USING_HSE
                    bool "RTC USING HSE"

                config BSP_RTC_USING_LSI
                    bool "RTC USING LSI"
            endchoice
        endif

    config BSP_USING_WDT
        bool "Enable Watchdog Timer"
        select RT_USING_WDT
        default n

    menuconfig BSP_USING_CLOCK_TIMER
        bool "Enable clock_timer"
        default n
        select RT_USING_CLOCK_TIME
        if BSP_USING_CLOCK_TIMER
            config BSP_USING_CLOCK_TIMER1
                bool "using clock_timer1"
                default n

            config BSP_USING_CLOCK_TIMER2
                bool "using clock_timer2"
                default n

            config BSP_USING_CLOCK_TIMER3
                bool "using clock_timer3"
                default n

            config BSP_USING_CLOCK_TIMER4
                bool "using clock_timer4"
                default n

            config BSP_USING_CLOCK_TIMER5
                bool "using clock_timer5"
                default n

            config BSP_USING_CLOCK_TIMER6
                bool "using clock_timer6"
                default n

            config BSP_USING_CLOCK_TIMER7
                bool "using clock_timer7"
                default n

            config BSP_USING_CLOCK_TIMER8
                bool "using clock_timer8"
                default n

            config BSP_USING_CLOCK_TIMER9
                bool "using clock_timer9"
                default n
        endif

    config BSP_USING_ADC
        bool "Enable ADC"
        select RT_USING_ADC
        default n

    config BSP_USING_DAC
        bool "Enable DAC"
        select RT_USING_DAC
        default n

    config BSP_USING_CAN
        bool "Enable CAN"
        select RT_USING_CAN
        default n

    rsource "../../libraries/n32_drivers/Kconfig"

endmenu

menu "Board extended module Drivers"

endmenu

endmenu
```

## bsp/n32/n32hxxx/libraries/Kconfig
```kconfig
config SOC_FAMILY_N32
    bool

config SOC_SERIES_N32H7xx
    bool
    select ARCH_ARM_CORTEX_M7
    select SOC_FAMILY_N32

config SOC_SERIES_N32H47x_48x
    bool
    select ARCH_ARM_CORTEX_M4
    select SOC_FAMILY_N32


config SOC_SERIES_N32H49x
    bool
    select ARCH_ARM_CORTEX_M4
    select SOC_FAMILY_N32
```
