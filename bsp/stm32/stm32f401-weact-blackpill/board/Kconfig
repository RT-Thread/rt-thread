## bsp/stm32/stm32f407-micu/board/Kconfig
```kconfig
menu "Hardware Drivers Config"

config SOC_STM32F407VE
    bool
    select SOC_SERIES_STM32F4
    select RT_USING_COMPONENTS_INIT
    select RT_USING_USER_MAIN
    default y

menu "Onboard Peripheral Drivers"

    config BSP_USING_VIRTUAL_USART
        bool "Enable DAPLink USB-to-USART1 virtual port"
        select BSP_USING_UART
        select BSP_USING_UART1
        default y

    config BSP_USING_ON_BOARD_FLASH
        bool "Enable Onboard SPI Flash"
        select BSP_USING_SPI
        select BSP_USING_SPI1
        select BSP_SPI1_TX_USING_DMA
        select BSP_SPI1_RX_USING_DMA
        select RT_USING_SFUD
        default n

    config BSP_USING_AHT20
        bool "Enable AHT20(swi2c1)"
        select RT_USING_I2C
        select BSP_USING_SOFT_I2C
        select BSP_USING_SOFT_I2C1
        select PKG_USING_SENSORS_DRIVERS
        select PKG_USING_AHT10
        default n 

    config BSP_USING_ICM20608
        bool "Enable ICM20608(swi2c1)"
        select RT_USING_I2C
        select BSP_USING_SOFT_I2C
        select BSP_USING_SOFT_I2C1
        select PKG_USING_SENSORS_DRIVERS
        select PKG_USING_ICM20608
        default n

        
    config RT_SOFT_I2C1_HAS_PIN_DEFAULT
        bool
        default y if RT_USING_SOFT_I2C1

    config RT_SOFT_I2C1_SCL_PIN_DEFAULT
        int
        default 22 if RT_USING_SOFT_I2C1

    config RT_SOFT_I2C1_SDA_PIN_DEFAULT
        int
        default 23 if RT_USING_SOFT_I2C1

    config RT_SOFT_I2C2_HAS_PIN_DEFAULT
        bool
        default y if RT_USING_SOFT_I2C2

    config RT_SOFT_I2C2_SCL_PIN_DEFAULT
        int
        default 26 if RT_USING_SOFT_I2C2

    config RT_SOFT_I2C2_SDA_PIN_DEFAULT
        int
        default 27 if RT_USING_SOFT_I2C2

endmenu

menu "On-chip Peripheral Drivers"

    config BSP_USING_GPIO
        bool "Enable GPIO"
        select RT_USING_PIN
        default y

    menuconfig BSP_USING_UART
        bool "Enable UART"
        default y
        select RT_USING_SERIAL
        if BSP_USING_UART
            config BSP_STM32_UART_V1_TX_TIMEOUT
                int "UART TX timeout"
                default 2000
                depends on RT_USING_SERIAL_V1
                
            config BSP_USING_UART1
                bool "Enable UART1"
                default y

            config BSP_UART1_RX_USING_DMA
                bool "Enable UART1 RX DMA"
                depends on BSP_USING_UART1 && RT_SERIAL_USING_DMA
                default n
        endif
        
    menuconfig BSP_USING_SPI
            bool "Enable SPI BUS"
            default n
            select RT_USING_SPI
            if BSP_USING_SPI
                config BSP_USING_SPI1
                    bool "Enable SPI1 BUS"
                    default n

                config BSP_SPI1_TX_USING_DMA
                    bool "Enable SPI1 TX DMA"
                    depends on BSP_USING_SPI1
                    default n

                config BSP_SPI1_RX_USING_DMA
                    bool "Enable SPI1 RX DMA"
                    depends on BSP_USING_SPI1
                    select BSP_SPI1_TX_USING_DMA
                    default n

                config BSP_USING_SPI2
                    bool "Enable SPI2 BUS"
                    default n

                config BSP_SPI2_TX_USING_DMA
                    bool "Enable SPI2 TX DMA"
                    depends on BSP_USING_SPI2
                    default n

                config BSP_SPI2_RX_USING_DMA
                    bool "Enable SPI2 RX DMA"
                    depends on BSP_USING_SPI2
                    select BSP_SPI2_TX_USING_DMA
                    default n
            endif

    config BSP_USING_SDIO
        bool "Enable SDIO"
        select RT_USING_SDIO
        default n
        if BSP_USING_SDIO
            config SDIO_MAX_FREQ
                int "sdio max freq"
                range 0 24000000
                depends on BSP_USING_SDIO
                default 1000000
        endif

    menuconfig BSP_USING_ONCHIP_RTC
        bool "Enable RTC"
        select RT_USING_RTC
        default n
        if BSP_USING_ONCHIP_RTC
            choice BSP_RTC_LS_SEL
                prompt "Select clock source"
                default BSP_RTC_USING_LSE

                config BSP_RTC_USING_LSE
                    bool "RTC USING LSE"

                config BSP_RTC_USING_LSI
                    bool "RTC USING LSI"
            endchoice
        endif

    menuconfig BSP_USING_SOFT_I2C
        bool "Enable software I2C (swi2c)"
        default n
        select RT_USING_I2C
        select RT_USING_SOFT_I2C
        if BSP_USING_SOFT_I2C
        menuconfig BSP_USING_SOFT_I2C1
            bool "Enable software I2C1 Bus (swi2c1)"
            default n
            select RT_USING_SOFT_I2C1
            if BSP_USING_SOFT_I2C1
                config RT_SOFT_I2C1_SCL_PIN
                    int "swi2c1 SCL pin number"
                    default 22
                config RT_SOFT_I2C1_SDA_PIN
                    int "swi2c1 SDA pin number"
                    default 23
            endif

        menuconfig BSP_USING_SOFT_I2C2
            bool "Enable software I2C2 Bus (swi2c2)"
            default n
            select RT_USING_SOFT_I2C2
            if BSP_USING_SOFT_I2C2
                config RT_SOFT_I2C2_SCL_PIN
                    int "swi2c2 SCL pin number"
                    default 26
                config RT_SOFT_I2C2_SDA_PIN
                    int "swi2c2 SDA pin number"
                    default 27
            endif
        endif
    menuconfig BSP_USING_TIM
        bool "Enable timer"
        default n
        select RT_USING_CLOCK_TIME
        if BSP_USING_TIM
            config BSP_USING_TIM11
                bool "Enable TIM11"
                default n

            config BSP_USING_TIM13
                bool "Enable TIM13"
                default n

            config BSP_USING_TIM14
                bool "Enable TIM14"
                default n
        endif

    menuconfig BSP_USING_PWM
        bool "Enable PWM"
        default n
        select RT_USING_PWM
        if BSP_USING_PWM
        menuconfig BSP_USING_PWM1
            bool "Enable timer1 output PWM"
            default n
            if BSP_USING_PWM1
                config BSP_USING_PWM1_CH1
                    bool "Enable PWM1 channel1"
                    default n
                config BSP_USING_PWM1_CH2
                    bool "Enable PWM1 channel2"
                    default n
                config BSP_USING_PWM1_CH3
                    bool "Enable PWM1 channel3"
                    default n
                config BSP_USING_PWM1_CH4
                    bool "Enable PWM1 channel4"
                    default n
            endif
        menuconfig BSP_USING_PWM3
            bool "Enable timer3 output PWM"
            default n
            if BSP_USING_PWM3
                config BSP_USING_PWM3_CH1
                    bool "Enable PWM3 channel1"
                    default n
                config BSP_USING_PWM3_CH2
                    bool "Enable PWM3 channel2"
                    default n
            endif
        menuconfig BSP_USING_PWM4
            bool "Enable timer4 output PWM"
            default n
            if BSP_USING_PWM4
                config BSP_USING_PWM4_CH1
                    bool "Enable PWM4 channel1"
                    default n
                config BSP_USING_PWM4_CH2
                    bool "Enable PWM4 channel2"
                    default n
            endif
        endif
    source "$(BSP_DIR)/../libraries/HAL_Drivers/drivers/Kconfig"

endmenu

menu "Board extended module Drivers"

    config BSP_USING_SSD1306
        bool "Enable SSD1306 OLED"
        select RT_USING_I2C
        select BSP_USING_SOFT_I2C
        select BSP_USING_SOFT_I2C2
        select PKG_USING_SSD1306
        default n
        help
            Enable SSD1306 OLED display (connected to I2C2 on this board).


endmenu


endmenu
```

## bsp/stm32/stm32f407-robomaster-c/board/Kconfig
```kconfig
menu "Hardware Drivers Config"

config SOC_STM32F407IG
    bool
    select SOC_SERIES_STM32F4
    select RT_USING_COMPONENTS_INIT
    select RT_USING_USER_MAIN
    default y

menu "Onboard Peripheral Drivers"

    config BSP_USING_ARDUINO
        bool "Compatible with Arduino Ecosystem (RTduino)"
        select PKG_USING_RTDUINO
        select BSP_USING_STLINK_TO_USART
        select BSP_USING_GPIO
        select BSP_USING_ADC
        select BSP_USING_ADC1
        select BSP_USING_PWM
        select BSP_USING_PWM1
        select BSP_USING_PWM1_CH1
        select BSP_USING_PWM1_CH2
        select BSP_USING_PWM1_CH3
        select BSP_USING_PWM1_CH4
        select BSP_USING_PWM8
        select BSP_USING_PWM8_CH1
        select BSP_USING_PWM8_CH2
        select BSP_USING_PWM8_CH3
        select BSP_USING_I2C
        select BSP_USING_I2C1
        imply RTDUINO_USING_SERVO
        imply RTDUINO_USING_WIRE
        default n

endmenu

menu "On-chip Peripheral Drivers"

    config BSP_USING_GPIO
        bool "Enable GPIO"
        select RT_USING_PIN
        default y

    menuconfig BSP_USING_UART
        bool "Enable UART"
        default y
        select RT_USING_SERIAL
        if BSP_USING_UART
            config BSP_USING_UART1
                bool "Enable UART1 (FinSH , symbol UART2 on board)"
                default y

            config BSP_UART1_RX_USING_DMA
                bool "Enable UART1 RX DMA"
                depends on BSP_USING_UART1 && RT_SERIAL_USING_DMA
                default n

            config BSP_USING_UART3
                bool "Enable UART3 (DBUS)"
                default n
            config BSP_UART3_RX_USING_DMA
                bool "Enable UART3 RX DMA"
                depends on BSP_USING_UART3 && RT_SERIAL_USING_DMA
                default n

            config BSP_USING_UART6
                bool "Enable UART6"
                default n
            config BSP_UART6_RX_USING_DMA
                bool "Enable UART6 RX DMA"
                depends on BSP_USING_UART6 && RT_SERIAL_USING_DMA
                default n

        endif

    menuconfig BSP_USING_CAN
        bool "Enable CAN"
        default n
        select RT_USING_CAN
        if BSP_USING_CAN
            config BSP_USING_CAN1
                bool "using CAN1 (2pin)"
                default n
            config BSP_USING_CAN2
                bool "using CAN2 (4pin)"
                default n
        endif

    menuconfig BSP_USING_PWM
        bool "Enable PWM"
        default n
        select RT_USING_PWM
        if BSP_USING_PWM

            menuconfig BSP_USING_PWM1
                bool "Enable timer1 output PWM"
                default n
                if BSP_USING_PWM1
                    config BSP_USING_PWM1_CH1
                        bool "Enable PWM1 channel1"
                        default n
                    config BSP_USING_PWM1_CH2
                        bool "Enable PWM1 channel2"
                        default n
                    config BSP_USING_PWM1_CH3
                        bool "Enable PWM1 channel3"
                        default n
                    config BSP_USING_PWM1_CH4
                        bool "Enable PWM1 channel4"
                        default n
                endif

            menuconfig BSP_USING_PWM4
                bool "Enable timer4 output PWM"
                default n
                if BSP_USING_PWM4
                    config BSP_USING_PWM4_CH3
                        bool "Enable PWM4 channel3 (buzzer)"
                        default n
                endif

            menuconfig BSP_USING_PWM5
                bool "Enable timer5 output PWM"
                default n
                if BSP_USING_PWM5
                    config BSP_USING_PWM5_CH1
                        bool "Enable PWM5 channel1(LED_B)"
                        default n
                    config BSP_USING_PWM5_CH2
                        bool "Enable PWM5 channel2(LED_G)"
                        default n
                    config BSP_USING_PWM5_CH3
                        bool "Enable PWM5 channel3(LED_R)"
                        default n
                endif

            menuconfig BSP_USING_PWM8
                bool "Enable timer8 output PWM"
                default n
                if BSP_USING_PWM8
                    config BSP_USING_PWM8_CH1
                        bool "Enable PWM8 channel1"
                        default n
                    config BSP_USING_PWM8_CH2
                        bool "Enable PWM8 channel2"
                        default n
                    config BSP_USING_PWM8_CH3
                        bool "Enable PWM8 channel3"
                        default n
                endif

        endif

    menuconfig BSP_USING_ADC
        bool "Enable ADC"
        default n
        select RT_USING_ADC
        if BSP_USING_ADC
            config BSP_USING_ADC1
                bool "Enable ADC1"
                default n
            config BSP_USING_ADC3
                bool "Enable ADC3"
                default n
        endif

    menuconfig BSP_USING_SPI
        bool "Enable SPI BUS"
        default n
        select RT_USING_SPI
        if BSP_USING_SPI
            config BSP_USING_SPI2
                bool "Enable SPI2 BUS"
                default n

            config BSP_SPI2_TX_USING_DMA
                bool "Enable SPI2 TX DMA"
                depends on BSP_USING_SPI2
                default n

            config BSP_SPI2_RX_USING_DMA
                bool "Enable SPI2 RX DMA"
                depends on BSP_USING_SPI2
                select BSP_SPI2_TX_USING_DMA
                default n
        endif

    menuconfig BSP_USING_I2C1
        bool "Enable I2C1 BUS (software simulation)"
        default n
        select RT_USING_I2C
        select RT_USING_I2C_BITOPS
        select RT_USING_PIN
        if BSP_USING_I2C1
            comment "Notice: PF0 --> 80; PF1 --> 81"
            config BSP_I2C1_SCL_PIN
                int "i2c1 scl pin number"
                default 81
            config BSP_I2C1_SDA_PIN
                int "I2C1 sda pin number"
                default 80
        endif


    source "../libraries/HAL_Drivers/Kconfig"

endmenu

menu "Board extended module Drivers"

endmenu

endmenu
```
