## bsp/stm32/stm32l475-atk-pandora/board/Kconfig
```kconfig
menu "Hardware Drivers Config"

config SOC_STM32L475VE
    bool
    select SOC_SERIES_STM32L4
    select RT_USING_COMPONENTS_INIT
    select RT_USING_USER_MAIN
    default y

config BOARD_STM32L475_ATK_PANDORA
    bool
    default y

menu "Onboard Peripheral Drivers"

    config BSP_USING_STLINK_TO_USART
        bool "Enable STLINK TO USART (uart1)"
        select BSP_USING_UART
        select BSP_USING_UART1
        default y

    config BSP_USING_ARDUINO
        bool "Compatible with Arduino Ecosystem (RTduino)"
        select PKG_USING_RTDUINO
        select BSP_USING_STLINK_TO_USART
        select BSP_USING_GPIO
        select BSP_USING_TIM
        select BSP_USING_TIM7
        select BSP_USING_PWM
        select BSP_USING_PWM1
        select BSP_USING_PWM1_CH1
        select BSP_USING_PWM2
        select BSP_USING_PWM2_CH3
        select BSP_USING_PWM2_CH4
        select BSP_USING_PWM4
        select BSP_USING_PWM4_CH1
        select BSP_USING_PWM4_CH2
        select BSP_USING_PWM4_CH3
        select BSP_USING_PWM4_CH4
        select BSP_USING_ADC
        select BSP_USING_ADC1
        select BSP_USING_I2C
        select BSP_USING_I2C1 # PC7-SDA PC6-SCL (User I2C)
        select BSP_USING_DAC
        select BSP_USING_DAC1
        select BSP_USING_SPI
        select BSP_USING_SPI2 # Wireless Interface (User SPI)
        imply BSP_SPI2_TX_USING_DMA
        imply BSP_SPI2_RX_USING_DMA
        imply RTDUINO_USING_SERVO
        imply RTDUINO_USING_WIRE
        imply RTDUINO_USING_SPI
        default n

    if BSP_USING_ARDUINO
        config BSP_USING_ARDUINO_ST7789
            bool "Enable LCD (ST7789) Arduino libraries"
            select BSP_USING_SPI3
            select BSP_SPI3_TX_USING_DMA
            select PKG_USING_ARDUINO_ADAFRUIT_ST7735
            depends on !BSP_USING_SPI_LCD
            default n

        config BSP_USING_ARDUINO_ST7789_DEMO
            bool "Enable LCD (ST7789) Arduino demo"
            depends on BSP_USING_ARDUINO_ST7789
            default n

        config BSP_USING_ARDUINO_AHT10
            bool "Enable AHT10 sensor Arduino libraries"
            select BSP_USING_I2C4
            select PKG_USING_ARDUINO_ADAFRUIT_AHTX0
            depends on !BSP_USING_AHT10
            default n

        config BSP_USING_ARDUINO_AP3216
            bool
            select BSP_USING_I2C3
            depends on !BSP_USING_AP3216C
            default n

        config BSP_USING_ARDUINO_ICM20608
            bool
            select BSP_USING_I2C3
            depends on !BSP_USING_ICM20608
            default n
    endif

    config BSP_USING_KEY
        bool "Enable onboard keys"
        select RT_USING_PIN
        select RT_USING_TIMER_SOFT
        select PKG_USING_MULTIBUTTON
        default n

    config BSP_USING_QSPI_FLASH
        bool "Enable QSPI FLASH (W25Q128 qspi1)"
        select BSP_USING_QSPI
        select RT_USING_SFUD
        select RT_SFUD_USING_QSPI
        default n

    config BSP_USING_SPI_LCD
        bool "Enable LCD (spi3)"
        select BSP_USING_SPI
        select BSP_USING_SPI3
        select BSP_SPI3_TX_USING_DMA
        select BSP_USING_PWM
        select BSP_USING_PWM4
        select BSP_USING_PWM4_CH2
        default n

    config BSP_USING_LCD_SAMPLE
        bool "Enable LCD raw driver sample"
        depends on BSP_USING_SPI_LCD && !BSP_USING_LVGL
        default n

    config BSP_USING_LCD_QRCODE
        bool "Enable LCD to show QRCode"
        depends on BSP_USING_SPI_LCD && !BSP_USING_LVGL
        select BSP_USING_LCD_SAMPLE
        select PKG_USING_QRCODE
        default n

    config BSP_USING_LVGL
        bool "Enable LVGL for LCD"
        select PKG_USING_LVGL
        select BSP_USING_SPI_LCD
        default n

    if BSP_USING_LVGL
        config BSP_USING_LVGL_DEMO
            bool "Enable LVGL demo"
            default y
    endif

    menuconfig BSP_USING_FS
        bool "Enable File System"
        select RT_USING_DFS
        select RT_USING_DFS_ROMFS
        default n

        if BSP_USING_FS
            config BSP_USING_SDCARD_FATFS
                bool "Enable SDCARD (FATFS)"
                select BSP_USING_SPI
                select BSP_USING_SPI1
                select RT_USING_SPI_MSD
                select RT_USING_DFS_ELMFAT
                default n

            config BSP_USING_SPI_FLASH_LITTLEFS
                bool "Enable SPI-FLASH (LittleFS)"
                select RT_USING_MTD_NOR
                select BSP_USING_QSPI_FLASH
                select RT_USING_FAL
                select FAL_USING_AUTO_INIT
                select FAL_PART_HAS_TABLE_CFG
                select PKG_USING_LITTLEFS
                default n
        endif


    config BSP_USING_ICM20608
        bool "Enable ICM20608 (i2c3)"
        select BSP_USING_I2C
        select BSP_USING_I2C3
        select PKG_USING_MPU6XXX
        select PKG_USING_MPU6XXX_LATEST_VERSION
        default n

    config BSP_USING_AHT10
        bool "Enable AHT10 (i2c4)"
        select BSP_USING_I2C
        select BSP_USING_I2C4
        select PKG_USING_AHT10
        select AHT10_USING_SENSOR_DEVICE
        default n

    config BSP_USING_AP3216C
        bool "Enable AP3216C (i2c3)"
        select BSP_USING_I2C
        select BSP_USING_I2C3
        select PKG_USING_AP3216C
        select AP3216C_USING_SENSOR_DEVICE
        default n

    menuconfig BSP_USING_AUDIO
        bool "Enable Audio Device"
        select RT_USING_AUDIO
        select BSP_USING_I2C
        select BSP_USING_I2C3
        default n

        if BSP_USING_AUDIO
            config BSP_USING_AUDIO_PLAY
            bool "Enable Audio Play"
            default y

            config BSP_USING_AUDIO_RECORD
            bool "Enable Audio Record"
            default n
        endif

    menuconfig BSP_USING_USB_AUDIO
        bool "Enable USB Audio"
        select RT_USB_DEVICE_AUDIO
        select BSP_USING_USBD
        select BSP_USBD_EP_ISOC
        select BSP_USING_AUDIO
        default n

        if BSP_USING_USB_AUDIO
            config BSP_USING_USB_AUDIO_SPEAKER
            bool "Enable USB Audio Spearker"
            select RT_USB_DEVICE_AUDIO_SPEAKER
            select BSP_USING_AUDIO_PLAY
            default y

            config BSP_USING_USB_AUDIO_MIC
            bool "Enable USB Audio Mic"
            select RT_USB_DEVICE_AUDIO_MIC
            select BSP_USING_AUDIO_RECORD
            default n

            config _BSP_USB_DEVICE_COMPOSITE
            bool
            select RT_USB_DEVICE_COMPOSITE
            default y
            depends on BSP_USING_USB_AUDIO_SPEAKER && BSP_USING_USB_AUDIO_MIC
        endif

    config BSP_USING_WIFI
            bool "Enable WiFi (AP6181)"
            select PKG_USING_WLAN_WICED
            select BSP_USING_STM32_SDIO
            select PKG_USING_STM32_SDIO
            select BSP_USING_QSPI_FLASH
            select BSP_USING_ON_CHIP_FLASH
            select RT_USING_WIFI
            select RT_WLAN_PROT_LWIP_PBUF_FORCE
            select RT_USING_LWIP
            select RT_USING_DFS
            select DFS_USING_POSIX
            select RT_USING_FAL
            select PKG_USING_EASYFLASH
            select RT_USING_WIFI_6181_LIB
            select RT_USING_OTA_LIB
            select RT_USING_SAL
            default n

            if BSP_USING_WIFI
                config BSP_USING_WIFI_THREAD_INIT
                    bool "Using Thread Initialize WiFi"
                    default n

                config BSP_USING_WIFI_AUTO_INIT
                    bool "Using WiFi Automatically Initialization"
                    depends on RT_USING_COMPONENTS_INIT
                    default y
            endif

endmenu

menu "On-chip Peripheral Drivers"

    config BSP_USING_GPIO
        bool "Enable GPIO"
        select RT_USING_PIN
        default y

    menuconfig BSP_USING_UART
        bool "Enable UART"
        default y
        select RT_USING_SERIAL
        if BSP_USING_UART
            menuconfig BSP_USING_UART1
                bool "Enable UART1 (Debugger)"
                default y
                if BSP_USING_UART1
                    config BSP_UART1_RX_USING_DMA
                        bool "Enable UART1 RX DMA"
                        depends on BSP_USING_UART1 && RT_SERIAL_USING_DMA
                        default n

                    config BSP_UART1_TX_USING_DMA
                        bool "Enable UART1 TX DMA"
                        depends on BSP_USING_UART1 && RT_SERIAL_USING_DMA
                        default n

                    config BSP_UART1_RX_BUFSIZE
                        int "Set UART1 RX buffer size"
                        range 64 65535
                        depends on RT_USING_SERIAL_V2
                        default 256

                    config BSP_UART1_TX_BUFSIZE
                        int "Set UART1 TX buffer size"
                        range 0 65535
                        depends on RT_USING_SERIAL_V2
                        default 0
                endif

            menuconfig BSP_USING_UART2
                bool "Enable UART2"
                default n
                if BSP_USING_UART2
                    config BSP_UART2_RX_USING_DMA
                        bool "Enable UART2 RX DMA"
                        depends on BSP_USING_UART2 && RT_SERIAL_USING_DMA
                        default n

                    config BSP_UART2_TX_USING_DMA
                        bool "Enable UART2 TX DMA"
                        depends on BSP_USING_UART2 && RT_SERIAL_USING_DMA
                        default n

                    config BSP_UART2_RX_BUFSIZE
                        int "Set UART2 RX buffer size"
                        range 64 65535
                        depends on RT_USING_SERIAL_V2
                        default 256

                    config BSP_UART2_TX_BUFSIZE
                        int "Set UART2 TX buffer size"
                        range 0 65535
                        depends on RT_USING_SERIAL_V2
                        default 256
                endif
        endif

    config BSP_USING_ON_CHIP_FLASH
        bool "Enable on-chip FLASH"
        default n

    menuconfig BSP_USING_SPI
        bool "Enable SPI Bus"
        default n
        select RT_USING_SPI
        if BSP_USING_SPI
            config BSP_USING_SPI1
                bool "Enable SPI1 Bus"
                default n

            config BSP_SPI1_TX_USING_DMA
                bool "Enable SPI1 TX DMA"
                depends on BSP_USING_SPI1
                default n

            config BSP_SPI1_RX_USING_DMA
                bool "Enable SPI1 RX DMA"
                depends on BSP_USING_SPI1
                select BSP_SPI1_TX_USING_DMA
                default n

            config BSP_USING_SPI2
                bool "Enable SPI2 Bus"
                default n

            config BSP_SPI2_TX_USING_DMA
                bool "Enable SPI2 TX DMA"
                depends on BSP_USING_SPI2
                default n

            config BSP_SPI2_RX_USING_DMA
                bool "Enable SPI2 RX DMA"
                depends on BSP_USING_SPI2
                select BSP_SPI2_TX_USING_DMA
                default n

            config BSP_USING_SPI3
                bool "Enable SPI3 Bus"
                default n

            config BSP_SPI3_TX_USING_DMA
                bool "Enable SPI3 TX DMA"
                depends on BSP_USING_SPI3
                default n

            config BSP_SPI3_RX_USING_DMA
                bool "Enable SPI3 RX DMA"
                depends on BSP_USING_SPI3
                select BSP_SPI3_TX_USING_DMA
                default n
        endif

    config BSP_USING_QSPI
        bool "Enable QSPI Bus"
        select RT_USING_QSPI
        select RT_USING_SPI
        default n

    config BSP_QSPI_USING_DMA
        bool "Enable QSPI DMA support"
        default n

    menuconfig BSP_USING_I2C
        bool "Enable I2C Bus"
        default n
        select RT_USING_I2C
        select RT_USING_I2C_BITOPS
        select RT_USING_PIN
        if BSP_USING_I2C
            config BSP_USING_I2C1
                bool "Enable I2C1 Bus (User I2C)"
                default n
                if BSP_USING_I2C1
                    comment "Notice: PC7 --> 39; PC6 --> 38"
                    config BSP_I2C1_SCL_PIN
                        int "i2c1 SCL pin number"
                        range 1 176
                        default 38
                    config BSP_I2C1_SDA_PIN
                        int "i2c1 SDA pin number"
                        range 1 176
                        default 39
                endif

            config BSP_USING_I2C3
                bool "Enable I2C3 Bus (AP3216C/ICM20608/ES8388)"
                default n

                if BSP_USING_I2C3
                    # Notice: PC0 --> 32; PC1 --> 33
                    config BSP_I2C3_SCL_PIN
                        int
                        default 32
                    config BSP_I2C3_SDA_PIN
                        int
                        default 33
                endif

            config BSP_USING_I2C4
                bool "Enable I2C4 Bus (AHT10)"
                default n

                if BSP_USING_I2C4
                    # Notice: PC1 --> 33; PD6 --> 54
                    config BSP_I2C4_SCL_PIN
                        int
                        default 54
                    config BSP_I2C4_SDA_PIN
                        int
                        default 33
                endif
        endif

    menuconfig BSP_USING_TIM
        bool "Enable timer"
        default n
        select RT_USING_HWTIMER
        if BSP_USING_TIM
            config BSP_USING_TIM7
                bool "Enable TIM7"
                default n

            config BSP_USING_TIM15
                bool "Enable TIM15"
                default n

            config BSP_USING_TIM16
                bool "Enable TIM16"
                default n

            config BSP_USING_TIM17
                bool "Enable TIM17"
                default n
        endif

    menuconfig BSP_USING_PWM
        bool "Enable PWM"
        default n
        select RT_USING_PWM
        if BSP_USING_PWM
        menuconfig BSP_USING_PWM1
            bool "Enable timer1 output PWM"
            default n
            if BSP_USING_PWM1
                config BSP_USING_PWM1_CH1
                    bool "Enable PWM1 channel1"
                    default n
            endif

        menuconfig BSP_USING_PWM2
            bool "Enable timer2 output PWM"
            default n
            if BSP_USING_PWM2
                config BSP_USING_PWM2_CH3
                    bool "Enable PWM2 channel3"
                    default n

                config BSP_USING_PWM2_CH4
                    bool "Enable PWM2 channel4"
                    default n
            endif

        menuconfig BSP_USING_PWM4
            bool "Enable timer4 output PWM"
            default n
            if BSP_USING_PWM4
                config BSP_USING_PWM4_CH1
                    bool "Enable PWM4 channel1"
                    default n

                config BSP_USING_PWM4_CH2
                    bool "Enable PWM4 channel2"
                    default n

                config BSP_USING_PWM4_CH3
                    bool "Enable PWM4 channel3"
                    default n

                config BSP_USING_PWM4_CH4
                    bool "Enable PWM4 channel4"
                    default n
            endif
        endif

    menuconfig BSP_USING_ADC
        bool "Enable ADC"
        default n
        select RT_USING_ADC
        if BSP_USING_ADC
            config BSP_USING_ADC1
                bool "Enable ADC1"
                default n
        endif

    menuconfig BSP_USING_DAC
        bool "Enable DAC"
        default n
        select RT_USING_DAC
        if BSP_USING_DAC
            config BSP_USING_DAC1
                bool "Enable DAC1"
                default n
        endif

    menuconfig BSP_USING_ONCHIP_RTC
        bool "Enable RTC"
        select RT_USING_RTC
        default n
        if BSP_USING_ONCHIP_RTC
            choice
                prompt "Select clock source"
                default BSP_RTC_USING_LSE

                config BSP_RTC_USING_LSE
                    bool "RTC USING LSE"

                config BSP_RTC_USING_LSI
                    bool "RTC USING LSI"
            endchoice
        endif

    config BSP_USING_WDT
        bool "Enable Watchdog Timer"
        select RT_USING_WDT
        default n

    config BSP_USING_USBD
        bool "Enable OTGFS as USB device"
        select RT_USING_USB_DEVICE
        default n

    config BSP_USBD_EP_ISOC
        bool
        default n
        depends on BSP_USING_USBD

    config BSP_USING_STM32_SDIO
            bool "Enable SDIO"
            select RT_USING_SDIO
            select PKG_USING_STM32_SDIO
            default n
            help
            BSP_USING_STM32_SDIO use drv_sdio_adapter.c,and
            BSP_USING_SDIO use drv_sdio.c

    source "../libraries/HAL_Drivers/Kconfig"

endmenu

menu "Board extended module Drivers"

    menuconfig BSP_USING_AT_ESP8266
        bool "Enable ESP8266(AT Command, COM2)"
        default n
        select BSP_USING_COM2
        select PKG_USING_AT_DEVICE
        select AT_DEVICE_USING_ESP8266
        select AT_DEVICE_ESP8266_SAMPLE
        select AT_DEVICE_ESP8266_SAMPLE_BSP_TAKEOVER

        if BSP_USING_AT_ESP8266

            config ESP8266_SAMPLE_WIFI_SSID
                string "WIFI ssid"
                default "rtthread"

            config ESP8266_SAMPLE_WIFI_PASSWORD
                string "WIFI password"
                default "12345678"

            config ESP8266_SAMPLE_CLIENT_NAME
                string "AT client device name (Must be 'uart2')"
                default "uart2"

            config ESP8266_SAMPLE_RECV_BUFF_LEN
                int "The maximum length of receive line buffer"
                default 512

            comment "May adjust RT_SERIAL_RB_BUFSZ up to 512 if using the Serial V1 device driver"

        endif

    config BSP_USING_NRF24L01
        bool "Enable NRF24L01"
        select BSP_USING_SPI
        select BSP_USING_SPI2
        select PKG_USING_NRF24L01
        default n

endmenu

endmenu
```
