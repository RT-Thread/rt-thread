## bsp/wch/arm/ch579m/board/Kconfig
```kconfig
menu "Hardware Drivers Config"

config SOC_CH579M
    bool
    select RT_USING_USER_MAIN
    select RT_USING_COMPONENTS_INIT
    default y

menu "On-chip Peripheral Drivers"

    menuconfig BSP_USING_UART
        bool "Enable UART"
        default y
        select RT_USING_SERIAL
        if BSP_USING_UART
            config BSP_USING_UART0
                bool "Enable UART0"
                default n

            config BSP_USING_UART1
                bool "Enable UART1"
                default y

            config BSP_USING_UART2
                bool "Enable UART2"
                default n

            config BSP_USING_UART3
                bool "Enable UART3"
                default n
        endif

    config BSP_USING_USBH
        bool "Enable USBH"
        default n
        select RT_USING_USB_HOST

    config BSP_USING_ETH
        bool "Enable ETH"
        default n
        select RT_USING_LWIP

endmenu

endmenu
```

## bsp/wch/arm/libraries/Kconfig
```kconfig
config SOC_ARM_FAMILY_CH32
    bool

config SOC_ARM_SERIES_CH32F103
    bool
    select ARCH_ARM_CORTEX_M3
    select SOC_ARM_FAMILY_CH32

config SOC_ARM_SERIES_CH32F203
    bool
    select ARCH_ARM_CORTEX_M3
    select SOC_ARM_FAMILY_CH32

config SOC_ARM_SERIES_CH32F205
    bool
    select ARCH_ARM_CORTEX_M3
    select SOC_ARM_FAMILY_CH32

config SOC_ARM_SERIES_CH32F207
    bool
    select ARCH_ARM_CORTEX_M3
    select SOC_ARM_FAMILY_CH32
```

## bsp/wch/risc-v/Libraries/Kconfig
```kconfig
config SOC_RISCV_FAMILY_CH32
    bool

config SOC_RISCV_SERIES_CH32V1
    bool
    select ARCH_RISCV
    select SOC_RISCV_FAMILY_CH32
    select RT_USING_HW_ATOMIC

config SOC_RISCV_SERIES_CH32V2
    bool
    select ARCH_RISCV
    select SOC_RISCV_FAMILY_CH32
    select RT_USING_HW_ATOMIC

config SOC_RISCV_SERIES_CH32V3
    bool
    select ARCH_RISCV
    select SOC_RISCV_FAMILY_CH32
    select RT_USING_HW_ATOMIC

config SOC_FAMILY_CH56X
    bool
    select ARCH_RISCV
    select RT_USING_HW_ATOMIC

config SOC_SERIES_CH569
    bool
    select SOC_FAMILY_CH56X
    select RT_USING_HW_ATOMIC
```

## bsp/wch/risc-v/ch32v103r-evt/board/Kconfig
```kconfig
menu "Hardware Drivers Config"

config SOC_CH32V103R8
    bool
    select SOC_RISCV_SERIES_CH32V1
    select RT_USING_COMPONENTS_INIT
    select RT_USING_USER_MAIN
    default y

menu "On-chip Peripheral Drivers"

config BSP_USING_UART
    bool "using onchip usart"
    select RT_USING_SERIAL
    default n

    if BSP_USING_UART
        config BSP_USING_UART1
        bool "using uart1"
        default n
    endif
endmenu

menu "Onboard Peripheral Drivers"

endmenu

menu "Board extended module Drivers"

endmenu

endmenu
```
