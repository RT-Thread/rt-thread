## bsp/allwinner/avaota-f2-e907/Kconfig
```kconfig
mainmenu "RT-Thread Project Configuration"

BSP_DIR := .

RTT_DIR := ../../..

PKGS_DIR := packages

source "$(RTT_DIR)/Kconfig"
osource "$PKGS_DIR/Kconfig"

config BOARD_AVAOTA_F2_E907
    bool
    select ARCH_RISCV32
    select RT_USING_COMPONENTS_INIT
    select RT_USING_USER_MAIN
    select RT_USING_HW_ATOMIC
    default y

config RT_CPUS_NR
    int
    default 1

config __STACKSIZE__
    int "stack size for interrupt"
    default 8192
```

## bsp/allwinner/avaota-f2/Kconfig
```kconfig
mainmenu "RT-Thread Project Configuration"

BSP_DIR := .

RTT_DIR := ../../..

PKGS_DIR := packages

source "$(RTT_DIR)/Kconfig"
osource "$PKGS_DIR/Kconfig"

config BOARD_AVAOTA_F2_C907
    bool
    select ARCH_RISCV32
    select RT_USING_COMPONENTS_INIT
    select RT_USING_USER_MAIN
    select RT_USING_HW_ATOMIC
    default y

config RT_CPUS_NR
    int
    default 2

config __STACKSIZE__
    int "stack size for interrupt"
    default 8192
    help
        Must match __STACKSIZE__ in link.lds and STACK_SIZE in board/startup_gcc.S (8192).
```

## bsp/gd32/arm/gd32h77d-ginopi/Kconfig
```kconfig
mainmenu "RT-Thread Configuration"

BSP_DIR := .

RTT_DIR := ../../../..

PKGS_DIR := packages

source "$(RTT_DIR)/Kconfig"

# Board defaults must precede the package defaults.
config GD32VW553_SAMPLE_RESET_PIN
    int
    default 37 if BSP_USING_GD32VW553_AT # PC5: 2 * 16 + 5

osource "$PKGS_DIR/Kconfig"
rsource "../libraries/Kconfig"

if !RT_USING_NANO
rsource "board/Kconfig"
rsource "applications/Kconfig"
endif
```

## bsp/renesas/rh850/libraries/Kconfig
```kconfig
config SOC_FAMILY_RENESAS_RH850
    bool

config SOC_SERIES_RH850_U2C
    bool
    select SOC_FAMILY_RENESAS_RH850

config BSP_USING_UART
    bool "Enable the RLIN3 serial driver"
    depends on RT_USING_SERIAL_V1
    default y
```

## components/drivers/serial/Kconfig
```kconfig
menuconfig RT_USING_SERIAL
    bool "Using Serial device drivers"
    select RT_USING_DEVICE_IPC
    select RT_USING_DEVICE
    default y

    if RT_USING_SERIAL
        choice RT_USING_SERIAL_VERSION
            prompt "Choice Serial version"
            default RT_USING_SERIAL_V1
            config RT_USING_SERIAL_V1
                bool "RT_USING_SERIAL_V1"
            config RT_USING_SERIAL_V2
                bool "RT_USING_SERIAL_V2"
                help
                    Enable the Serial V2 device driver framework, which unifies
                    polling, interrupt, and DMA transfers behind blocking and
                    non-blocking I/O modes (RT_SERIAL_RX_BLOCKING /
                    RT_SERIAL_RX_NON_BLOCKING and RT_SERIAL_TX_BLOCKING /
                    RT_SERIAL_TX_NON_BLOCKING).

                    When enabled, the build compiles dev_serial_v2.c and includes
                    drivers/dev_serial_v2.h instead of the V1 implementation.
                    Buffer sizes are configured per device via rx_bufsz and
                    tx_bufsz in struct serial_configure (allocated dynamically on
                    open when non-zero, or using polling when set to 0), and
                    RX ringbuffer overflow handling is controlled by
                    RT_USING_SERIAL_MODE.

                    Requires RT_USING_SERIAL (with RT_USING_DEVICE and
                    RT_USING_DEVICE_IPC), RT_USING_HEAP when buffered RX/TX is
                    used, and a BSP UART driver adapted to Serial V2
                    rt_uart_ops (including a valid transmit callback).

                    Mutually exclusive with RT_USING_SERIAL_V1 and disables the
                    global RT_SERIAL_RB_BUFSZ option. Applications and BSP
                    drivers written for legacy V1 open flags
                    (RT_DEVICE_FLAG_INT_RX/TX, RT_DEVICE_FLAG_DMA_RX/TX) are
                    incompatible without adaptation.
        endchoice

        choice RT_USING_SERIAL_MODE
            prompt "Choice Serial version"
            depends on RT_USING_SERIAL_V2
            default RT_SERIAL_BUF_STRATEGY_OVERWRITE
            config RT_SERIAL_BUF_STRATEGY_DROP
                bool "drop new incoming data when the buffer is full"
            config RT_SERIAL_BUF_STRATEGY_OVERWRITE
                bool "overwrite old data when the buffer is full"
        endchoice

        config RT_SERIAL_USING_DMA
            bool "Enable serial DMA mode"
            default y

        config RT_SERIAL_RB_BUFSZ
            int "Set RX buffer size"
            depends on !RT_USING_SERIAL_V2
            default 64
        config RT_USING_SERIAL_BYPASS
            bool "Using serial bypass"
            default n
        endif

if RT_USING_DM && RT_USING_SERIAL
    rsource "device/Kconfig"
endif
```
