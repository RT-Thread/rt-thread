## bsp/imxrt1052-evk/Kconfig
```kconfig
mainmenu "RT-Thread Configuration"

config $BSP_DIR
    string
    option env="BSP_ROOT"
    default "."

config $RTT_DIR
    string
    option env="RTT_ROOT"
    default "../.."

config $PKGS_DIR
    string
    option env="PKGS_ROOT"
    default "packages"

source "$RTT_DIR/Kconfig"
source "$PKGS_DIR/Kconfig"

config SOC_IMXRT1052
    bool 
    select ARCH_ARM_CORTEX_M7
    default y

# RT1050 board select!
choice
    prompt "RT1050 Board select"
    default BOARD_RT1050_EVK
    config BOARD_RT1050_EVK
        bool "RT1050_EVK"
    config BOARD_RT1050_FIRE
        bool "RT1050_FIRE"
endchoice

menu "RT1050 Bsp Config" 

menu "Select uart drivers"
    config RT_USING_UART1
        bool "Using uart1"
        select RT_USING_SERIAL
        default y 
    config RT_USING_UART2
        bool "Using uart2"
        select RT_USING_SERIAL
        default n 
    config RT_USING_UART3
        bool "Using uart3"
        select RT_USING_SERIAL
        default n 
    config RT_USING_UART4
        bool "Using uart4"
        select RT_USING_SERIAL
        default n 
    config RT_USING_UART5
        bool "Using uart5"
        select RT_USING_SERIAL
        default n 
    config RT_USING_UART6
        bool "Using uart6"
        select RT_USING_SERIAL
        default n 
    config RT_USING_UART7
        bool "Using uart7"
        select RT_USING_SERIAL
        default n 
    config RT_USING_UART8
        bool "Using uart8"
        select RT_USING_SERIAL
        default n 
endmenu

menu "Select spi bus drivers"
    choice 
        prompt "SPI bus clock source"
        default LPSPI_CLK_SOURCE_FROM_PLL3PFD1

        config LPSPI_CLK_SOURCE_FROM_PLL3PFD1
            bool "PLL3PFD1"
        config LPSPI_CLK_SOURCE_FROM_PLL3PFD0
            bool "PLL3PFD0"
        config LPSPI_CLK_SOURCE_FROM_PLL2
            bool "PLL2"
        config LPSPI_CLK_SOURCE_FROM_PLL2PFD2
            bool "PLL2PFD2"
    endchoice
    config LPSPI_CLK_SOURCE
        int
        default 0 if LPSPI_CLK_SOURCE_FROM_PLL3PFD1
        default 1 if LPSPI_CLK_SOURCE_FROM_PLL3PFD0
        default 2 if LPSPI_CLK_SOURCE_FROM_PLL2
        default 3 if LPSPI_CLK_SOURCE_FROM_PLL2PFD2

    config LPSPI_CLK_SOURCE_DIVIDER
        int "SPI bus clock source divider"
        range 0 8
        default 7

    config RT_USING_SPIBUS1
        bool "Using spi1 bus"
        select RT_USING_SPI
        default n 
    choice
        prompt "spi1 bus sck io choice"
        default LPSPI1_SCK_GPIO_1
        depends on RT_USING_SPIBUS1
        config LPSPI1_SCK_GPIO_1
            bool "GPIO_EMC_27"
        config LPSPI1_SCK_GPIO_2
            bool "GPIO_SD_B0_00"
    endchoice
    choice
        prompt "spi1 bus sdo io choice"
        default LPSPI1_SDO_GPIO_1
        depends on RT_USING_SPIBUS1
        config LPSPI1_SDO_GPIO_1
            bool "GPIO_EMC_28"
        config LPSPI1_SDO_GPIO_2
            bool "GPIO_SD_B0_02"
    endchoice
    choice
        prompt "spi1 bus sdi io choice"
        default LPSPI1_SDI_GPIO_1
        depends on RT_USING_SPIBUS1
        config LPSPI1_SDI_GPIO_1
            bool "GPIO_EMC_29"
        config LPSPI1_SDI_GPIO_2
            bool "GPIO_SD_B0_03"
    endchoice

    config RT_USING_SPIBUS2
        bool "Using spi2 bus"
        select RT_USING_SPI
        default n 
    choice
        prompt "spi2 bus sck io choice"
        default LPSPI2_SCK_GPIO_1
        depends on RT_USING_SPIBUS2
        config LPSPI2_SCK_GPIO_1
            bool "GPIO_SD_B1_07"
        config LPSPI2_SCK_GPIO_2
            bool "GPIO_EMC_00"
    endchoice
    choice
        prompt "spi2 bus sdo io choice"
        default LPSPI2_SDO_GPIO_1
        depends on RT_USING_SPIBUS2
        config LPSPI2_SDO_GPIO_1
            bool "GPIO_SD_B1_08"
        config LPSPI2_SDO_GPIO_2
            bool "GPIO_EMC_02"
    endchoice
    choice
        prompt "spi2 bus sdi io choice"
        default LPSPI2_SDI_GPIO_1
        depends on RT_USING_SPIBUS2
        config LPSPI2_SDI_GPIO_1
            bool "GPIO_SD_B1_09"
        config LPSPI2_SDI_GPIO_2
            bool "GPIO_EMC_03"
    endchoice

    config RT_USING_SPIBUS3
        bool "Using spi3 bus"
        select RT_USING_SPI
        default n 
    choice
        prompt "spi3 bus sck io choice"
        default LPSPI3_SCK_GPIO_1
        depends on RT_USING_SPIBUS3
        config LPSPI3_SCK_GPIO_1
            bool "GPIO_AD_B1_15"
        config LPSPI3_SCK_GPIO_2
            bool "GPIO_AD_B0_00"
    endchoice
    choice
        prompt "spi3 bus sdo io choice"
        default LPSPI3_SDO_GPIO_1
        depends on RT_USING_SPIBUS3
        config LPSPI3_SDO_GPIO_1
            bool "GPIO_AD_B1_14"
        config LPSPI3_SDO_GPIO_2
            bool "GPIO_AD_B0_01"
    endchoice
    choice
        prompt "spi3 bus sdi io choice"
        default LPSPI3_SDI_GPIO_1
        depends on RT_USING_SPIBUS3
        config LPSPI3_SDI_GPIO_1
            bool "GPIO_AD_B1_13"
        config LPSPI3_SDI_GPIO_2
            bool "GPIO_AD_B0_02"
    endchoice

    config RT_USING_SPIBUS4
        bool "Using spi4 bus"
        select RT_USING_SPI
        default y 
    choice
        prompt "spi4 bus sck io choice"
        default LPSPI4_SCK_GPIO_1
        depends on RT_USING_SPIBUS4
        config LPSPI4_SCK_GPIO_1
            bool "GPIO_B0_03"
        config LPSPI4_SCK_GPIO_2
            bool "GPIO_B1_07"
    endchoice
    choice
        prompt "spi4 bus sdo io choice"
        default LPSPI4_SDO_GPIO_1
        depends on RT_USING_SPIBUS4
        config LPSPI4_SDO_GPIO_1
            bool "GPIO_B0_02"
        config LPSPI4_SDO_GPIO_2
            bool "GPIO_B1_06"
    endchoice
    choice
        prompt "spi4 bus sdi io choice"
        default LPSPI4_SDI_GPIO_1
        depends on RT_USING_SPIBUS4
        config LPSPI4_SDI_GPIO_1
            bool "GPIO_B0_01"
        config LPSPI4_SDI_GPIO_2
            bool "GPIO_B1_05"
    endchoice
endmenu

#menu "SDRAM driver support"
    config RT_USING_SDRAM
        bool "Using sdram"
        default y 
#endmenu

#menu "RTC driver support"
    config RT_USING_RTC_HP
        bool "Using hp rtc"
        select RT_USING_RTC
        default n 
#endmenu

if BOARD_RT1050_EVK
if RT_USING_USB_DEVICE
    choice
        prompt "select usb device controller"
        default RT_USING_EHCI0_AS_DEVICE

        config RT_USING_EHCI0_AS_DEVICE
            bool "set EHCI0 as device"
        config RT_USING_EHCI1_AS_DEVICE
            bool "set EHCI1 as device"
    endchoice
endif
endif

endmenu
```

## bsp/juicevm/Kconfig
```kconfig
mainmenu "RT-Thread Project Configuration"

BSP_DIR := .

RTT_DIR := ../..

PKGS_DIR := packages

source "$(RTT_DIR)/Kconfig"
osource "$PKGS_DIR/Kconfig"

config SOC_JUICEVM_RV64
    bool
    select ARCH_RISCV64

config BOARD_RV64_FRDM_JUICEVM
    bool
    select SOC_JUICEVM_RV64
    select RT_USING_COMPONENTS_INIT
    select RT_USING_USER_MAIN
    default y

rsource "driver/Kconfig"

config __STACKSIZE__
    int
    default 4096
```

## bsp/k210/Kconfig
```kconfig
mainmenu "RT-Thread Project Configuration"

BSP_DIR := .

RTT_DIR := ../..

PKGS_DIR := packages

source "$(RTT_DIR)/Kconfig"
osource "$PKGS_DIR/Kconfig"
rsource "drivers/Kconfig"

config __STACKSIZE__
    int "stack size for interrupt"
    default 4096
```

## bsp/k210/driver/Kconfig
```kconfig
config BSP_USING_UART_HS
    bool "Enable High Speed UART"
    default y

menu "General Purpose UARTs"

menuconfig BSP_USING_UART1
    bool "Enable UART1"
    default n
    if BSP_USING_UART1
        config BSP_UART1_TXD_PIN
            int "uart1 TXD pin number"
            default 20
        config BSP_UART1_RXD_PIN
            int "uart1 RXD pin number"
            default 21
    endif

menuconfig BSP_USING_UART2
    bool "Enable UART2"
    default n
    if BSP_USING_UART2
        config BSP_UART2_TXD_PIN
            int "uart2 TXD pin number"
            default 28
        config BSP_UART2_RXD_PIN
            int "uart2 RXD pin number"
            default 27
    endif

menuconfig BSP_USING_UART3
    bool "Enable UART3"
    default n
    if BSP_USING_UART3
        config BSP_UART3_TXD_PIN
            int "uart3 TXD pin number"
            default 22
        config BSP_UART3_RXD_PIN
            int "uart3 RXD pin number"
            default 23
    endif
endmenu

config BSP_USING_I2C1
    bool "Enable I2C1 (GPIO0/1)"
    select RT_USING_I2C
    default n

menuconfig BSP_USING_SPI1
    bool "Enable SPI1"
    select RT_USING_SPI
    default n
if BSP_USING_SPI1
    config BSP_USING_SPI1_AS_QSPI
        bool
        default n
    config BSP_SPI1_CLK_PIN
        int "spi1 clk pin number"
        default 29
    config BSP_SPI1_D0_PIN
        int "spi1 d0 pin number"
        default 30
    config BSP_SPI1_D1_PIN
        int "spi1 d1 pin number"
        default 31
    if BSP_USING_SPI1_AS_QSPI
        config BSP_SPI1_D2_PIN
            int "spi1 d2 pin number"
            default 32
        config BSP_SPI1_D3_PIN
            int "spi1 d3 pin number"
            default 33
    endif
    menuconfig BSP_SPI1_USING_SS0
        bool "SPI1 Enable SS0"
        default n
    if BSP_SPI1_USING_SS0
        config BSP_SPI1_SS0_PIN
            int "spi1 ss0 pin number"
            default 32
    endif
    menuconfig BSP_SPI1_USING_SS1
        bool "SPI1 Enable SS1"
        default n
    if BSP_SPI1_USING_SS1
        config BSP_SPI1_SS1_PIN
            int "spi1 ss1 pin number"
            default 25
    endif
    menuconfig BSP_SPI1_USING_SS2
        bool "SPI1 Enable SS2"
        default n
    if BSP_SPI1_USING_SS2
        config BSP_SPI1_SS2_PIN
            int "spi1 ss2 pin number"
            default 26
    endif
    menuconfig BSP_SPI1_USING_SS3
        bool "SPI1 Enable SS3"
        default n
    if BSP_SPI1_USING_SS3
        config BSP_SPI1_SS3_PIN
            int "spi1 ss3 pin number"
            default 27
    endif
endif

menuconfig BSP_USING_LCD
    bool "Enable LCD on SPI0"
    default n

if BSP_USING_LCD
    config BSP_LCD_CS_PIN
        int "CS pin number of 8080 interface"
        default 6
    config BSP_LCD_WR_PIN
        int "WR pin number of 8080 interface"
        default 7
    config BSP_LCD_DC_PIN
        int "DC pin number of 8080 interface"
        default 8
    config BSP_LCD_X_MAX
        int "LCD Height"
        default 240
    config BSP_LCD_Y_MAX
        int "LCD Width"
        default 320
endif


menuconfig BSP_USING_CAMERA
    bool "Enable Camera"
    default n

if BSP_USING_CAMERA
    config BSP_CAMERA_SCCB_SDA_PIN
        int "SCCB SDA pin number for camera"
        default 9
    config BSP_CAMERA_SCCB_SCLK_PIN
        int "SCCB SCLK pin number for camera"
        default 10
    config BSP_CAMERA_CMOS_RST_PIN
        int "CMOS RST pin number for camera"
        default 11
    config BSP_CAMERA_CMOS_VSYNC_PIN
        int "CMOS VSYNC pin number for camera"
        default 12
    config BSP_CAMERA_CMOS_PWDN_PIN
        int "CMOS PWDN pin number for camera"
        default 13
    config BSP_CAMERA_CMOS_XCLK_PIN
        int "CMOS XCLK pin number for camera"
        default 14
    config BSP_CAMERA_CMOS_PCLK_PIN
        int "CMOS PCLK pin number for camera"
        default 15
    config BSP_CAMERA_CMOS_HREF_PIN
        int "CMOS HREF pin number for camera"
        default 17
endif
```

## bsp/k230/Kconfig
```kconfig
mainmenu "RT-Thread Project Configuration"

BSP_DIR := .

RTT_DIR := ../../

PKGS_DIR := packages

source "$RTT_DIR/Kconfig"
source "$PKGS_DIR/Kconfig"
rsource "board/Kconfig"

choice
    prompt "SoC variant"
    default SOC_K230

config SOC_K230
    bool "K230"
    select ARCH_RISCV64
    select RT_USING_COMPONENTS_INIT
    select RT_USING_USER_MAIN
    select RT_USING_CACHE
    select ARCH_MM_MMU
    select ARCH_RISCV_FPU
    select ARCH_RISCV_XUANTIE
    select ARCH_REMAP_KERNEL if RT_USING_SMART

config SOC_K230D
    bool "K230D (128MB DDR)"
    select ARCH_RISCV64
    select RT_USING_COMPONENTS_INIT
    select RT_USING_USER_MAIN
    select RT_USING_CACHE
    select ARCH_MM_MMU
    select ARCH_RISCV_FPU
    select ARCH_RISCV_XUANTIE
    select ARCH_REMAP_KERNEL if RT_USING_SMART
endchoice

config BOARD_C908
    bool
    default y

config __STACKSIZE__
    int "stack size for interrupt"
    default 4096

choice BSP_ROOTFS_TYPE
    prompt "Root File-System type"
    default BSP_ROOTFS_TYPE_ELMFAT

    config BSP_ROOTFS_TYPE_ELMFAT
        bool "Use Elm-chan FAT File-System"
        select RT_USING_DFS_ELMFAT

    config BSP_ROOTFS_TYPE_CROMFS
        bool "Use Compressed ROM File-System (ReadOnly)"
        select RT_USING_DFS_CROMFS
        select PKG_USING_ZLIB
endchoice

choice BSP_RISCV_USING_FPU
    prompt "FPU precision"
    default BSP_RISCV_FPU_D

    config BSP_RISCV_FPU_SOFT
        bool "Software floating-point"
        select ARCH_RISCV_FPU

    config BSP_RISCV_FPU_D
        bool "Double-precision floating-point with Vector"
        select ARCH_RISCV_FPU_D
        select ARCH_RISCV_VECTOR
endchoice
```
