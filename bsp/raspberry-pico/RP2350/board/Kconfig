## bsp/renesas/ra4m1-ek/board/Kconfig
```kconfig
menu "Hardware Drivers Config"

    config SOC_R7FA4M1AB
        bool
        select SOC_SERIES_R7FA4M1
        select RT_USING_COMPONENTS_INIT
        select RT_USING_USER_MAIN
        default y

    menu "Onboard Peripheral Drivers"

        menuconfig BSP_USING_FS
            bool "Enable filesystem"
            default n
            if BSP_USING_FS
                config BSP_USING_SPICARD_FS
                    bool "Enable SPI FLASH filesystem"
                    select BSP_USING_SCI
                    select BSP_USING_SCI9
                    select BSP_USING_SCI9_SPI
                    select RT_USING_SPI_MSD
                    select RT_USING_DFS_ELMFAT
                    default n
            endif

    endmenu

    menu "On-chip Peripheral Drivers"

        rsource "../../libraries/HAL_Drivers/drivers/Kconfig"

        menuconfig BSP_USING_UART
            bool "Enable UART"
            default y
            select RT_USING_SERIAL
            select RT_USING_SERIAL_V2
            if BSP_USING_UART

                menuconfig BSP_USING_UART0
                    bool "Enable UART0"
                    default y
                    if BSP_USING_UART0
                        config BSP_UART0_RX_USING_DMA
                            bool "Enable UART0 RX DMA"
                            depends on BSP_USING_UART0 && RT_SERIAL_USING_DMA
                            default n

                        config BSP_UART0_TX_USING_DMA
                            bool "Enable UART0 TX DMA"
                            depends on BSP_USING_UART0 && RT_SERIAL_USING_DMA
                            default n

                        config BSP_UART0_RX_BUFSIZE
                            int "Set UART0 RX buffer size"
                            range 64 65535
                            depends on RT_USING_SERIAL_V2
                            default 256

                        config BSP_UART0_TX_BUFSIZE
                            int "Set UART0 TX buffer size"
                            range 0 65535
                            depends on RT_USING_SERIAL_V2
                            default 0
                    endif
            endif

        menuconfig BSP_USING_SPI
                bool "Enable SPI"
                default n
                select RT_USING_SPI
                if BSP_USING_SPI
                    config BSP_USING_SPI0
                        bool "Enable SPI0 BUS"
                        default n

                    config BSP_USING_SPI1
                        bool "Enable SPI1 BUS"
                        default n
                endif
        
        menuconfig BSP_USING_HW_I2C
                bool "Enable I2C"
                default n
                select RT_USING_I2C
                select BSP_USING_HW_I2C0
                if BSP_USING_HW_I2C
                    config BSP_USING_HW_I2C0
                        bool "Enable I2C0 BUS"
                        default n
                endif

        menuconfig BSP_USING_ADC
            bool "Enable ADC"
            default n
            select RT_USING_ADC
            if BSP_USING_ADC
                config BSP_USING_ADC0
                    bool "Enable ADC0"
                    default n
            endif

        menuconfig BSP_USING_TIM
            bool "Enable timer"
            default n
            select RT_USING_HWTIMER
            if BSP_USING_TIM
                config BSP_USING_TIM0
                    bool "Enable TIM0"
                    default n
                config BSP_USING_TIM1
                    bool "Enable TIM1"
                    default n
        endif

        menuconfig BSP_USING_DAC
            bool "Enable DAC"
            default n
            select RT_USING_DAC
            if BSP_USING_DAC
                config BSP_USING_DAC0
                    bool "Enable DAC0"
                    default n
            endif

        menuconfig BSP_USING_PWM
            bool "Enable PWM"
            default n
            select RT_USING_PWM
            if BSP_USING_PWM
                config BSP_USING_PWM0
                    bool "Enable GPT0 (32-Bits) output PWM"
                    default n
            endif

        menuconfig BSP_USING_CAN
            bool "Enable CAN"
            default n
            select RT_USING_CAN
            if BSP_USING_CAN
                config BSP_USING_CAN0
                    bool "Enable CAN0"
                    default n
            endif

        endmenu
        
    menu "Board extended module Drivers"

    endmenu

endmenu
```
