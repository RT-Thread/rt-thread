## bsp/gd32/arm/gd32e230-lckfb/board/Kconfig
```kconfig
# SPDX-License-Identifier: Apache-2.0

menu "Hardware Drivers Config"

config SOC_SERIES_GD32E23x
    bool
    default y

config SOC_GD32E230C8
    bool
    select SOC_SERIES_GD32E23x
    select RT_USING_COMPONENTS_INIT
    select RT_USING_USER_MAIN
    default y

menu "Onboard Peripheral Drivers"
    menuconfig BSP_USING_LED
        bool "Enable Onboard LED"
        default y
        if BSP_USING_LED
            config BSP_LED_PIN
                int "The pin number of the onboard LED"
                default 45 # GET_PIN(C, 13)
        endif

endmenu

menu "On-chip Peripheral Drivers"

    config BSP_USING_GPIO
        bool "Enable GPIO"
        select RT_USING_PIN
        default y

    menuconfig BSP_USING_UART
        bool "Enable UART"
        default y
        if BSP_USING_UART
            choice
                prompt "Select UART framework version"
                default BSP_USING_SERIAL_V1
                
                config BSP_USING_SERIAL_V1
                    bool "Use Serial V1 framework"
                    select RT_USING_SERIAL
                    
                config BSP_USING_SERIAL_V2
                    bool "Use Serial V2 framework"
                    select RT_USING_SERIAL_V2
            endchoice

            menuconfig BSP_USING_UART0
                bool "Enable UART0"
                default y
                if BSP_USING_UART0
                    config BSP_UART0_TX_PIN
                        string "UART0 TX name, such as PA8"
                        default "PA9"
                        
                    config BSP_UART0_RX_PIN
                        string "UART0 RX name, such as PA9"
                        default "PA10"
                        
                    config BSP_UART0_AFIO
                        string "UART0 alternate function, such as AF7"
                        default "AF1"
                        
                    if BSP_USING_SERIAL_V2
                        config BSP_UART0_RX_USING_DMA
                            bool "Enable UART0 RX DMA"
                            depends on RT_SERIAL_USING_DMA
                            default n

                        config BSP_UART0_TX_USING_DMA
                            bool "Enable UART0 TX DMA"
                            depends on RT_SERIAL_USING_DMA
                            default n

                        config BSP_UART0_DMA_PING_BUFSIZE
                            int "Set UART0 RX DMA ping-pong buffer size"
                            range 16 65535
                            depends on BSP_UART0_RX_USING_DMA
                            default 64

                        config BSP_UART0_RX_BUFSIZE
                            int "Set UART0 RX buffer size"
                            range 64 65535
                            default 128

                        config BSP_UART0_TX_BUFSIZE
                            int "Set UART0 TX buffer size"
                            range 0 65535
                            default 128
                    endif
                endif

            menuconfig BSP_USING_UART1
                bool "Enable UART1"
                default n
                if BSP_USING_UART1
                    config BSP_UART1_TX_PIN
                        string "UART1 TX name, such as PA8"
                        default "PA8"
                        
                    config BSP_UART1_RX_PIN
                        string "UART1 RX name, such as PA9"
                        default "PA9"
                        
                    config BSP_UART1_AFIO
                        string "UART1 alternate function, such as AF7"
                        default "AF7"
                        
                    if BSP_USING_SERIAL_V2
                        config BSP_UART1_RX_USING_DMA
                            bool "Enable UART1 RX DMA"
                            depends on RT_SERIAL_USING_DMA
                            default n

                        config BSP_UART1_TX_USING_DMA
                            bool "Enable UART1 TX DMA"
                            depends on RT_SERIAL_USING_DMA
                            default n

                        config BSP_UART1_DMA_PING_BUFSIZE
                            int "Set UART1 RX DMA ping-pong buffer size"
                            range 16 65535
                            depends on BSP_UART1_RX_USING_DMA
                            default 64

                        config BSP_UART1_RX_BUFSIZE
                            int "Set UART1 RX buffer size"
                            range 64 65535
                            default 128

                        config BSP_UART1_TX_BUFSIZE
                            int "Set UART1 TX buffer size"
                            range 0 65535
                            default 128
                    endif
                endif

            menuconfig BSP_USING_UART2
                bool "Enable UART2"
                default n
                if BSP_USING_UART2
                    config BSP_UART2_TX_PIN
                        string "UART2 TX name, such as PA8"
                        default "PA8"
                        
                    config BSP_UART2_RX_PIN
                        string "UART2 RX name, such as PA9"
                        default "PA9"
                        
                    config BSP_UART2_AFIO
                        string "UART2 alternate function, such as AF7"
                        default "AF7"
                        
                    if BSP_USING_SERIAL_V2
                        config BSP_UART2_RX_USING_DMA
                            bool "Enable UART2 RX DMA"
                            depends on RT_SERIAL_USING_DMA
                            default n

                        config BSP_UART2_TX_USING_DMA
                            bool "Enable UART2 TX DMA"
                            depends on RT_SERIAL_USING_DMA
                            default n

                        config BSP_UART2_DMA_PING_BUFSIZE
                            int "Set UART2 RX DMA ping-pong buffer size"
                            range 16 65535
                            depends on BSP_UART2_RX_USING_DMA
                            default 64

                        config BSP_UART2_RX_BUFSIZE
                            int "Set UART2 RX buffer size"
                            range 64 65535
                            default 128

                        config BSP_UART2_TX_BUFSIZE
                            int "Set UART2 TX buffer size"
                            range 0 65535
                            default 128
                    endif
                endif

            menuconfig BSP_USING_UART3
                bool "Enable UART3"
                default n
                if BSP_USING_UART3
                    config BSP_UART3_TX_PIN
                        string "UART3 TX name, such as PA8"
                        default "PA8"
                        
                    config BSP_UART3_RX_PIN
                        string "UART3 RX name, such as PA9"
                        default "PA9"
                        
                    config BSP_UART3_AFIO
                        string "UART3 alternate function, such as AF7"
                        default "AF7"
                        
                    if BSP_USING_SERIAL_V2
                        config BSP_UART3_RX_USING_DMA
                            bool "Enable UART3 RX DMA"
                            depends on RT_SERIAL_USING_DMA
                            default n

                        config BSP_UART3_TX_USING_DMA
                            bool "Enable UART3 TX DMA"
                            depends on RT_SERIAL_USING_DMA
                            default n

                        config BSP_UART3_DMA_PING_BUFSIZE
                            int "Set UART3 RX DMA ping-pong buffer size"
                            range 16 65535
                            depends on BSP_UART3_RX_USING_DMA
                            default 64

                        config BSP_UART3_RX_BUFSIZE
                            int "Set UART3 RX buffer size"
                            range 64 65535
                            default 128

                        config BSP_UART3_TX_BUFSIZE
                            int "Set UART3 TX buffer size"
                            range 0 65535
                            default 128
                    endif
                endif
        endif

    menuconfig BSP_USING_SPI
        bool "Enable SPI"
        select RT_USING_SPI
        default n
        if BSP_USING_SPI
            config BSP_USING_SPI0
                bool "Enable SPI0"
                default n
            
            config BSP_SPI0_TX_USING_DMA
                bool "Enable SPI0 TX DMA"
                depends on BSP_USING_SPI0
                default n

            config BSP_SPI0_RX_USING_DMA
                bool "Enable SPI0 RX DMA"
                depends on BSP_USING_SPI0
                default n

            config BSP_USING_SPI1
                bool "Enable SPI1"
                default n

            config BSP_SPI1_TX_USING_DMA
                bool "Enable SPI1 TX DMA"
                depends on BSP_USING_SPI1
                default n

            config BSP_SPI1_RX_USING_DMA
                bool "Enable SPI1 RX DMA"
                depends on BSP_USING_SPI1
                default n
        endif
    
    menu "I2C Configuration"
        menuconfig BSP_USING_HW_I2C
            bool "Enable Hardware I2C"
            select RT_USING_I2C
            default n
            if BSP_USING_HW_I2C
                config BSP_USING_HW_I2C0
                    bool "Enable I2C0"
                    default y
                
                config BSP_HW_I2C0_CLOCK_SPEED
                    int "I2C0 Clock Speed (Hz)"
                    depends on BSP_USING_HW_I2C0
                    range 100000 1000000
                    default 400000
                    help
                      Set the I2C0 clock speed in Hz.
                      Standard mode: 100000 (100KHz)
                      Fast mode: 400000 (400KHz)
                      Fast mode plus: 1000000 (1MHz)
                
                config BSP_USING_HW_I2C1
                    bool "Enable I2C1"
                    default n
                
                config BSP_HW_I2C1_CLOCK_SPEED
                    int "I2C1 Clock Speed (Hz)"
                    depends on BSP_USING_HW_I2C1
                    range 100000 1000000
                    default 400000
                    help
                      Set the I2C1 clock speed in Hz.
                      Standard mode: 100000 (100KHz)
                      Fast mode: 400000 (400KHz)
                      Fast mode plus: 1000000 (1MHz)
            endif
    endmenu

    menuconfig BSP_USING_ADC
        bool "Enable ADC"
        select RT_USING_ADC
        default n
        if BSP_USING_ADC
            config BSP_USING_ADC0
                bool "Enable ADC"
                default y
        endif

    menuconfig BSP_USING_TIM
        bool "Enable Hardware Timer"
        select RT_USING_HWTIMER
        default n
        if BSP_USING_TIM
            config BSP_USING_TIM2
                bool "Enable TIM2"
                default n

            config BSP_USING_TIM3
                bool "Enable TIM3"
                default n
        endif

    menuconfig BSP_USING_ONCHIP_RTC
        bool "Enable RTC"
        select RT_USING_RTC
        default n
        if BSP_USING_ONCHIP_RTC
            config BSP_USING_ALARM
                bool "Enable RTC alarm"
                select RT_USING_ALARM
                default n
            if BSP_USING_ALARM
                choice
                    prompt "Select rtc alarm device"
                    default BSP_USING_ALARM0

                    config BSP_USING_ALARM0
                        bool "Enable RTC Alarm0"

                    config BSP_USING_ALARM1
                        bool "Enable RTC Alarm1"
                endchoice
            endif
        endif

    config BSP_USING_WDT
        bool "Enable Watchdog Timer"
        select RT_USING_WDT
        default n

    # Source the upstream GD32 drivers Kconfig
    source "$(BSP_DIR)/../libraries/gd32_drivers/Kconfig"

endmenu

menu "Board extended module Drivers"
    # Configuration for external modules connected to the board
endmenu

endmenu
```
