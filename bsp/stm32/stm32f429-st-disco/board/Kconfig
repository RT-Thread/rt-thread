## bsp/stm32/stm32f767-NUCLEO-F767ZI/board/Kconfig
```kconfig
menu "Hardware Drivers Config"

config SOC_STM32F767ZI 
    bool
    select SOC_SERIES_STM32F7
    default y

menu "Onboard Peripheral Drivers"

 config BSP_USING_USB_TO_USART 
        bool "Enable USB TO USART (uart3)"
        select BSP_USING_UART3
        default y
        
    config PHY_USING_LAN8720A
        bool

    config BSP_USING_ETH
        bool "Enable Ethernet"
        select RT_USING_LWIP
        select PHY_USING_LAN8720A
        default n

 
endmenu

menu "On-chip Peripheral Drivers"

    config BSP_USING_GPIO
        bool "Enable GPIO"
        select RT_USING_PIN
        default y

    config BSP_USING_UART3 
        bool "Enable UART3"
        select RT_USING_SERIAL
        default y
    
        config BSP_USING_UART1 
        bool "Enable UART1"
        select RT_USING_SERIAL
        default n

    config BSP_USING_UART2 
        bool "Enable UART2"
        select RT_USING_SERIAL
        default n


endmenu

menu "Board extended module Drivers"

endmenu
 
endmenu
```

## bsp/stm32/stm32f767-atk-apollo/board/Kconfig
```kconfig
menu "Hardware Drivers Config"

config SOC_STM32F767IG
    bool
    select SOC_SERIES_STM32F7
    select RT_USING_COMPONENTS_INIT
    select RT_USING_USER_MAIN
    default y

menu "Onboard Peripheral Drivers"

    config BSP_USING_USB_TO_USART
        bool "Enable USB TO USART (uart1)"
        select BSP_USING_UART
        select BSP_USING_UART1
        default y

    config BSP_USING_RS232
        bool "Enable RS232 (uart2 pin conflict with Ethernet)"
        select BSP_USING_UART
        select BSP_USING_UART2
        default n

    config BSP_USING_SDRAM
        bool "Enable SDRAM"
        default n

    config BSP_USING_QSPI_FLASH
        bool "Enable QSPI FLASH (W25Q256 qspi)"
        select BSP_USING_QSPI
        select RT_USING_SFUD
        select RT_SFUD_USING_QSPI
        default n

    config BSP_USING_MPU9250
        bool "Enable MPU 9250 (i2c2)"
        select BSP_USING_I2C2
        select PKG_USING_MPU6XXX
        default n

    config PHY_USING_LAN8720A
        bool

    config BSP_USING_ETH
        bool "Enable Ethernet"
        select BSP_USING_I2C2
        select PKG_USING_PCF8574
        select RT_USING_LWIP
        select PHY_USING_LAN8720A
        default n

    config BSP_USING_POT
        bool "Enable potentiometer"
        select BSP_USING_ADC
        select BSP_USING_ADC1
        default n

    config BSP_USING_SDCARD
        bool "Enable SDCARD (sdio)"
        select BSP_USING_SDIO
        select RT_USING_DFS
        select RT_USING_DFS_ELMFAT
        default n
    config BSP_USING_LCD
        bool "Enable LCD"
        select BSP_USING_LTDC
        select BSP_USING_SDRAM
        default n

endmenu

menu "On-chip Peripheral Drivers"

    config BSP_USING_GPIO
        bool "Enable GPIO"
        select RT_USING_PIN
        default y

    menuconfig BSP_USING_UART
        bool "Enable UART"
        default y
        select RT_USING_SERIAL
        if BSP_USING_UART
            config BSP_USING_UART1
                bool "Enable UART1"
                default y

            config BSP_UART1_RX_USING_DMA
                bool "Enable UART1 RX DMA"
                depends on BSP_USING_UART1 && RT_SERIAL_USING_DMA
                default n

            config BSP_USING_UART2
                bool "Enable UART2"
                default n

            config BSP_UART2_RX_USING_DMA
                bool "Enable UART2 RX DMA"
                depends on BSP_USING_UART2 && RT_SERIAL_USING_DMA
                default n

        endif

    config BSP_USING_ON_CHIP_FLASH
        bool "Enable on-chip FLASH"
        default n

    menuconfig BSP_USING_SPI
        bool "Enable SPI BUS"
        default n
        select RT_USING_SPI
        if BSP_USING_SPI
            config BSP_USING_SPI2
                bool "Enable SPI2 BUS"
                default n

            config BSP_SPI2_TX_USING_DMA
                bool "Enable SPI2 TX DMA"
                depends on BSP_USING_SPI2
                default n

            config BSP_SPI2_RX_USING_DMA
                bool "Enable SPI2 RX DMA"
                depends on BSP_USING_SPI2
                select BSP_SPI2_TX_USING_DMA
                default n
        endif


    config BSP_USING_QSPI
        bool "Enable QSPI BUS"
        select RT_USING_QSPI
        select RT_USING_SPI
        default n

    config BSP_QSPI_USING_DMA
        bool "Enable QSPI DMA support"
        default n

    menuconfig BSP_USING_TIM
        bool "Enable timer"
        default n
        select RT_USING_HWTIMER
        if BSP_USING_TIM
            config BSP_USING_TIM11
                bool "Enable TIM11"
                default n
        endif

    menuconfig BSP_USING_PWM
        bool "Enable PWM"
        default n
        select RT_USING_PWM
        if BSP_USING_PWM
        menuconfig BSP_USING_PWM3
            bool "Enable timer3 output PWM"
            default n
            if BSP_USING_PWM3
                config BSP_USING_PWM3_CH3
                    bool "Enable PWM3 channel3"
                    default n
            endif
        endif

    menuconfig BSP_USING_ADC
        bool "Enable ADC"
        default n
        select RT_USING_ADC
        if BSP_USING_ADC
            config BSP_USING_ADC1
                bool "Enable ADC1"
                default n
        endif

    menuconfig BSP_USING_I2C1
        bool "Enable I2C1 BUS (software simulation)"
        default n
        select RT_USING_I2C
        select RT_USING_I2C_BITOPS
        select RT_USING_PIN
        if BSP_USING_I2C1
            comment "Notice: PB8 --> 24; PB9 --> 25"
            config BSP_I2C1_SCL_PIN
                int "I2C1 scl pin number"
                range 1 176
                default 24
            config BSP_I2C1_SDA_PIN
                int "I2C1 sda pin number"
                range 1 176
                default 25
        endif

    menuconfig BSP_USING_I2C2
        bool "Enable I2C2 BUS (software simulation)"
        default n
        select RT_USING_I2C
        select RT_USING_I2C_BITOPS
        select RT_USING_PIN
        if BSP_USING_I2C2
            comment "Notice: PH4 --> 116; PH5 --> 117"
            config BSP_I2C2_SCL_PIN
                int "i2c2 scl pin number"
                range 1 176
                default 116
            config BSP_I2C2_SDA_PIN
                int "I2C2 sda pin number"
                range 1 176
                default 117
        endif

    menuconfig BSP_USING_ONCHIP_RTC
        bool "Enable RTC"
        select RT_USING_RTC
        default n
        if BSP_USING_ONCHIP_RTC
            choice
                prompt "Select clock source"
                default BSP_RTC_USING_LSE

                config BSP_RTC_USING_LSE
                    bool "RTC USING LSE"

                config BSP_RTC_USING_LSI
                    bool "RTC USING LSI"
            endchoice
        endif

    config BSP_USING_WDT
        bool "Enable Watchdog Timer"
        select RT_USING_WDT
        default n

    menuconfig BSP_USING_USBH
        bool "Enable USB Host"
        select RT_USING_USB_HOST
        default n
        if BSP_USING_USBH
            menuconfig RT_USBH_MSTORAGE
                bool "Enable Udisk Drivers"
                default n
                if RT_USBH_MSTORAGE
                    config UDISK_MOUNTPOINT
                    string "Udisk mount dir"
                    default "/"
                endif
        endif

    config BSP_USING_SDIO
        bool "Enable SDIO"
        select RT_USING_SDIO
        select RT_USING_DFS
        default n

    config BSP_USING_LTDC
        bool "Enable LTDC"
        default n

 source "../libraries/HAL_Drivers/Kconfig"

endmenu

menu "Board extended module Drivers"

endmenu

endmenu
```

## bsp/stm32/stm32f767-fire-challenger-local/board/Kconfig
```kconfig
menu "Hardware Drivers Config"

config SOC_STM32F767IG
    bool
    select SOC_SERIES_STM32F7
    default y

menu "Onboard Peripheral Drivers"

    config BSP_USING_USB_TO_USART
        bool "Enable USB TO USART (uart1)"
        select BSP_USING_UART1
        default y

    config BSP_USING_RS232
        bool "Enable RS232 (uart2 pin conflict with Ethernet)"
        select BSP_USING_UART2
        default n

    config BSP_USING_SDRAM
        bool "Enable SDRAM"
        select BSP_USING_FMC
        default n

    config BSP_USING_QSPI_FLASH
        bool "Enable QSPI FLASH (W25Q128 qspi1)"
        select BSP_USING_QSPI
        select RT_USING_SFUD
        select RT_SFUD_USING_QSPI
        default n

    config BSP_USING_LCD
        bool "Enable LCD"
        select BSP_USING_LTDC
        select BSP_USING_SDRAM
        default n

    config BSP_USING_MPU6050
        bool "Enable MPU6050 (i2c4)"
        select BSP_USING_I2C4
        select PKG_USING_MPU6XXX
        default n

    config BSP_USING_ETH
        bool "Enable Ethernet"
        default n
        select RT_USING_LWIP
        if BSP_USING_ETH
            config EXTERNAL_PHY_ADDRESS
                hex
                default 0x00
        endif

    config BSP_USING_RGB
        bool "Enable RGB LED (timer5 channel1 - 3)"
        select RT_USING_PWM
        select BSP_USING_PWM
        select BSP_USING_PWM5
        select BSP_USING_PWM5_CH1
        select BSP_USING_PWM5_CH2
        select BSP_USING_PWM5_CH3
        default n    

    config BSP_USING_POT
        bool "Enable potentiometer"
        select BSP_USING_ADC
        select BSP_USING_ADC1
        default n

    config BSP_USING_SDCARD
        bool "Enable SDCARD (sdio)"
        select BSP_USING_SDIO
        select RT_USING_DFS
        select RT_USING_DFS_ELMFAT
        select RT_USING_PIN
        default n

endmenu

menu "On-chip Peripheral Drivers"

    config BSP_USING_GPIO
        bool "Enable GPIO"
        select RT_USING_PIN
        default y

    config BSP_USING_UART1
        bool "Enable UART1"
        select RT_USING_SERIAL
        default y

    config BSP_USING_UART2
        bool "Enable UART2"
        select RT_USING_SERIAL
        default n

    config BSP_USING_UART3
        bool "Enable UART3"
        select RT_USING_SERIAL
        default n

    config BSP_UART_USING_DMA_RX
        bool "Enable UART RX DMA support"
        default n

    config BSP_USING_ON_CHIP_FLASH
        bool "Enable on-chip FLASH"
        default n
        
    config BSP_USING_SPI1
        bool "Enable SPI1 BUS"
        select RT_USING_SPI
        default n

    config BSP_USING_SPI2
        bool "Enable SPI2 BUS"
        select RT_USING_SPI
        default n

    config BSP_USING_SPI5
        bool "Enable SPI5 BUS"
        select RT_USING_SPI
        default n

    config BSP_SPI_USING_DMA
        bool "Enable SPI DMA support"
        default n

    config BSP_USING_QSPI
        bool "Enable QSPI BUS"
        select RT_USING_QSPI
        select RT_USING_SPI
        default n

    menuconfig BSP_USING_TIM
        bool "Enable timer"
        default n
        select RT_USING_HWTIMER
        if BSP_USING_TIM
            config BSP_USING_TIM11
                bool "Enable TIM11"
                default n

            config BSP_USING_TIM13
                bool "Enable TIM13"
                default n

            config BSP_USING_TIM14
                bool "Enable TIM14"
                default n
        endif

    menuconfig BSP_USING_PWM
        bool "Enable pwm"
        default n
        select RT_USING_PWM
        if BSP_USING_PWM
        menuconfig BSP_USING_PWM2
            bool "Enable timer2 output pwm"
            default n
            if BSP_USING_PWM2
                config BSP_USING_PWM2_CH1
                    bool "Enable PWM2 channel1"
                    default n
        endif
        menuconfig BSP_USING_PWM5
            bool "Enable timer5 output pwm"
            default n
            if BSP_USING_PWM5
                config BSP_USING_PWM5_CH1
                    bool "Enable PWM5 channel1"
                    default n

                config BSP_USING_PWM5_CH2
                    bool "Enable PWM5 channel2"
                    default n

                config BSP_USING_PWM5_CH3
                    bool "Enable PWM5 channel3"
                    default n
            endif
        endif
        
    menuconfig BSP_USING_ADC
        bool "Enable ADC"
        default n
        select RT_USING_ADC
        if BSP_USING_ADC
            config BSP_USING_ADC1
                bool "Enable ADC1"
                default n

            config BSP_USING_ADC2
                bool "Enable ADC2"
                default n

            config BSP_USING_ADC3
                bool "Enable ADC3"
                default n
        endif

    menuconfig BSP_USING_I2C2
        bool "Enable I2C2 BUS (software simulation)"
        default n
        select RT_USING_I2C
        select RT_USING_I2C_BITOPS
        select RT_USING_PIN
        if BSP_USING_I2C2
            comment "Notice: PH4 --> 116; PH5 --> 117"
            config BSP_I2C2_SCL_PIN
                int "i2c2 scl pin number"
                range 1 176
                default 116
            config BSP_I2C2_SDA_PIN
                int "I2C2 sda pin number"
                range 1 176
                default 117
        endif

    menuconfig BSP_USING_I2C4
        bool "Enable I2C4 BUS (software simulation)"
        default n
        select RT_USING_I2C
        select RT_USING_I2C_BITOPS
        select RT_USING_PIN
        if BSP_USING_I2C4
            comment "Notice: PD12 --> 60; PD13 --> 61" 
            config BSP_I2C4_SCL_PIN
                int "i2c4 scl pin number"
                range 1 176
                default 60
            config BSP_I2C4_SDA_PIN
                int "I2C4 sda pin number"
                range 1 176
                default 61
        endif

    config BSP_USING_ONCHIP_RTC
        bool "Enable RTC"
        select RT_USING_RTC
        select RT_USING_LIBC
        default n

    config BSP_USING_WDT
        bool "Enable Watchdog Timer"
        select RT_USING_WDT
        default n

    config BSP_USING_SDIO
        bool "Enable SDIO"
        select RT_USING_SDIO
        select RT_USING_DFS
        default n
    
    config BSP_USING_FMC
        bool
        default n

    config BSP_USING_LTDC
        bool
        default n

endmenu

menu "Board extended module Drivers"

    menuconfig BSP_USING_LCD
        bool "Enable LCD"
        default n
        select BSP_USING_SDRAM
        if BSP_USING_LCD
        config PKG_USING_GUIENGINE
            bool "Enable RT GUI"
            default n
        config PKG_USING_NES2RTT_O
            bool "Enable NES"
            default n    
        config PKG_USING_InfoNES2RTT
            bool "Enable InfoNES"
            default n
        config PKG_USING_NESYZ2RTT
            bool "Enable NESYuanZi"
            default n
        endif

    config PKG_USING_BEEPPLAYER
            bool "Enable beep player"
            default n
            select RT_USING_PWM
            select BSP_USING_PWM
            select BSP_USING_PWM2
            select BSP_USING_PWM2_CH1
            if PKG_USING_BEEPPLAYER
                config PKG_USING_BEEPPLAYER_SAMPLE
                bool "Enable beep player sample"
                default y
            endif
            
endmenu

endmenu
```
