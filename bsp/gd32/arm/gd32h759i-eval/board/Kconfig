## bsp/gd32/gd32103c-eval/board/Kconfig
```kconfig
menu "Hardware Drivers Config"

config SOC_SERIES_GD32F10x
    bool
    default y
	
config SOC_GD32103V
    bool
    select SOC_SERIES_GD32F10x
    select RT_USING_COMPONENTS_INIT
    select RT_USING_USER_MAIN
    default y
	
menu "Onboard Peripheral Drivers"

endmenu

menu "On-chip Peripheral Drivers"

    config BSP_USING_GPIO
        bool "Enable GPIO"
        select RT_USING_PIN
        default y

    menuconfig BSP_USING_UART
        bool "Enable UART"
        default y
        select RT_USING_SERIAL
        if BSP_USING_UART
            config BSP_USING_UART0
                bool "Enable UART0"
                default n

            config BSP_UART0_RX_USING_DMA
                bool "Enable UART0 RX DMA"
                depends on BSP_USING_UART0 
                select RT_SERIAL_USING_DMA
                default n

            config BSP_USING_UART1
                bool "Enable UART1"
                default y

            config BSP_UART1_RX_USING_DMA
                bool "Enable UART1 RX DMA"
                depends on BSP_USING_UART1 
                select RT_SERIAL_USING_DMA
                default n

            config BSP_USING_UART2
                bool "Enable UART2"
                default n

            config BSP_UART2_RX_USING_DMA
                bool "Enable UART2 RX DMA"
                depends on BSP_USING_UART2 
                select RT_SERIAL_USING_DMA
                default n

            config BSP_USING_UART3
                bool "Enable UART3"
                default n

            config BSP_UART3_RX_USING_DMA
                bool "Enable UART3 RX DMA"
                depends on BSP_USING_UART3 
                select RT_SERIAL_USING_DMA
                default n

            config BSP_USING_UART4
                bool "Enable UART4"
                default n

            config BSP_UART4_RX_USING_DMA
                bool "Enable UART4 RX DMA"
                depends on BSP_USING_UART4 
                select RT_SERIAL_USING_DMA
                default n
        endif

    menuconfig BSP_USING_SPI
        bool "Enable SPI BUS"
        default n
        select RT_USING_SPI
        if BSP_USING_SPI
            config BSP_USING_SPI1
                bool "Enable SPI1 BUS"
                default n

            config BSP_SPI1_TX_USING_DMA
                bool "Enable SPI1 TX DMA"
                depends on BSP_USING_SPI1
                default n
                
            config BSP_SPI1_RX_USING_DMA
                bool "Enable SPI1 RX DMA"
                depends on BSP_USING_SPI1
                select BSP_SPI1_TX_USING_DMA
                default n
        endif

    menuconfig BSP_USING_I2C1
        bool "Enable I2C1 BUS (software simulation)"
        default n
        select RT_USING_I2C
        select RT_USING_I2C_BITOPS
        select RT_USING_PIN
        if BSP_USING_I2C1
            config BSP_I2C1_SCL_PIN
                int "i2c1 scl pin number"
                range 1 216
                default 24
            config BSP_I2C1_SDA_PIN
                int "I2C1 sda pin number"
                range 1 216
                default 25
        endif

    config BSP_USING_WDT
        bool "Enable Watchdog Timer"
        select RT_USING_WDT
        default n

    config BSP_USING_RTC
        bool "Enable Internal RTC"
        select RT_USING_RTC
        default n

    menuconfig BSP_USING_HWTIMER
        bool "Enable hwtimer"
        default n
        select RT_USING_HWTIMER
        if BSP_USING_HWTIMER
            config BSP_USING_HWTIMER0
                bool "using hwtimer0"
                default n
            config BSP_USING_HWTIMER1
                bool "using hwtimer1"
                default n
            config BSP_USING_HWTIMER2
                bool "using hwtimer2"
                default n
            config BSP_USING_HWTIMER3
                bool "using hwtimer3"
                default n
            config BSP_USING_HWTIMER4
                bool "using hwtimer4"
                default n
            config BSP_USING_HWTIMER5
                bool "using hwtimer5"
                default n
            config BSP_USING_HWTIMER6
                bool "using hwtimer6"
                default n
            config BSP_USING_HWTIMER7
                bool "using hwtimer7"
                default n
        endif

    menuconfig BSP_USING_ADC
        bool "Enable ADC"
        default n
        select RT_USING_ADC
        if BSP_USING_ADC
            config BSP_USING_ADC0
                bool "using adc0"
                default n
            config BSP_USING_ADC1
                bool "using adc1"
                default n
        endif
    source "../libraries/gd32_drivers/Kconfig"

endmenu

menu "Board extended module Drivers"

endmenu

endmenu
```

## bsp/gd32/gd32205/Kconfig
```kconfig
mainmenu "RT-Thread Configuration"

config BSP_DIR
    string
    option env="BSP_ROOT"
    default "."

config RTT_DIR
    string
    option env="RTT_ROOT"
    default "../../.."

# you can change the RTT_ROOT default: "rt-thread"
# example : default "F:/git_repositories/rt-thread"

config PKGS_DIR
    string
    option env="PKGS_ROOT"
    default "packages"

source "$RTT_DIR/Kconfig"
source "$PKGS_DIR/Kconfig"
source "$BSP_DIR/../libraries/Kconfig"

if SOC_SERIES_GD32F2
    config SOC_GD32205Rx
        bool "GD32F205Rx chip"
        select RT_USING_COMPONENTS_INIT
        select RT_USING_USER_MAIN
        default y
endif

config BSP_USING_UART0
    bool "using uart0"
    select RT_USING_SERIAL
    default n
config BSP_USING_UART1
    bool "using uart1"
    select RT_USING_SERIAL
    default n
```

## bsp/gd32/gd32407v-start/Kconfig
```kconfig
mainmenu "RT-Thread Configuration"

config BSP_DIR
    string
    option env="BSP_ROOT"
    default "."

config RTT_DIR
    string
    option env="RTT_ROOT"
    default "../../.."

config PKGS_DIR
    string
    option env="PKGS_ROOT"
    default "packages"
 
menuconfig SOC_SERIES_GD32F4
    bool "gd32f4xx series chip"
#    if SOC_SERIES_GD32F2
#        config SOC_GD32205Rx
#            bool "GD32F205Rx chip"
#            select RT_USING_COMPONENTS_INIT
#            select RT_USING_USER_MAIN
#            default y
#    endif
source "$RTT_DIR/Kconfig"
source "$PKGS_DIR/Kconfig"
source "../libraries/Kconfig"
source "board/Kconfig"
```

## bsp/gd32/gd32450i-eval/board/Kconfig
```kconfig
menu "Hardware Drivers Config"

config SOC_SERIES_GD32F4xx
    bool
    default y

config SOC_GD32450I
    bool
    select SOC_SERIES_GD32F4xx
    select RT_USING_COMPONENTS_INIT
    select RT_USING_USER_MAIN
    default y

menu "Onboard Peripheral Drivers"

endmenu

menu "On-chip Peripheral Drivers"

    config BSP_USING_GPIO
        bool "Enable GPIO"
        select RT_USING_PIN
        default y

    menuconfig BSP_USING_UART
        bool "Enable UART"
        default y
        select RT_USING_SERIAL
        if BSP_USING_UART
            config BSP_USING_UART0
                bool "Enable UART0"
                default n

            config BSP_UART0_RX_USING_DMA
                bool "Enable UART0 RX DMA"
                depends on BSP_USING_UART0
                select RT_SERIAL_USING_DMA
                default n

            config BSP_USING_UART1
                bool "Enable UART1"
                default y

            config BSP_UART1_RX_USING_DMA
                bool "Enable UART1 RX DMA"
                depends on BSP_USING_UART1
                select RT_SERIAL_USING_DMA
                default n

            config BSP_USING_UART2
                bool "Enable UART2"
                default n

            config BSP_UART2_RX_USING_DMA
                bool "Enable UART2 RX DMA"
                depends on BSP_USING_UART2
                select RT_SERIAL_USING_DMA
                default n

            config BSP_USING_UART3
                bool "Enable UART3"
                default n

            config BSP_UART3_RX_USING_DMA
                bool "Enable UART3 RX DMA"
                depends on BSP_USING_UART3
                select RT_SERIAL_USING_DMA
                default n

            config BSP_USING_UART4
                bool "Enable UART4"
                default n

            config BSP_UART4_RX_USING_DMA
                bool "Enable UART4 RX DMA"
                depends on BSP_USING_UART4
                select RT_SERIAL_USING_DMA
                default n

            config BSP_USING_UART5
                bool "Enable UART5"
                default n

            config BSP_UART5_RX_USING_DMA
                bool "Enable UART5 RX DMA"
                depends on BSP_USING_UART5
                select RT_SERIAL_USING_DMA
                default n

            config BSP_USING_UART6
                bool "Enable UART6"
                default n

            config BSP_UART6_RX_USING_DMA
                bool "Enable UART6 RX DMA"
                depends on BSP_USING_UART6
                select RT_SERIAL_USING_DMA
                default n

            config BSP_USING_UART7
                bool "Enable UART7"
                default n

            config BSP_UART7_RX_USING_DMA
                bool "Enable UART7 RX DMA"
                depends on BSP_USING_UART7
                select RT_SERIAL_USING_DMA
                default n
        endif

    menuconfig BSP_USING_SPI
        bool "Enable SPI BUS"
        default n
        select RT_USING_SPI
        if BSP_USING_SPI
            config BSP_USING_SPI1
                bool "Enable SPI1 BUS"
                default n

            config BSP_SPI1_TX_USING_DMA
                bool "Enable SPI1 TX DMA"
                depends on BSP_USING_SPI1
                default n

            config BSP_SPI1_RX_USING_DMA
                bool "Enable SPI1 RX DMA"
                depends on BSP_USING_SPI1
                select BSP_SPI1_TX_USING_DMA
                default n
        endif

    menuconfig BSP_USING_I2C1
        bool "Enable I2C1 BUS (software simulation)"
        default n
        select RT_USING_I2C
        select RT_USING_I2C_BITOPS
        select RT_USING_PIN
        if BSP_USING_I2C1
            config BSP_I2C1_SCL_PIN
                int "i2c1 scl pin number"
                range 1 216
                default 24
            config BSP_I2C1_SDA_PIN
                int "I2C1 sda pin number"
                range 1 216
                default 25
        endif
    source "../libraries/gd32_drivers/Kconfig"

endmenu

menu "Board extended module Drivers"

endmenu

endmenu
```

## bsp/gd32/libraries/Kconfig
```kconfig
config SOC_FAMILY_GD32
    bool

config SOC_SERIES_GD32F4
    bool "gd32f4xx serise chip"
    select ARCH_ARM_CORTEX_M4
    select SOC_FAMILY_GD32

config SOC_SERIES_GD32F2
    bool "gd32f2xx serise chip"
    select ARCH_ARM_CORTEX_M3
    select SOC_FAMILY_GD32
```

## bsp/gd32/risc-v/gd32vw553h-eval/board/Kconfig
```kconfig
menu "Hardware Drivers Config"

config SOC_SERIES_GD32VW55x
    bool
    default y

config SOC_GD32VW553H
    bool
    select SOC_SERIES_GD32VW55x
    select RT_USING_COMPONENTS_INIT
    select RT_USING_USER_MAIN
    default y

menu "Onboard Peripheral Drivers"

endmenu

menu "On-chip Peripheral Drivers"

    config BSP_USING_GPIO
        bool "Enable GPIO"
        select RT_USING_PIN
        default n

    menuconfig BSP_USING_UART
        bool "Enable UART"
        default n
        select RT_USING_SERIAL
        if BSP_USING_UART
            config BSP_USING_UART0
                bool "Enable UART0"
                default n

            config BSP_UART0_RX_USING_DMA
                bool "Enable UART0 RX DMA"
                depends on BSP_USING_UART0
                select RT_SERIAL_USING_DMA
                default n

            config BSP_USING_UART1
                bool "Enable UART1"
                default n

            config BSP_UART1_RX_USING_DMA
                bool "Enable UART1 RX DMA"
                depends on BSP_USING_UART1
                select RT_SERIAL_USING_DMA
                default n

            config BSP_USING_UART2
                bool "Enable UART2"
                default n

            config BSP_UART2_RX_USING_DMA
                bool "Enable UART2 RX DMA"
                depends on BSP_USING_UART2
                select RT_SERIAL_USING_DMA
                default n
        endif

    menuconfig BSP_USING_PWM
        bool "Enable PWM"
        default n
        select RT_USING_PWM
        if BSP_USING_PWM
            config BSP_USING_PWM0
                bool "Enable PWM0"
                default y
            config BSP_USING_PWM1
                bool "Enable PWM1"
                default n
            config BSP_USING_PWM2
                bool "Enable PWM2"
                default n
            config BSP_USING_PWM15
                bool "Enable PWM15"
                default n
            config BSP_USING_PWM16
                bool "Enable PWM16"
                default n
        endif
    menuconfig BSP_USING_HW_I2C
        bool "Enable Hardware I2C"
        default n
        select RT_USING_I2C
        if BSP_USING_HW_I2C
            config BSP_USING_HW_I2C0
                bool "Enable Hardware I2C0"
                default n

            # config i2c0 pins
            choice
                prompt "Select I2C0 pins"
                depends on BSP_USING_HW_I2C0
                config BSP_HW_I2C0_PIN_PA2_PA3
                    bool "SCL=PA2,  SDA=PA3"
                config BSP_HW_I2C0_PIN_PA15_PC8
                    bool "SCL=PA15, SDA=PC8"
                config BSP_HW_I2C0_PIN_PB0_PB1
                    bool "SCL=PB0,  SDA=PB1"
                config BSP_HW_I2C0_PIN_PB15_PA8
                    bool "SCL=PB15, SDA=PA8"
            endchoice

            # config i2c0 clock
            config BSP_HW_I2C0_CLK
                int "I2C0 clock frequency(KHz)"
                default 100
                depends on BSP_USING_HW_I2C0
                range 10 1000

            config BSP_USING_HW_I2C1
                bool "Enable Hardware I2C1"
                default n

            # config i2c1 pins
            choice
                prompt "Select I2C1 pins"
                depends on BSP_USING_HW_I2C1
                config BSP_HW_I2C1_PIN_PA6_PA7
                    bool "SCL=PA6,  SDA=PA7"
                config BSP_HW_I2C1_PIN_PA13_PA14
                    bool "SCL=PA13, SDA=PA14"
                config BSP_HW_I2C1_PIN_PA15_PC8
                    bool "SCL=PA15, SDA=PC8"
                config BSP_HW_I2C1_PIN_PB12_PB13
                    bool "SCL=PB12, SDA=PB13"
                config BSP_HW_I2C1_PIN_PB15_PA8
                    bool "SCL=PB15, SDA=PA8"
            endchoice

            # config i2c1 clock
            config BSP_HW_I2C1_CLK
                int "I2C1 clock frequency(KHz)"
                default 100
                depends on BSP_USING_HW_I2C1
                range 10 1000
        endif

    source "$(BSP_DIR)/../libraries/gd32_drivers/Kconfig"

endmenu

menu "Board extended module Drivers"

endmenu

endmenu
```

## bsp/gd32/risc-v/libraries/Kconfig
```kconfig
config SOC_FAMILY_GD32
    bool

config SOC_GD32VF103V
    bool
    select SOC_SERIES_GD32VF103V
    select SOC_FAMILY_GD32
    select RT_USING_HW_ATOMIC

config SOC_GD32VW553H
    bool
    select SOC_SERIES_GD32VW
    select SOC_FAMILY_GD32
    select RT_USING_HW_ATOMIC
```
