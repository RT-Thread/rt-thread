## bsp/hk32/hk32f030c8-mini/board/Kconfig
```kconfig
menu "Hardware Drivers Config"

config SOC_HK32F030C8T6
    bool
    select SOC_SERIES_HK32F0XX
    select RT_USING_COMPONENTS_INIT
    select RT_USING_USER_MAIN
    default y

menu "Onboard Peripheral Drivers"

    config BSP_USING_SERIAL
        bool "Enable USART (uart1)"
        select BSP_USING_UART
        select BSP_USING_UART1
        default y

endmenu

menu "On-chip Peripheral Drivers"

    config BSP_USING_GPIO
        bool "Enable GPIO"
        select RT_USING_PIN
        default y

    config BSP_USING_ON_CHIP_FLASH
        bool "Enable on-chip FLASH"
        default n

    menuconfig BSP_USING_RTC
        bool "Enable RTC"
        select RT_USING_RTC
        default n
        if BSP_USING_RTC
            choice
                prompt "Select clock source"
                default BSP_RTC_USING_LSE

                config BSP_RTC_USING_LSE
                    bool "RTC USING LSE"

                config BSP_RTC_USING_LSI
                    bool "RTC USING LSI"
            endchoice
        endif

    menuconfig BSP_USING_UART
        bool "Enable UART"
        default y
        select RT_USING_SERIAL
        if BSP_USING_UART
            config BSP_USING_UART1
                bool "Enable UART1"
                default y

            config BSP_USING_UART2
                bool "Enable UART2"
                default n
        endif

    menuconfig BSP_USING_PWM
        bool "Enable PWM"
        default n
        select RT_USING_PWM
        if BSP_USING_PWM
        menuconfig BSP_USING_TIM1
            bool "Enable timer1 output PWM"
            default n
            if BSP_USING_TIM1
                config BSP_USING_TIM1_CH1
                    bool "Enable TIM1 channel1 PWM"
                    default n

                config BSP_USING_TIM1_CH4
                    bool "Enable TIM1 channel4 PWM"
                    default n
            endif
        endif

    menuconfig BSP_USING_HWTIMER
        bool "Enable HWTIMER"
        default n
        select RT_USING_HWTIMER
        if BSP_USING_HWTIMER
        config BSP_USING_HWTIM3
            bool "Enable hardware timer3"
            default n
        endif

    menuconfig BSP_USING_SPI
        bool "Enable SPI BUS"
        default n
        select RT_USING_SPI
        if BSP_USING_SPI
            config BSP_USING_SPI1
                bool "Enable SPI1 BUS"
                default n

            config BSP_USING_SPI2
                bool "Enable SPI2 BUS"
                default n
        endif

    menuconfig BSP_USING_ADC
        bool "Enable ADC"
        default n
        select RT_USING_ADC
        if BSP_USING_ADC
            config BSP_USING_ADC1
                bool "Enable ADC1"
                default n
            config BSP_USING_ADC2
                bool "Enable ADC2"
                default n
        endif

endmenu

endmenu
```

## bsp/hk32/libraries/Kconfig
```kconfig
config SOC_FAMILY_HK32
    bool

config SOC_SERIES_HK32F0XX
    bool
    select ARCH_ARM_CORTEX_M0
    select SOC_FAMILY_HK32
```
