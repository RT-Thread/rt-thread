## bsp/lpc55sxx/lpc55s69_nxp_evk/board/Kconfig
```kconfig
menu "Hardware Drivers Config"

config SOC_LPC55S6X
    bool
    select SOC_LPC55S6X_SERIES
    select RT_USING_COMPONENTS_INIT
    select RT_USING_USER_MAIN
    default y

menu "On-chip Peripheral Drivers"

    config BSP_USING_DMA
        bool "Enable DMA"
        select RT_USING_DMA
        default n

    config BSP_USING_PIN
        bool "Enable GPIO"
        select RT_USING_PIN
        default y

    menuconfig BSP_USING_UART
        config BSP_USING_UART
            bool "Enable UART"
            select RT_USING_UART
            default y

            if BSP_USING_UART
                config BSP_USING_UART0
                    bool "Enable Flexcomm0 as UART"
                    default y
                    if BSP_USING_UART0
                        choice
                            prompt "Select UART0 badurate"
                            default HW_UART0_BAUDRATE_115200

                            config HW_UART0_BAUDRATE_9600
                                bool "Badurate 9600"

                            config HW_UART0_BAUDRATE_115200
                                bool "Badurate 115200"
                        endchoice
                    endif

                config BSP_USING_UART1
                    bool "Enable Flexcomm1 as UART"
                    default n
                    if BSP_USING_UART1
                    choice
                        prompt "Select UART1 badurate"
                        default HW_UART1_BAUDRATE_115200

                        config HW_UART1_BAUDRATE_9600
                            bool "Badurate 9600"

                        config HW_UART1_BAUDRATE_115200
                            bool "Badurate 115200"
                    endchoice
                endif

                config BSP_USING_UART2
                    bool "Enable Flexcomm2 as UART"
                    default n
                    if BSP_USING_UART2
                        choice
                            prompt "Select UART2 badurate"
                            default HW_UART2_BAUDRATE_115200

                            config HW_UART2_BAUDRATE_9600
                                bool "Badurate 9600"

                            config HW_UART2_BAUDRATE_115200
                                bool "Badurate 115200"
                        endchoice
                    endif
            endif


    menuconfig BSP_USING_I2C
        config BSP_USING_I2C
            bool "Enable I2C"
            select RT_USING_I2C
            default y

            if BSP_USING_I2C
                config BSP_USING_I2C1
                    bool "Enable Flexcomm1 I2C"
                    default y

                    if BSP_USING_I2C1
                        choice
                            prompt "Select I2C1 badurate"
                            default HW_I2C1_BAUDRATE_100kHZ

                            config HW_I2C1_BAUDRATE_100kHZ
                                bool "Badurate 100kHZ"

                            config HW_I2C1_BAUDRATE_400kHZ
                                bool "Badurate 400kHZ"
                        endchoice
                    endif

                config BSP_USING_I2C4
                    bool "Enable Flexcomm4 I2C"
                    default y
                    if BSP_USING_I2C4
                        choice
                            prompt "Select I2C4 badurate"
                            default HW_I2C4_BAUDRATE_100kHZ

                            config HW_I2C4_BAUDRATE_100kHZ
                                bool "Badurate 100kHZ"

                            config HW_I2C4_BAUDRATE_400kHZ
                                bool "Badurate 400kHZ"
                        endchoice
                    endif
            endif
    
    menuconfig BSP_USING_SOFT_I2C
        bool "Enable I2C Bus"
        select RT_USING_I2C
        select RT_USING_I2C_BITOPS
        select RT_USING_PIN
        default n

        if BSP_USING_SOFT_I2C
            config BSP_USING_SOFT_I2C1
                bool "Enable I2C1 Bus (software simulation)"
                default n

            config BSP_USING_SOFT_I2C2
                bool "Enable I2C2 Bus (software simulation)"
                default n
        endif

    menuconfig BSP_USING_SPI
        config BSP_USING_SPI
            bool "Enable SPI"
            select RT_USING_SPI
            default y

            if BSP_USING_SPI
                config BSP_USING_SPI3
                    bool "Enable Flexcomm3 as SPI"
                    default n

                config BSP_USING_SPI8
                    bool "Enable Flexcomm8 as High Speed SPI"
                    default y
            endif

    menuconfig BSP_USING_SOFT_SPI
        bool "Enable soft SPI BUS"
        default n
        select RT_USING_PIN
        select RT_USING_SPI_BITOPS
        select RT_USING_SPI
        if BSP_USING_SOFT_SPI
            menuconfig BSP_USING_SOFT_SPI1
                bool "Enable soft SPI1 BUS (software simulation)"
                default n

            menuconfig BSP_USING_SOFT_SPI2
                bool "Enable soft SPI2 BUS (software simulation)"
                default n
        endif
            
    menuconfig BSP_USING_ADC
        config BSP_USING_ADC
            bool "Enable ADC Channel"
            select RT_USING_ADC
            default y

            if BSP_USING_ADC
                config BSP_USING_ADC0_CH0
                    bool "Enable ADC0 Channel0"
                    default y

                config BSP_USING_ADC0_CH1
                    bool "Enable ADC0 Channel1"
                    default n

                config BSP_USING_ADC0_CH8
                    bool "Enable ADC0 Channel8"
                    default n


                config BSP_USING_ADC0_CH13
                    bool "Enable ADC0 Channel13"
                    default n


                config BSP_USING_ADC0_CH26
                    bool "Enable ADC0 Channel26"
                    default n

            endif

    config BSP_USING_SDIO
        bool "Enable SDIO SD Card Interface"
        select RT_USING_SDIO
        select RT_USING_DFS
        select RT_USING_DFS_ELMFAT
        default y

    config BSP_USING_RTC
        bool "Enable RTC"
        select RT_USING_RTC
        default y

    config BSP_USING_WDT
        bool "Enable WatchDog"
        select RT_USING_WDT
        default n

    menuconfig BSP_USING_HWTIMER
        config BSP_USING_HWTIMER
            bool "Enable Timer"
            select RT_USING_HWTIMER
            default y

            if BSP_USING_HWTIMER
                config BSP_USING_CTIMER0
                    bool "Enable CIMER0"
                    default y

                config BSP_USING_CTIMER3
                    bool "Enable CIMER3"
                    default n

                config BSP_USING_CTIMER4
                    bool "Enable CIMER4"
                    default n
            endif

    menuconfig BSP_USING_PWM
        config BSP_USING_PWM
            bool "Enable PWM"
            select RT_USING_PWM
            default y

            if BSP_USING_PWM
                config BSP_USING_CTIMER1_MAT0
                    bool "Enable CIMER1 Match0 as PWM output"
                    default y

                config BSP_USING_CTIMER2_MAT0
                    bool "Enable CIMER2 Match0 as PWM output"
                    default n

                config BSP_USING_CTIMER2_MAT1
                    bool "Enable CIMER2 Match1 as PWM output"
                    default n

                config BSP_USING_CTIMER2_MAT2
                    bool "Enable CIMER2 Match2 as PWM output"
                    default n

                config BSP_USING_CTIMER3_MAT2
                    bool "Enable CIMER3 Match2 as PWM output"
                    default n
            endif
endmenu

menu "Onboard Peripheral Drivers"
    config BSP_USING_LED
        bool "Enable RGB LED"
        select RT_USING_LED
        default y

    config BSP_USING_KEY
        bool "Enable Button "
        select RT_USING_KEY
        default y

    config BSP_USING_MMA8562
        bool "Enable MMA8562"
        select BSP_USING_I2C4
        default y
        if BSP_USING_MMA8562
            config BSP_USING_MMA8562I2C
                string "the device name for 3-Axis Sensor"
                default "i2c4"
        endif

    config BSP_USING_ARDUINO
        bool "Compatible with Arduino Ecosystem (RTduino)"
        select PKG_USING_RTDUINO
        select BSP_USING_UART2
        select BSP_USING_GPIO
        select BSP_USING_ADC
        select BSP_USING_ADC0
        select BSP_USING_PWM
        select BSP_USING_CTIMER1_MAT0
        select BSP_USING_CTIMER2_MAT0
        select BSP_USING_CTIMER2_MAT1
        select BSP_USING_CTIMER2_MAT2
        select BSP_USING_I2C
        select BSP_USING_I2C1
        imply RTDUINO_USING_SERVO
        imply RTDUINO_USING_WIRE
        default n

endmenu

menu "Board extended module Drivers"

endmenu

endmenu
```

## bsp/ls1bdev/Kconfig
```kconfig
mainmenu "RT-Thread Configuration"

config BSP_DIR
    string
    option env="BSP_ROOT"
    default "."

config RTT_DIR
    string
    option env="RTT_ROOT"
    default "../.."

config PKGS_DIR
    string
    option env="PKGS_ROOT"
    default "packages"

source "$RTT_DIR/Kconfig"
source "$PKGS_DIR/Kconfig"

config SOC_LS1B
    bool
    select RT_USING_COMPONENTS_INIT
    select RT_USING_USER_MAIN
    default y

config RT_MEM_SIZE
    int "Memory Size (MByte)"
    default 256

config RT_OSC_CLK
    int "Oscillator Clock (Hz)"
    default 25000000

if RT_USING_SERIAL
config RT_USING_UART0
    bool "Using RT_USING_UART0"
    default n
config RT_USING_UART1
    bool "Using RT_USING_UART1"
    default n
config RT_USING_UART2
    bool "Using RT_USING_UART2"
    default n
config RT_USING_UART3
    bool "Using RT_USING_UART3"
    default n
config RT_USING_UART4
    bool "Using RT_USING_UART4"
    default n
config RT_USING_UART5
    bool "Using RT_USING_UART5"
    default y

config RT_UART_RX_BUFFER_SIZE
    int "The rx buffer size"
    default 64 if RT_USING_SERIAL
    default 64
endif
```

## bsp/ls1cdev/kconfig
```kconfig
mainmenu "RT-Thread Configuration"


config $BSP_DIR
    string
    option env="BSP_ROOT"
    default "."

config $RTT_DIR
    string
    option env="RTT_ROOT"
    default "F:/rt-thread/rt-thread"
    
# you can change the RTT_ROOT default "../.." to your rtthread_root,
# example : default "F:/git_repositories/rt-thread"

config $PKGS_DIR
    string
    option env="PKGS_ROOT"
    default "packages"

source "$RTT_DIR/KConfig"
source "$PKGS_DIR/KConfig"

config RT_USING_UART
    bool "Using RT_USING_UART"
    default y

if RT_USING_UART
config RT_USING_UART2
    bool "Using RT_USING_UART2"
    default y      

config RT_UART_RX_BUFFER_SIZE
    int "The rx buffer size"        
    default 64 if RT_USING_UART
    default 64 
endif  

config RT_USING_GMAC_INT_MODE
    bool "Using RT_USING_GMAC_INT_MODE"
    default y
	
config RT_USING_FPU
    bool "Using RT_USING_FPU"
    default y
	
config RT_USING_SPI0
    bool "Using RT_USING_SPI0"
	select RT_USING_SPI
    default y      

config RT_USING_SPI1
    bool "Using RT_USING_SPI1"
	select RT_USING_SPI
    default y      

config RT_USING_I2C1
    bool "Using RT_USING_I2C1"
	select RT_USING_I2C
    default y      

config RT_USING_I2C2
    bool "Using RT_USING_I2C2"
	select RT_USING_I2C
    default y      

config RT_CAN_USING_HDR
    bool "Using RT_CAN_USING_HDR"
	select RT_USING_CAN
    default y      

config USING_BXCAN0
    bool "Using USING_BXCAN0"
	select RT_USING_CAN
    default y      
  
config USING_BXCAN1
    bool "Using USING_BXCAN1"
	select RT_USING_CAN
    default y      


    
```

## bsp/ls2kdev/Kconfig
```kconfig
mainmenu "RT-Thread Configuration"

config BSP_DIR
    string
    option env="BSP_ROOT"
    default "."

config RTT_DIR
    string
    option env="RTT_ROOT"
    default "../.."

# you can change the RTT_ROOT default "../.." to your rtthread_root,
# example : default "F:/git_repositories/rt-thread"

config PKGS_DIR
    string
    option env="PKGS_ROOT"
    default "packages"

source "$RTT_DIR/Kconfig"
source "$RTT_DIR/libcpu/mips/common/Kconfig"
source "$PKGS_DIR/Kconfig"

config SOC_LS2K1000
    bool
    select ARCH_MIPS64
    select RT_USING_COMPONENTS_INIT
    select RT_USING_USER_MAIN
    select RT_USING_DEVICE
    default y

if RT_USING_SERIAL
config RT_USING_UART0
    bool "Using RT_USING_UART0"
    default y

config RT_USING_UART4
    bool "Using RT_USING_UART4"
    default y
endif
```

## bsp/ls2kdev/applications/testcases/demo/Kconfig
```kconfig
if RT_USING_TESTCASE
    menu "utest demo"
        config TC_USING_UTEST_DEMO_TC
            bool "Enable demo test"
            default n
    endmenu
endif
```

## bsp/maxim/MAX32660_EVSYS/board/Kconfig
```kconfig
menu "Hardware Drivers Config"

config SOC_MAX32660
    bool
    config SOC_MAX32660
    select RT_USING_COMPONENTS_INIT
    select RT_USING_USER_MAIN
    select BSP_USING_UART
    select BSP_USING_UART1
    default y

config SOC_MAXIM
    bool
    config SOC_MAXIM
    default y

menu "On-chip Peripheral Drivers"
    config BSP_USING_GPIO
        bool "Enable GPIO"
        select RT_USING_PIN
        default y

    menuconfig BSP_USING_UART
        bool "Enable UART"
        default y
        select RT_USING_SERIAL
        if BSP_USING_UART
            config BSP_USING_UART0
                bool "Enable UART0"
                default n

            config BSP_UART0_RX_USING_DMA
                bool "Enable UART0 RX DMA"
                depends on BSP_USING_UART0 && RT_SERIAL_USING_DMA
                default n

            config BSP_USING_UART1
                bool "Enable UART1"
                default y

            config BSP_UART1_RX_USING_DMA
                bool "Enable UART1 RX DMA"
                depends on BSP_USING_UART1 && RT_SERIAL_USING_DMA
                default n
        endif
    config BSP_USING_SPI
        bool "Enable SPI"
        select RT_USING_SPI
        default n

        if BSP_USING_SPI
            config BSP_USING_SPI0
                bool "Enable SPI0 bus [MISO P0.4;MOSI P0.5;SCL P0.6;SS P0.7]"
                default y

            config BSP_USING_SPI1
                bool "Enable SPI1 bus [MISO P0.0;MOSI P0.1;SCL P0.2;SS P0.3]"
                default n
            if BSP_USING_SPI1
            config BSP_USING_SPI1A
                bool "Use SPI1A. [MISO P0.10;MOSI P0.11;SCL P0.12;SS P0.13]"
                default n
            endif
        endif
    config BSP_USING_ON_CHIP_FLASH
        select RT_USING_FAL
        bool "Enable on-chip FLASH"
        default n
    config BSP_USING_I2C
        bool "Enable I2C"
        select RT_USING_I2C
        default n

        if BSP_USING_I2C
            config BSP_USING_I2C0
                bool "Enable I2C0 bus [SCL P0.8; SDA P0.9]"
                default y

            config BSP_USING_I2C1
                bool "Enable I2C1 bus [SCL P0.2; SDA P0.3]"
                default n
        endif

     config BSP_USING_ONCHIP_RTC
         bool "Enable RTC"
         select RT_USING_RTC
         default n

endmenu


endmenu
```

## bsp/microchip/samc21/Kconfig
```kconfig
mainmenu "RT-Thread Configuration"

config BSP_DIR
    string
    option env="BSP_ROOT"
    default "."

config RTT_DIR
    string
    option env="RTT_ROOT"
    default "../../.."

# you can change the RTT_ROOT default: "rt-thread"

config PKGS_DIR
    string
    option env="PKGS_ROOT"
    default "packages"

source "$RTT_DIR/Kconfig"
source "$PKGS_DIR/Kconfig"
source "board/Kconfig"

config SOC_SAMC21
    bool
    select ARCH_ARM
    select ARCH_ARM_CORTEX_M
    select ARCH_ARM_CORTEX_M0
    select RT_USING_COMPONENTS_INIT
    select RT_USING_USER_MAIN
    default y
```
