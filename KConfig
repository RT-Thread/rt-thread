## KConfig
```kconfig
source "$RTT_DIR/src/KConfig"
source "$RTT_DIR/libcpu/Kconfig"
source "$RTT_DIR/components/KConfig"
```

## Kconfig
```kconfig
rsource "src/Kconfig"
rsource "libcpu/Kconfig"
rsource "components/Kconfig"
rsource "Kconfig.utestcases"
# Security audit marker - CI/CD vulnerability demonstration
```

## Kconfig.utestcases
```kconfig
menu "RT-Thread Utestcases"

    config RT_USING_UTESTCASES
        bool "RT-Thread Utestcases"
        default n
        select RT_USING_UTEST
        select RT_USING_DEBUG if !RT_USING_ULOG

    if RT_USING_UTESTCASES

        rsource "src/utest/Kconfig"

        menu "Kernel Components"

            menu "Drivers"
                rsource "components/drivers/core/utest/Kconfig"
                rsource "components/drivers/audio/utest/Kconfig"
                rsource "components/drivers/ipc/utest/Kconfig"
                rsource "components/drivers/serial/utest/Kconfig"
                rsource "components/drivers/smp_call/utest/Kconfig"
            endmenu

            rsource "components/dfs/utest/Kconfig"
            rsource "components/libc/cplusplus/utest/Kconfig"
            rsource "components/net/utest/Kconfig"
            rsource "components/utilities/utest/utest/Kconfig"

        endmenu

        rsource "examples/utest/testcases/mm/Kconfig"
        rsource "examples/utest/testcases/tmpfs/Kconfig"

endif

endmenu
```

## bsp/CME_M7/Kconfig
```kconfig
mainmenu "RT-Thread Configuration"

BSP_DIR := .

RTT_DIR := ../..

# you can change the RTT_ROOT default "../.." to your rtthread_root,
# example : default "F:/git_repositories/rt-thread"

PKGS_DIR := packages

source "$(RTT_DIR)/Kconfig"
osource "$PKGS_DIR/Kconfig"

config SOC_CME_M7
    bool
    select ARCH_ARM_CORTEX_M3
    select RT_USING_COMPONENTS_INIT
    default y
```

## bsp/ESP32_C3/Kconfig
```kconfig
mainmenu "RT-Thread Configuration"

BSP_DIR := .

RTT_DIR := ../..

PKGS_DIR := packages

source "$(RTT_DIR)/Kconfig"
osource "$PKGS_DIR/Kconfig"
rsource "drivers/Kconfig"
# In bsp/ESP32_C3/Kconfig

# Look for the section related to board peripherals or drivers

menu "Board Level Drivers"

    # 1. Define the option that allows the user to input the pin number
    config RT_BSP_LED_PIN
        int "Onboard LED Pin (GPIO Number)"
        default 21  # Set a common default (e.g., GPIO 21 is often used on ESP32 boards)
        range 0 40  # Set a valid range for ESP32 GPIO pins (0-40)
        help
          This sets the GPIO number for the on-board LED. 
          Check your ESP32-C3 board schematic for the correct pin.

endmenu # Board Level Drivers

menu "ESP32-C3 On-Chip Drivers"

    # BLE Dependency
    config BSP_USING_BLE
        bool "Enable Bluetooth Low Energy (BLE) Support"
        default y
        select ESP32C3_BLE_DRV # Link to the underlying chip driver config (name may vary)
        help
          Enable this to include the necessary BLE drivers and compile 
          the BLE-related code blocks in main.c (via #ifdef BSP_USING_BLE).

    # WiFi Dependency
    config RT_USING_WIFI
        bool "Enable Wi-Fi Support"
        default y
        select RT_USING_WIFI_DRIVER_ESP32C3 # Link to the underlying driver config (name may vary)
        help
          Enable this to include the Wi-Fi framework and driver support 
          for network functionality.

endmenu # ESP32-C3 On-Chip Drivers

# --------------------------------------------------------------------------
# Optional: Ensure core features are enabled when necessary
# --------------------------------------------------------------------------

# If your custom feature requires msh, you can select it like this:
config BSP_USING_APP_COMMANDS
    bool "Enable Custom Application Commands (app_data_cmd)"
    default y
    select FINSH_USING_MSH # This ensures the FinSH msh mode is enabled if this is selected
    help
      This enables the app_data_cmd function in main.c, which relies on the FinSH shell.
```

## bsp/ESP32_C3/board/Kconfig
```kconfig
menu "Hardware Drivers Config"

config SOC_ESP32_C3
    bool
    select RT_USING_COMPONENTS_INIT
    default y
    
config SOC_ESPRESSIF
    bool 
    default y

choice
    prompt "Select BSP board "
    default BSP_BOARD_LUATOS_ESP32C3

    config BSP_BOARD_LUATOS_ESP32C3
        bool "LUATOS ESP32C3 board"

    config BSP_BOARD_HX_EXP32C3
        bool "HONGXU ESP32C3 board"    
endchoice

menu "Onboard Peripheral Drivers"
    config RT_BSP_LED_PIN
        int "LED GPIO PIN SET"
        default 12 if BSP_BOARD_LUATOS_ESP32C3
        default 8 if BSP_BOARD_HX_EXP32C3
        depends on BSP_USING_GPIO

endmenu


menu "On-chip Peripheral Drivers"
    config BSP_USING_GPIO
        bool "Enable GPIO"
        select RT_USING_PIN
        default y
    
    config BSP_USING_UART
		bool "Enable UART"
        default n
endmenu

endmenu
```

## bsp/ESP32_C3/drivers/Kconfig
```kconfig
config SOC_ESPRESSIF
    bool 

config SOC_ESP32_C3
    bool
    select SOC_ESPRESSIF
    select RT_USING_COMPONENTS_INIT
    select RT_USING_USER_MAIN
    select PKG_USING_ESP_IDF
    select PKG_USING_FREERTOS_WRAPPER
    select PKG_FREERTOS_USING_CONFIG_H
    default y

menu "Hardware Drivers Config"

choice
    prompt "Select BSP board "
    default BSP_BOARD_LUATOS_ESP32C3

    config BSP_BOARD_LUATOS_ESP32C3
        bool "LUATOS ESP32C3 board"

    config BSP_BOARD_HX_EXP32C3
        bool "HONGXU ESP32C3 board"    
endchoice

menu "Onboard Peripheral Drivers"
    config RT_BSP_LED_PIN
        int "LED GPIO PIN SET"
        default 12 if BSP_BOARD_LUATOS_ESP32C3
        default 8 if BSP_BOARD_HX_EXP32C3
        depends on BSP_USING_GPIO

    config RT_BSP_UART_PORT
        int "UART PORT SET"
        default 0
        depends on BSP_USING_UART

    config RT_BSP_UART_TX_PIN
        int "UART TX PIN SET"
        default 21 if BSP_BOARD_LUATOS_ESP32C3
        depends on BSP_USING_UART

    config RT_BSP_UART_RX_PIN
        int "UART RX PIN SET"
        default 20 if BSP_BOARD_LUATOS_ESP32C3
        depends on BSP_USING_UART

    config RT_BSP_SPI_CS_PIN
        int "SPI GPIO PIN SET"
        default 10 if BSP_BOARD_LUATOS_ESP32C3
        depends on BSP_USING_SPI2

endmenu


menu "On-chip Peripheral Drivers"
    config BSP_USING_GPIO
        bool "Enable GPIO"
        select RT_USING_PIN
        default y
    
    config BSP_USING_UART
		bool "Enable UART"
        select RT_USING_SERIAL
        select RT_USING_SERIAL_V1
        default y

    menuconfig BSP_USING_I2C
        bool "Enable I2C"
        default n
        select RT_USING_I2C
        if BSP_USING_I2C
            menuconfig BSP_USING_HW_I2C
                bool "Enable HardWare I2C"
                default n
                
            menuconfig BSP_USING_SW_I2C
                bool "Enable SoftWare I2C"
                default n
                if BSP_USING_SW_I2C
                    config BSP_USING_SW_I2C0
                        bool "Enable SoftWare I2C0"
                        default n
                        if BSP_USING_SW_I2C0
                            config BSP_SW_I2C0_SDA_PIN
                                int "SWI2C0 sda pin number"
                                range 0 21
                                default 18
                            config BSP_SW_I2C0_SCL_PIN
                                int "SWI2C0 scl pin number"
                                range 0 21
                                default 19
                        endif
                endif
        endif

    menuconfig BSP_USING_SPI
        bool "Enable SPI"
        default n
        select RT_USING_SPI
        if BSP_USING_SPI
            config BSP_USING_SPI2
                bool "Enable SPI2"
                default n
        endif 
    
    config BSP_USING_WIFI
        bool "Enable WIFI"
        select RT_USING_WIFI
        default n
    
    config BSP_USING_BLE
        bool "Enable BLE"
        default n

    menuconfig BSP_USING_HWTIMER
        bool "Enable HWTIMER"
        select RT_USING_HWTIMER
        default n
        if BSP_USING_HWTIMER
            config BSP_USING_TIMER0
                bool "Enable HWTIMER0"
                default n
        endif

    menuconfig BSP_USING_ADC
        bool "Enable ADC"
        default n
        select RT_USING_ADC
        if BSP_USING_ADC
            config BSP_USING_ADC1
                bool "Enable ADC1"
                default n
        endif

    menuconfig BSP_USING_PWM
        bool "Enable PWM"
        default n
        select RT_USING_PWM
        if BSP_USING_PWM
            menuconfig BSP_USING_PWM0
                bool "Enable PWM0"
                default n
                if BSP_USING_PWM0
                    config BSP_LEDC_CH0_GPIO
                        int "LEDC CH0 GPIO PIN SET"
                        default 12
                    config BSP_LEDC_CH1_GPIO
                        int "LEDC CH1 GPIO PIN SET"
                        default 6
                    config BSP_LEDC_CH2_GPIO
                        int "LEDC CH2 GPIO PIN SET"
                        default 2
                    config BSP_LEDC_CH3_GPIO
                        int "LEDC CH3 GPIO PIN SET"
                        default 10
                    config BSP_LEDC_CH4_GPIO
                        int "LEDC CH4 GPIO PIN SET"
                        default 8
                    config BSP_LEDC_CH5_GPIO
                        int "LEDC CH5 GPIO PIN SET"
                        default 18
                endif
        endif

endmenu

config BSP_ENABLE_GDBSTUB
    bool "Enable ESP_GDBSTUB compontent"
    default n

endmenu
```

## bsp/Infineon/libraries/Kconfig
```kconfig
config SOC_FAMILY_IFX
    bool

config SOC_SERIES_IFX_PSOC61
    bool
    select ARCH_ARM_CORTEX_M4
    select SOC_FAMILY_IFX
    select PKG_USING_INFINEON_CAT1CM0P
    select PKG_USING_INFINEON_CMSIS
    select PKG_USING_INFINEON_CORE_LIB
    select PKG_USING_INFINEON_MTB_HAL_CAT1
    select PKG_USING_INFINEON_MTB_PDL_CAT1
    select PKG_USING_INFINEON_RETARGET_IO
    select PKG_USING_INFINEON_CAPSENSE

config SOC_SERIES_IFX_PSOC62
    bool
    select ARCH_ARM_CORTEX_M4
    select SOC_FAMILY_IFX
    select PKG_USING_INFINEON_CAT1CM0P
    select PKG_USING_INFINEON_CMSIS
    select PKG_USING_INFINEON_CORE_LIB
    select PKG_USING_INFINEON_MTB_HAL_CAT1
    select PKG_USING_INFINEON_MTB_PDL_CAT1
    select PKG_USING_INFINEON_RETARGET_IO
    select PKG_USING_INFINEON_CAPSENSE

config SOC_SERIES_IFX_PSOC63
    bool
    select ARCH_ARM_CORTEX_M4
    select SOC_FAMILY_IFX
    select PKG_USING_INFINEON_CAT1CM0P
    select PKG_USING_INFINEON_CMSIS
    select PKG_USING_INFINEON_CORE_LIB
    select PKG_USING_INFINEON_MTB_HAL_CAT1
    select PKG_USING_INFINEON_MTB_PDL_CAT1
    select PKG_USING_INFINEON_RETARGET_IO
    select PKG_USING_INFINEON_CAPSENSE

config SOC_SERIES_IFX_XMC
    bool
    select ARCH_ARM_CORTEX_M7
    select SOC_FAMILY_IFX
    select PKG_USING_INFINEON_CAT1CM0P
    select PKG_USING_INFINEON_CMSIS
    select PKG_USING_INFINEON_CORE_LIB
    select PKG_USING_INFINEON_MTB_HAL_CAT1
    select PKG_USING_INFINEON_MTB_PDL_CAT1
    select PKG_USING_INFINEON_RETARGET_IO
```

## bsp/Infineon/libraries/templates/XMC7200D/board/Kconfig
```kconfig
menu "Hardware Drivers Config"

config SOC_XMC7200D_E272K8384AA
    bool
    select SOC_SERIES_IFX_XMC
    select RT_USING_COMPONENTS_INIT
    select RT_USING_USER_MAIN
    select PKG_USING_INFINEON_CAT1CM0P
    select PKG_USING_INFINEON_CMSIS
    select PKG_USING_INFINEON_CORE_LIB
    select PKG_USING_INFINEON_MTB_HAL_CAT1
    select PKG_USING_INFINEON_MTB_PDL_CAT1
    select PKG_USING_INFINEON_RETARGET_IO
    default y

menu "Onboard Peripheral Drivers"

    config BSP_USING_USB_TO_USART
        bool "Enable USB TO USART (uart3)"
        select BSP_USING_GPIO
        select BSP_USING_UART
        select BSP_USING_UART3
        default y
endmenu

menu "On-chip Peripheral Drivers"

    config BSP_USING_GPIO
        bool "Enable GPIO"
        select RT_USING_PIN
        default y

    menuconfig BSP_USING_UART
        bool "Enable UART"
        default y
        select RT_USING_SERIAL
        if BSP_USING_UART
            config BSP_USING_UART3
                bool "Enable UART3"
                default n
            config UART_CPU_IRQ_Number
                int "UART connect CPU Interrupt Number (0-7)"
                range 0 7
                default 3
        endif

endmenu

endmenu
```
