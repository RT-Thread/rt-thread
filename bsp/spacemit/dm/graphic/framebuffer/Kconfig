## components/dfs/utest/v2/af_unix/Kconfig
```kconfig
menuconfig RT_UTEST_TC_USING_DFS_V2_AF_UNIX
    bool "DFSv2 AF_UNIX Test"
    default n
    depends on RT_USING_DFS_V2
    depends on RT_USING_AF_UNIX
    depends on SAL_USING_POSIX
    help
        Enable DFSv2 AF_UNIX unit tests. Sources are compiled only when
        this option and the selected test groups below are enabled.

        Coverage includes socket-node creation, transferable file
        references, datagram and stream IPC, poll readiness, pathname
        lifetime, namespace cleanup, and SCM_RIGHTS handling.

if RT_UTEST_TC_USING_DFS_V2_AF_UNIX

config RT_UTEST_DFS_V2_AF_UNIX_DIR
    string "Directory for AF_UNIX pathname tests"
    default "/dev"
    help
        Directory used to create temporary AF_UNIX pathname nodes.
        The filesystem mounted here must support S_IFSOCK nodes
        through create_vnode(), such as tmpfs or devtmpfs.

config RT_UTEST_DFS_V2_AF_UNIX_NODE
    bool "Socket node and file-reference tests"
    default y
    help
        Build tests for DFSv2 socket nodes and transferable file
        references:
        * dfs_file_mknod(FT_SOCKET) creates an S_ISSOCK node
        * creating the same path again returns EEXIST
        * unlink() removes the socket node
        * dfs_file_get_refs() rejects an invalid fd
        * get_refs() + put_ref() keeps the original fd usable
        * get_refs() + install_refs() transfers a pipe and shares
          the open file description

config RT_UTEST_DFS_V2_AF_UNIX_IPC
    bool "Datagram, stream and socketpair IPC tests"
    default y
    help
        Build tests for AF_UNIX IPC operations:
        * SOCK_DGRAM bind, connect, send and recvfrom
        * SOCK_STREAM listen, accept, send, recv and shutdown
        * socketpair() for both SOCK_DGRAM and SOCK_STREAM
        * sendmsg()/recvmsg() scatter-gather I/O
        * connected sendmsg() with a NULL msg_name
        * sendmsg() with a NULL msg_control and nonzero length
        * listen() on SOCK_DGRAM returns EOPNOTSUPP
        * connect() to a missing pathname returns ENOENT
        * non-blocking recv() returns EAGAIN

config RT_UTEST_DFS_V2_AF_UNIX_POLL
    bool "Poll readiness and peer-close tests"
    default y
    help
        Build tests for AF_UNIX poll/select readiness:
        * empty stream socket reports POLLOUT and not POLLIN
        * received data reports POLLIN
        * filling the stream buffer clears POLLOUT; a peer recv
          makes POLLOUT ready again
        * blocking poll(POLLIN) wakes with POLLHUP/POLLIN when
          the peer is closed (covers the peer-queue UAF case)
        * datagram queue-full and POLLIN readiness

config RT_UTEST_DFS_V2_AF_UNIX_NAMESPACE
    bool "Pathname bind, unlink and namespace tests"
    default y
    help
        Build tests for pathname lifetime and namespace cleanup:
        * bind() creates a persistent S_IFSOCK node
        * close() leaves the pathname in the filesystem
        * rebinding without unlink() returns EADDRINUSE
        * unlink() then bind() succeeds
        * connect() after close without unlink() returns
          ECONNREFUSED
        * connect() after unlink() returns ENOENT
        * repeated bind/close/unlink on distinct paths does not
          leak namespace entries

config RT_UTEST_DFS_V2_AF_UNIX_RIGHTS
    bool "SCM_RIGHTS transfer and rejection tests"
    default y
    help
        Build tests for SCM_RIGHTS descriptor passing:
        * transfer pipe descriptors over SOCK_DGRAM and
          SOCK_STREAM
        * recvmsg() without a control buffer reports MSG_CTRUNC
        * MSG_PEEK does not install or consume descriptors
        * an invalid fd returns EBADF
        * passing an AF_UNIX socket descriptor returns
          EOPNOTSUPP and does not create a reference cycle

endif
```

## components/drivers/adc/utest/Kconfig
```kconfig
menu "ADC Test"

config RT_UTEST_ADC
    bool "ADC framework Test"
    default n
    depends on RT_USING_ADC

endmenu
```

## components/drivers/can/Kconfig
```kconfig
menuconfig RT_USING_CAN
    bool "Using CAN device drivers"
    default n
    help
        Enable this option to include the CAN device driver framework.

if RT_USING_CAN

    config RT_CAN_USING_HDR
        bool "Enable CAN hardware filter support"
        default n
        help
            Enable framework-managed hardware filter metadata and callbacks.

    config RT_CAN_USING_CANFD
        bool "Enable CAN-FD support"
        default n
        help
            Enable CAN with Flexible Data-Rate support.

    config RT_CAN_USING_STATUS_POLLING
        bool "Enable periodic CAN status polling"
        default y
        help
            Periodically query RT_CAN_CMD_GET_STATUS and dispatch the status
            indication callback. TX progress does not depend on polling.

    config RT_CANMSG_BOX_SZ
        int "Software RX message box size (in messages)"
        default 16
        help
            Number of CAN frames buffered by the generic RX FIFO.

    config RT_CANSND_BOX_NUM
        int "Number of CAN TX mailboxes"
        default 1
        help
            Number of hardware TX mailboxes visible to blocking Generic CAN TX.

    config RT_CANSND_MSG_TIMEOUT
        int "Timeout for blocking send (in OS ticks)"
        default 100
        range 1 2147483647
        help
            One hard deadline covering mailbox wait, hardware submit and the
            terminal completion wait for one blocking frame. Configure this value
            above the target system's worst-case mailbox contention, CAN bus
            arbitration/transmission and terminal ISR scheduling latency. The
            framework does not auto-extend the timeout or recover a late terminal.

endif

if RT_USING_DM && RT_USING_CAN
    osource "$(SOC_DM_CAN_DIR)/Kconfig"
endif
```

## components/drivers/can/utest/Kconfig
```kconfig
menu "CAN Test"

config RT_UTEST_CAN
    bool "CAN Send and Receive Test"
    default n
    select RT_USING_CAN

if RT_UTEST_CAN

    choice
        prompt "CAN Test Topology"
        default RT_CAN_TC_USING_SELF_LOOPBACK

        config RT_CAN_TC_USING_SELF_LOOPBACK
            bool "Single CAN Self Loopback"
            help
                Use one CAN controller to send and receive its own frame. This
                mode uses CAN loopback configuration and is suitable for boards
                that support controller loopback or TX/RX self-loop wiring.

        config RT_CAN_TC_USING_EXTERNAL_DEVICE
            bool "Single CAN with External CAN Device"
            help
                Use one CAN controller connected through a CAN transceiver to an
                external CAN node. The external node must follow the configured
                transmit and receive frame agreement.

        config RT_CAN_TC_USING_DUAL_DEVICE
            bool "Two Connected CAN Devices"
            help
                Use two CAN controllers connected to the same CAN bus and verify
                frame transfer in both directions.

    endchoice

    config RT_CAN_TC_DEVICE_NAME
        string "Device Name for Single CAN Test"
        default "can1"
        depends on RT_CAN_TC_USING_SELF_LOOPBACK || RT_CAN_TC_USING_EXTERNAL_DEVICE

    config RT_CAN_TC_TX_DEVICE_NAME
        string "TX Device Name for Two CAN Test"
        default "can1"
        depends on RT_CAN_TC_USING_DUAL_DEVICE

    config RT_CAN_TC_RX_DEVICE_NAME
        string "RX Device Name for Two CAN Test"
        default "can2"
        depends on RT_CAN_TC_USING_DUAL_DEVICE

    config RT_CAN_TC_EXTERNAL_USING_SEND_TEST
        bool "Enable External Device Send Test"
        default y
        depends on RT_CAN_TC_USING_EXTERNAL_DEVICE
        help
            Send one standard data frame to the external CAN node. The external
            node should receive standard ID RT_CAN_TC_TX_FRAME_ID with DLC 8 and
            payload 0x10, 0x11, ..., 0x17.

    config RT_CAN_TC_EXTERNAL_USING_RECEIVE_TEST
        bool "Enable External Device Receive Test"
        default y
        depends on RT_CAN_TC_USING_EXTERNAL_DEVICE
        help
            Wait for one standard data frame from the external CAN node. The
            external node should send standard ID RT_CAN_TC_RX_FRAME_ID with DLC
            8 and payload 0x20, 0x21, ..., 0x27.

    config RT_CAN_TC_USING_NONBLOCKING_SEND_TEST
        bool "Enable Nonblocking Send Test"
        default n
        help
            Send one standard data frame with rt_can_msg.nonblocking set to 1.
            Self-loopback and dual-device tests verify the frame end to end.
            The external-device test only verifies that the frame is accepted or
            queued because the common CAN API has no TX-complete wait interface.
            Enable this only when the CAN driver implements sendmsg_nonblocking.

    config RT_CAN_TC_TX_FRAME_ID
        hex "External Device TX Frame ID"
        range 0 0x7FF
        default 0x321
        depends on RT_CAN_TC_USING_EXTERNAL_DEVICE

    config RT_CAN_TC_RX_FRAME_ID
        hex "External Device RX Frame ID"
        range 0 0x7FF
        default 0x322
        depends on RT_CAN_TC_USING_EXTERNAL_DEVICE

    config RT_CAN_TC_NONBLOCKING_TX_FRAME_ID
        hex "Nonblocking TX Frame ID"
        range 0 0x7FF
        default 0x323
        depends on RT_CAN_TC_USING_NONBLOCKING_SEND_TEST

    config RT_CAN_TC_BAUD_RATE
        int "Primary Arbitration Baud Rate for CAN Test"
        range 10000 1000000
        default 500000
        help
            Select one of the standard CAN rates: 10000, 20000, 50000, 100000,
            125000, 250000, 500000, 800000, or 1000000 bit/s. This rate is
            always tested. Self-loopback and dual-device tests can select
            additional rates. The external-device topology uses only this rate
            because the peer cannot be switched automatically.

    menu "Additional Arbitration Baud Rates"
        depends on RT_CAN_TC_USING_SELF_LOOPBACK || RT_CAN_TC_USING_DUAL_DEVICE

        config RT_CAN_TC_TEST_BAUD_RATE_10K
            bool "Test 10 kbit/s"
            default n

        config RT_CAN_TC_TEST_BAUD_RATE_20K
            bool "Test 20 kbit/s"
            default n

        config RT_CAN_TC_TEST_BAUD_RATE_50K
            bool "Test 50 kbit/s"
            default n

        config RT_CAN_TC_TEST_BAUD_RATE_100K
            bool "Test 100 kbit/s"
            default n

        config RT_CAN_TC_TEST_BAUD_RATE_125K
            bool "Test 125 kbit/s"
            default n

        config RT_CAN_TC_TEST_BAUD_RATE_250K
            bool "Test 250 kbit/s"
            default n

        config RT_CAN_TC_TEST_BAUD_RATE_500K
            bool "Test 500 kbit/s"
            default n

        config RT_CAN_TC_TEST_BAUD_RATE_800K
            bool "Test 800 kbit/s"
            default n

        config RT_CAN_TC_TEST_BAUD_RATE_1M
            bool "Test 1 Mbit/s"
            default n

        comment "The primary arbitration rate is always tested"

    endmenu

    config RT_CAN_TC_USING_CANFD
        bool "Enable CAN FD Test"
        depends on RT_CAN_USING_CANFD
        default n
        help
            In addition to classic CAN frames, verify CAN FD frames with an
            extended payload. This is an explicit per-device capability test;
            enable it only for CAN FD capable controllers and drivers. CAN FD
            frames are tested only at the primary arbitration rate.

    config RT_CAN_TC_CANFD_DATA_BAUD_RATE
        int "CAN FD Data Phase Baud Rate"
        range 10000 10000000
        default 2000000
        depends on RT_CAN_TC_USING_CANFD
        help
            The data phase may use the same rate as the arbitration phase.
            Select a higher rate when testing effective bit-rate switching.

    config RT_CAN_TC_CANFD_DATA_LENGTH
        int "Maximum CAN FD Payload Length"
        range 12 64
        default 16
        depends on RT_CAN_TC_USING_CANFD
        help
            Valid CAN FD payload lengths are 12, 16, 20, 24, 32, 48, and 64
            bytes. Other values in the numeric range are rejected at runtime.

    config RT_CAN_TC_CANFD_BRS
        bool "Enable CAN FD Bit Rate Switching"
        default y
        depends on RT_CAN_TC_USING_CANFD

    config RT_CAN_TC_EXTERNAL_READY_DELAY_MS
        int "External Node Ready Delay in Milliseconds"
        range 0 60000
        default 1000
        depends on RT_CAN_TC_USING_EXTERNAL_DEVICE
        help
            Delay after the DUT is configured and prints the frame agreement.
            This gives the external node time to start its ordered frame sequence.

    config RT_CAN_TC_TIMEOUT_MS
        int "RX Timeout in Milliseconds"
        range 1000 60000
        default 10000

endif

endmenu
```
