## components/net/utest/Kconfig
```kconfig
menu "Network"

    config RT_UTEST_TC_USING_SAL
        select RT_USING_SAL
        bool "SAL Unit Testcase"
        default n

    menuconfig RT_UTEST_TC_USING_NETDEV
        select RT_USING_NETDEV
        bool "Netdev API Test"
        help
            Enable netdev network device framework unit tests.
            
            Test coverage includes:
            * Network connectivity (ping operations)
            * DHCP functionality (enable/disable/restore)
            * DNS configuration and hostname resolution
            * Interface configuration (IP/gateway/netmask)
            * IP address conversion functions
            * Device retrieval and management
            * Status control and callback mechanisms

        if RT_UTEST_TC_USING_NETDEV

            config RT_UTEST_DEFAULT_NETDEV_NAME
                string "Default Netdev Name"
                default "e0"
                help
                    Network interface name for tests. Common values:
                    "e0" (Ethernet), "w0" (Wireless).
                    Ensure the device exists in your environment.
        endif

    menuconfig RT_UTEST_TC_USING_LWIP
        select RT_USING_LWIP
        select RT_LWIP_NETIF_LOOPBACK
        bool "lwIP Unit Testcase"
        default n
        help
            Enable lwIP network stack unit tests including DNS resolution,
            TCP/UDP socket operations, and network interface tests

        if RT_UTEST_TC_USING_LWIP

            config RT_UTEST_LWIP_DNS_TEST
                bool "DNS Resolution Test"
                default y
                help
                    Enable DNS resolution unit tests including gethostbyname()
                    and gethostbyname_r() functions for hostname to IP resolution,
                    as well as getaddrinfo() and freeaddrinfo() for address info
                    retrieval and release. Tests verify successful resolution
                    without hardcoded IP comparisons.

            config RT_UTEST_LWIP_TCP_TEST
                bool "TCP Socket Test"
                default y
                help
                    Enable TCP socket unit tests including client-server communication
                    with echo functionality, socket creation, binding, listening,
                    accepting connections, data transmission with varying buffer sizes,
                    socket options (TCP_NODELAY, SO_REUSEADDR, SO_REUSEPORT),
                    and connection management (shutdown, close).

            config RT_UTEST_LWIP_UDP_TEST
                bool "UDP Socket Test"
                default y
                help
                    Enable UDP socket unit tests including datagram transmission
                    and reception, client-server echo communication, socket binding
                    to any port, select() operations with timeout, recvfrom/sendto
                    functions, and timeout handling for receive operations.

            config RT_UTEST_LWIP_ICMP_TEST
                bool "ICMP Ping Test"
                default y
                help
                    Enable ICMP ping unit tests using raw sockets to send
                    ICMP echo requests and receive echo replies. Tests verify
                    basic ICMP functionality with loopback address (127.0.0.1).

            config RT_UTEST_LWIP_SOCKET_OPT_TEST
                bool "Socket Options Test"
                default y
                help
                    Enable socket options unit tests including setsockopt()
                    and getsockopt() functions. Tests verify setting and
                    retrieving socket options such as SO_REUSEADDR.

            config RT_UTEST_LWIP_ADDR_CONV_TEST
                bool "Address Conversion Test"
                default y
                help
                    Enable address conversion unit tests including inet_addr()
                    for converting string IP addresses to binary format and
                    inet_ntoa() for converting binary addresses back to strings.
                    Tests verify proper conversion functionality.

            config RT_UTEST_LWIP_NETIF_TEST
                bool "Network Interface Management Test"
                default y
                help
                    Enable network interface management unit tests including
                    netif_set_up(), netif_set_down(), and netif_set_default()
                    functions. Tests verify interface state changes and
                    default interface configuration.

            config RT_UTEST_LWIP_TCP_PORT
                int "TCP Test Port"
                default 1234
                range 1024 65535
                help
                    Configure the TCP port number for unit test communication.
                    Must be in the range 1024-65535 to avoid system ports

            config RT_UTEST_LWIP_UDP_PORT
                int "UDP Test Port"
                default 1235
                range 1024 65535
                help
                    Configure the UDP port number for unit test communication.
                    Must be in the range 1024-65535 to avoid system ports

            config RT_UTEST_LWIP_TEST_URL
                string "Test Domain Name"
                default "www.rt-thread.org"
                help
                    Configure the domain name for DNS resolution tests.
                    This domain will be resolved to verify DNS functionality

            config RT_UTEST_LWIP_TEST_ADDR
                string "Expected IP Address"
                default "180.163.146.111"
                help
                    Configure the expected IP address for DNS resolution verification.
                    This should match the actual IP of the test domain

        endif

endmenu
```

## components/rust/Kconfig
```kconfig
menuconfig RT_USING_RUST
    bool "Enable Rust component support"
    default n
    help
        Enable Rust programming language support for RT-Thread.
        This allows you to write RT-Thread components using Rust.

if RT_USING_RUST
    config RT_RUST_CORE
        bool "Enable Rust Core Library"
        default y
    config RUST_DEBUG_BUILD
        bool "Build Rust code in debug mode"
        default n
        help
            Build Rust code with debug symbols and without optimizations.
            This increases binary size but helps with debugging.
    config RUST_INIT_COMPONENT
        bool "Auto-initialize Rust component"
        default y
        help
            Automatically initialize Rust component during RT-Thread startup.

    rsource "examples/Kconfig"

endif
```

## components/rust/examples/Kconfig
```kconfig
menuconfig RT_USING_RUST_EXAMPLES
    bool "Enable Rust Examples"
    depends on RT_USING_RUST
    default n
    help
        Enable Rust example applications, components, and modules.

if RT_USING_RUST_EXAMPLES

    config RT_RUST_BUILD_ALL_EXAMPLES
        bool "Build All Examples"
        default n
        help
            Build all available Rust examples.

    menu "Application Examples"
        config RT_RUST_BUILD_APPLICATIONS
            bool "Build Application Examples"
            default y
            depends on RT_USING_FINSH
            help
                Build Rust application examples.

        if RT_RUST_BUILD_APPLICATIONS
            config RT_RUST_EXAMPLE_FS
                bool "File System Example"
                default n
                help
                    File system operations example.

            config RT_RUST_EXAMPLE_LOADLIB
                bool "Dynamic Library Loading Example"
                default n
                depends on RT_USING_MODULE
                help
                    Dynamic library loading and usage example.

            config RT_RUST_EXAMPLE_MUTEX
                bool "Mutex Example"
                default y
                help
                    Mutex synchronization example.

            config RT_RUST_EXAMPLE_PARAM
                bool "Parameter Example"
                default y
                help
                    Basic parameter handling example.

            config RT_RUST_EXAMPLE_QUEUE
                bool "Queue Example"
                default y
                help
                    Message queue example.

            config RT_RUST_EXAMPLE_SEMAPHORE
                bool "Semaphore Example"
                default y
                help
                    Semaphore synchronization example.

            config RT_RUST_EXAMPLE_THREAD
                bool "Thread Example"
                default y
                help
                    Thread creation and management example.
        endif
    endmenu

    menu "Component Examples"
        config RT_RUST_BUILD_COMPONENTS
            bool "Build Component Examples"
            default y
            help
                Build Rust component examples.

        if RT_RUST_BUILD_COMPONENTS
            config RUST_LOG_COMPONENT
                bool "Auto-initialize Rust log component"
                default y
                help
                    Automatically initialize Rust log component during RT-Thread startup.
        endif
    endmenu

    menu "Module Examples"
        config RT_RUST_BUILD_MODULES
            bool "Build Module Examples"
            default n
            depends on RT_USING_MODULE
            help
                Build Rust dynamic module examples.

        if RT_RUST_BUILD_MODULES
            config RT_RUST_MODULE_SIMPLE_MODULE
                bool "Simple Module"
                default y
                help
                    Basic dynamic module template.

        endif
    endmenu

endif
```
