## bsp/raspberry-pi/dm/firmware/Kconfig
```kconfig
config RT_FIRMWARE_RASPBERRYPI
    bool "Raspberrypi Firmware"
    depends on RT_USING_OFW
    depends on RT_USING_MBOX
    depends on RT_USING_DMA
    default n
```

## bsp/raspberry-pi/dm/graphic/backlight/Kconfig
```kconfig
config RT_GRAPHIC_BACKLIGHT_RPI
    bool "Raspberry Pi display firmware driven backlight"
    depends on RT_GRAPHIC_BACKLIGHT
    depends on RT_FIRMWARE_RASPBERRYPI
    default n
```

## bsp/raspberry-pi/dm/graphic/framebuffer/Kconfig
```kconfig
config RT_GRAPHIC_FB_BCM2708
    bool "BCM2708 framebuffer support"
    depends on RT_FIRMWARE_RASPBERRYPI
    default n

config RT_GRAPHIC_FB_RPISENSE
    bool "Raspberry Pi Sense HAT framebuffer"
    depends on RT_MFD_RPI_SENSE
    default n
```

## bsp/raspberry-pi/dm/graphic/logo/Kconfig
```kconfig
config RT_GRAPHIC_LOGO_RASPI_CLUT224
    bool "Standard 224-color Raspberry PI logo"
```

## bsp/raspberry-pi/dm/graphic/logo/Kconfig.path
```kconfig
if RT_GRAPHIC_LOGO_RASPI_CLUT224
    config RT_GRAPHIC_LOGO_RASPI_CLUT224_PATH
        string
        default "../dm/graphic/logo/logo-raspi-clut224.ppm"
endif
```

## bsp/raspberry-pi/dm/hwcrypto/Kconfig
```kconfig
config RT_HWCRYPTO_RNG_BCM2835
    bool "Broadcom BCM2835/BCM63xx Random Number Generator support"
    depends on RT_USING_DM
    depends on RT_USING_HWCRYPTO
    depends on RT_HWCRYPTO_USING_RNG
    depends on RT_USING_RESET
    default n

config RT_HWCRYPTO_RNG_IPROC_RNG200
    bool "Broadcom iProc/STB RNG200 support"
    depends on RT_USING_DM
    depends on RT_USING_HWCRYPTO
    depends on RT_HWCRYPTO_USING_RNG
    default n
```

## bsp/raspberry-pi/dm/i2c/Kconfig
```kconfig
config RT_I2C_BCM2835
    bool "Broadcom BCM2835 I2C controller"
    depends on RT_USING_PINCTRL
    default n

config RT_I2C_BRCMSTB
    bool "BRCM Settop/DSL I2C controller"
    depends on RT_USING_PINCTRL
    default n
```

## bsp/raspberry-pi/dm/input/joystick/Kconfig
```kconfig
config RT_INPUT_JOYSTICK_RPISENSE
    bool "Raspberry Pi Sense HAT joystick"
    depends on RT_INPUT_JOYSTICK
    depends on RT_MFD_RPI_SENSE
    default n
```

## bsp/raspberry-pi/dm/input/touchscreen/Kconfig
```kconfig
config RT_INPUT_TOUCHSCREEN_RASPBERRYPI_FW
    bool "Raspberry Pi's firmware base touch screen support"
    depends on RT_INPUT_TOUCHSCREEN
    depends on RT_USING_OFW
    depends on RT_USING_DMA
    depends on RT_FIRMWARE_RASPBERRYPI
    depends on RT_USING_ADT
    depends on RT_USING_ADT_BITMAP
    default n
```

## bsp/raspberry-pi/dm/mfd/Kconfig
```kconfig
config RT_MFD_BCM2835_PM
    bool "BCM2835 PM driver"
    depends on RT_USING_MFD
    default n

config RT_MFD_RP1
    bool "Raspberry Pi RP1 MFD driver"
    depends on RT_USING_MFD
    depends on RT_USING_PCI
    default n

config RT_MFD_RPI_SENSE
    bool "Raspberry Pi Sense HAT core functions"
    depends on RT_USING_MFD
    depends on RT_USING_I2C
    depends on RT_USING_OFW
    depends on RT_USING_PIN
    default n
```

## bsp/raspberry-pi/dm/nvmem/Kconfig
```kconfig
config RT_NVMEM_RASPBERRYPI_OTP
    bool "Raspberry Pi OTP support"
    depends on RT_USING_NVMEM
    default n
```

## bsp/raspberry-pi/dm/pci/Kconfig
```kconfig
config RT_PCIE_BRCMSTB
    bool "Broadcom Brcmstb PCIe controller"
    depends on RT_PCI_MSI
    depends on RT_USING_OFW
    default n
```

## bsp/raspberry-pi/dm/phy/Kconfig
```kconfig
config RT_PHY_MDIO_BCM_UNIMAC
    bool "Broadcom UniMAC MDIO bus controller (BCM2711 GENET)"
    default n

config RT_PHY_BCM54213
    bool "Broadcom BCM54213PE Ethernet PHY (Pi4/Pi5 RJ45)"
    default n
```

## bsp/raspberry-pi/dm/pic/Kconfig
```kconfig
config RT_PIC_BCM2712_MIP
    bool "Broadcom 2712 MSI-X Interrupt Peripheral support" if RT_PCI_MSI
    depends on RT_USING_OFW
    default n

config RT_PIC_BCM2835_INTC
    bool "BCM2835 intc"
    depends on RT_USING_OFW
    default n

config RT_PIC_BCM2836_L1_INTC
    bool "BCM2836 L1 intc"
    depends on RT_USING_OFW
    default n

config RT_PIC_BRCMSTB_L2_IRQ
    bool "BRCMSTB L2 IRQ"
    depends on RT_USING_OFW
    default n
```

## bsp/raspberry-pi/dm/pin/Kconfig
```kconfig
config RT_PIN_BCM_VIRT
    bool "Broadcom Virt GPIO support"
    depends on RT_USING_PIN
    default n

config RT_PIN_BRCMSTB
    bool "BRCMSTB GPIO support"
    depends on RT_USING_PIN
    default n

config RT_PIN_RASPBERRYPI_EXP
    bool "Raspberry Pi 3 GPIO Expander"
    depends on RT_USING_PIN
    depends on RT_FIRMWARE_RASPBERRYPI
    default n
```

## bsp/raspberry-pi/dm/pinctrl/Kconfig
```kconfig
config RT_PINCTRL_BCM2712
    bool "Broadcom BCM2712 PINCONF driver"
    depends on RT_USING_PINCTRL
    default n

config RT_PINCTRL_BCM2835
    bool "Broadcom BCM2835 GPIO (with PINCONF) driver"
    depends on RT_USING_PINCTRL
    default n

config RT_PINCTRL_RP1
    bool "Pinctrl driver for RP1"
    depends on RT_USING_PINCTRL
    default n
```

## bsp/raspberry-pi/dm/pmdomain/Kconfig
```kconfig
config RT_PMDOMAIN_BCM2835
    bool "BCM2835"
    depends on RT_USING_RESET
    default n

config RT_PMDOMAIN_RASPBERRYPI
    bool "Raspberrypi"
    default n
```

## bsp/raspberry-pi/dm/pwm/Kconfig
```kconfig
config RT_PWM_BCM2835
    bool "BCM2835 PWM support"
    depends on RT_USING_PINCTRL
    depends on RT_USING_DM
    depends on RT_USING_PWM
    default n

config RT_PWM_BRCMSTB
    bool "Broadcom STB PWM support"
    depends on RT_USING_PINCTRL
    depends on RT_USING_DM
    depends on RT_USING_PWM
    default n

config RT_PWM_RP1
    bool "RP1 PWM support"
    depends on RT_USING_PINCTRL
    depends on RT_USING_DM
    depends on RT_USING_PWM
    default n
```

## bsp/raspberry-pi/dm/reset/Kconfig
```kconfig
config RT_RESET_BRCMSTB_RESCAL
    bool "Broadcom STB RESCAL reset controller"
    depends on RT_USING_RESET
    default n

config RT_RESET_BRCMSTB
    bool "Broadcom STB reset controller"
    depends on RT_USING_RESET
    default n

config RT_RESET_RASPBERRYPI
    bool "Raspberry Pi 4 Firmware Reset Driver"
    depends on RT_USING_RESET
    depends on RT_FIRMWARE_RASPBERRYPI
    default n
```

## bsp/raspberry-pi/dm/rtc/Kconfig
```kconfig
config RT_RTC_RPI
    bool "Raspberry Pi RTC"
    depends on RT_FIRMWARE_RASPBERRYPI
    select RT_USING_ALARM
    default n
```

## bsp/raspberry-pi/dm/sdio/Kconfig
```kconfig
config RT_SDIO_SDHCI_BRCMSTB
    bool "Broadcom SDIO/SD/MMC"
    depends on RT_USING_SDIO
    select RT_USING_SDHCI

config RT_SDIO_SDHCI_IPROC
    bool "BCM2835 & iProc SD/MMC Controller"
    depends on RT_USING_SDIO
    select RT_USING_SDHCI
```

## bsp/raspberry-pi/dm/serial/Kconfig
```kconfig
config RT_SERIAL_8250_BCM2835AUX
    bool "BCM2835 auxiliar mini UART"
    depends on RT_SERIAL_8250
    default n

config RT_SERIAL_8250_BCM7271
    bool "Broadcom 8250 based serial port"
    depends on RT_SERIAL_8250
    depends on RT_USING_DMA
    depends on RT_SERIAL_USING_DMA
    default n
```

## bsp/raspberry-pi/dm/soc/Kconfig
```kconfig
config RT_SOC_BROADCOM_RASPBERRYPI_VOLTAGE_MONITOR
    bool "Raspberry Pi voltage monitor"
    depends on RT_FIRMWARE_RASPBERRYPI
    select RT_USING_DEVICE_IPC
    select RT_USING_SYSTEM_WORKQUEUE
    default y
```

## bsp/raspberry-pi/dm/spi/Kconfig
```kconfig
config RT_SPI_BCM2835
    bool "BCM2835 SPI controller"
    depends on RT_USING_DM
    depends on RT_USING_SPI
    depends on RT_USING_PIN
    depends on RT_USING_PINCTRL
    default n

config RT_SPI_BCM2835AUX
    bool "BCM2835 SPI auxiliary controller"
    depends on RT_USING_DM
    depends on RT_USING_SPI
    depends on RT_USING_PIN
    depends on RT_USING_PINCTRL
    default n
```
