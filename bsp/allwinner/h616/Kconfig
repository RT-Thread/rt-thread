## bsp/gd32/arm/gd32h77d-ginopi/board/Kconfig
```kconfig
menu "Hardware Drivers Config"

config SOC_SERIES_GD32H77x_H78X
    bool
    default y

config SOC_GD32H77DIW
    bool
    select SOC_SERIES_GD32H77x_H78X
    select RT_USING_COMPONENTS_INIT
    select RT_USING_USER_MAIN
    default y

menu "Onboard Peripheral Drivers"

    menuconfig BSP_USING_FS
        bool "Enable File System"
        select RT_USING_DFS
        select RT_USING_DFS_ROMFS
        default n

        if BSP_USING_FS
            config BSP_USING_SDCARD_FATFS
                bool "Enable SDCARD (FATFS)"
                select BSP_SDIO_USING_SDIO1
                select RT_USING_DFS_ELMFAT
                default n

            if BSP_USING_SDCARD_FATFS
                config BSP_USING_FS_AUTO_MOUNT
                    bool "Enable filesystem auto mount"
                    default y
            endif

            config BSP_USING_FLASH_FATFS
                bool "Enable FAL filesystem partition based on GD25Q64ESIG"
                select BSP_USING_OSPI0
                select RT_USING_FAL
                select FAL_PART_HAS_TABLE_CFG
                select RT_USING_DFS_ELMFAT
                default n
                help
                    Enable the onboard 8 MiB GD25Q64ESIG in Quad SPI mode and
                    expose its filesystem partition through FAL. FatFs maximum
                    sector size must be 4096.

            if BSP_USING_FLASH_FATFS
                config BSP_OSPI_FLASH_MAX_HZ
                    int "Maximum QSPI flash clock (Hz)"
                    range 1000000 100000000
                    default 50000000

                config BSP_USING_FLASH_FS_AUTO_MOUNT
                    bool "Enable filesystem auto mount"
                    default y
            endif
        endif

    menuconfig BSP_USING_ETH
        bool "Enable ENET1 (RMII)"
        select RT_USING_LWIP
        select RT_USING_SAL
        default n
        help
            Enable ENET1 in RMII mode. The PHY must provide the 50 MHz RMII
            reference clock on PC12.

        if BSP_USING_ETH
            config BSP_ENET_PHY_ADDR
                int "Default PHY address"
                range 0 31
                default 2
        endif

    config BSP_USING_SDRAM
        bool "Enable SDRAM"
        select RT_USING_SDRAM
        default n
        help
            Enable the onboard 32 MiB, 16-bit SDRAM connected to EXMC
            SDRAM device 0.

    menuconfig BSP_USING_LCD_MIPI
        bool "Enable 720x720 MIPI DSI LCD"
        select BSP_USING_SDRAM
        select BSP_USING_GPIO
        select BSP_USING_PWM
        select BSP_USING_PWM1
        select RT_USING_LCD
        default n
        help
            Enable the two-lane MIPI DSI LCD using the FL7707N controller.
            The RGB565 framebuffer occupies the start of the onboard SDRAM.
            Backlight brightness uses TIMER1 channel 0 on PA0.

    config BSP_USING_TOUCH_GT911
        bool "Enable GT911 capacitive touch"
        depends on BSP_USING_LCD_MIPI
        select BSP_USING_I2C
        select BSP_USING_HARD_I2C
        select BSP_USING_HARD_I2C3
        select RT_USING_TOUCH
        select RT_TOUCH_PIN_IRQ
        select PKG_USING_GT911
        default n
        help
            Enable the GT911 package driver on I2C3. PH3 drives the dedicated
            active-low reset input and PH5 selects the default 0x5D address
            during reset, then works as the touch interrupt input.

    config BSP_USING_OV7670
        bool "Enable OV7670 camera"
        depends on !BSP_USING_PWM0
        depends on !BSP_UART0_TX_USING_DMA && !BSP_UART5_TX_USING_DMA
        select BSP_USING_GPIO
        select BSP_USING_I2C
        select BSP_USING_HARD_I2C
        select BSP_USING_HARD_I2C2
        default n
        help
            Enable the onboard OV7670 on I2C2 and capture QVGA RGB565 frames
            through DCI and DMA1 channel 7. Camera XCLK is generated by
            TIMER0 channel 0 on PE9.

    menuconfig BSP_USING_USB
        bool "Enable USB"
        default n
        help
            Enable the onboard USB Type-C device port and/or USB-A host port.

        if BSP_USING_USB
            config BSP_USB_USING_DEVICE
                bool "Enable USBHS0 device (Type-C)"
                default y
                select RT_USING_USB_DEVICE
                select RT_USB_DEVICE_COMPOSITE
                select RT_USB_DEVICE_CDC

            config BSP_USB_USING_HOST
                bool "Enable USBHS1 host (USB-A)"
                default n
                select RT_USING_USB_HOST

            if BSP_USB_USING_DEVICE
                choice
                    prompt "USBHS0 device speed"
                    default BSP_USB_DEVICE_USING_HS

                    config BSP_USB_DEVICE_USING_HS
                        bool "High speed"

                    config BSP_USB_DEVICE_USING_FS
                        bool "Full speed"
                endchoice
            endif
        endif

endmenu

menu "On-chip Peripheral Drivers"

    config BSP_USING_GPIO
        bool "Enable GPIO"
        select RT_USING_PIN
        default y

    menuconfig BSP_USING_UART
        bool "Enable UART"
        default y
        if BSP_USING_UART
            choice BSP_SERIAL_V_SEL
                prompt "Select UART framework version"
                default BSP_USING_SERIAL_V1

                config BSP_USING_SERIAL_V1
                    bool "Use Serial V1 framework"
                    select RT_USING_SERIAL

                config BSP_USING_SERIAL_V2
                    bool "Use Serial V2 framework"
                    select RT_USING_SERIAL_V2
            endchoice

            menuconfig BSP_USING_UART0
                bool "Enable UART0"
                default n
                if BSP_USING_UART0
                    config BSP_UART0_TX_PIN
                        string "UART0 TX name, such as PA8"
                        default "PF4"

                    config BSP_UART0_RX_PIN
                        string "UART0 RX name, such as PA9"
                        default "PF5"

                    config BSP_UART0_AFIO
                        string "UART0 alternate function, such as AF7"
                        default "AF4"

                    if BSP_USING_SERIAL_V2
                        config BSP_UART0_RX_USING_DMA
                            bool "Enable UART0 RX DMA"
                            depends on RT_SERIAL_USING_DMA
                            default n

                        config BSP_UART0_TX_USING_DMA
                            bool "Enable UART0 TX DMA"
                            depends on RT_SERIAL_USING_DMA
                            default n

                        config BSP_UART0_DMA_PING_BUFSIZE
                            int "Set UART0 RX DMA ping-pong buffer size"
                            range 16 65535
                            depends on BSP_UART0_RX_USING_DMA
                            default 64

                        config BSP_UART0_RX_BUFSIZE
                            int "Set UART0 RX buffer size"
                            range 64 65535
                            default 128

                        config BSP_UART0_TX_BUFSIZE
                            int "Set UART0 TX buffer size"
                            range 0 65535
                            default 128
                    endif
                endif

            menuconfig BSP_USING_UART1
                bool "Enable UART1"
                default y
                if BSP_USING_UART1
                    config BSP_UART1_TX_PIN
                        string "UART1 TX name, such as PA8"
                        default "PA2"

                    config BSP_UART1_RX_PIN
                        string "UART1 RX name, such as PA9"
                        default "PA3"

                    config BSP_UART1_AFIO
                        string "UART1 alternate function, such as AF7"
                        default "AF7"

                    if BSP_USING_SERIAL_V2
                        config BSP_UART1_RX_USING_DMA
                            bool "Enable UART1 RX DMA"
                            depends on RT_SERIAL_USING_DMA
                            default n

                        config BSP_UART1_TX_USING_DMA
                            bool "Enable UART1 TX DMA"
                            depends on RT_SERIAL_USING_DMA
                            default n

                        config BSP_UART1_DMA_PING_BUFSIZE
                            int "Set UART1 RX DMA ping-pong buffer size"
                            range 16 65535
                            depends on BSP_UART1_RX_USING_DMA
                            default 64

                        config BSP_UART1_RX_BUFSIZE
                            int "Set UART1 RX buffer size"
                            range 64 65535
                            default 128

                        config BSP_UART1_TX_BUFSIZE
                            int "Set UART1 TX buffer size"
                            range 0 65535
                            default 128
                    endif
                endif

            menuconfig BSP_USING_UART2
                bool "Enable UART2"
                default n
                if BSP_USING_UART2
                    config BSP_UART2_TX_PIN
                        string "UART2 TX name, such as PA8"
                        default "PB10"

                    config BSP_UART2_RX_PIN
                        string "UART2 RX name, such as PA9"
                        default "PB11"

                    config BSP_UART2_AFIO
                        string "UART2 alternate function, such as AF7"
                        default "AF7"

                    if BSP_USING_SERIAL_V2
                        config BSP_UART2_RX_USING_DMA
                            bool "Enable UART2 RX DMA"
                            depends on RT_SERIAL_USING_DMA
                            default n

                        config BSP_UART2_TX_USING_DMA
                            bool "Enable UART2 TX DMA"
                            depends on RT_SERIAL_USING_DMA
                            default n

                        config BSP_UART2_DMA_PING_BUFSIZE
                            int "Set UART2 RX DMA ping-pong buffer size"
                            range 16 65535
                            depends on BSP_UART2_RX_USING_DMA
                            default 64

                        config BSP_UART2_RX_BUFSIZE
                            int "Set UART2 RX buffer size"
                            range 64 65535
                            default 128

                        config BSP_UART2_TX_BUFSIZE
                            int "Set UART2 TX buffer size"
                            range 0 65535
                            default 128
                    endif
                endif

            menuconfig BSP_USING_UART3
                bool "Enable UART3"
                default n
                if BSP_USING_UART3
                    config BSP_UART3_TX_PIN
                        string "UART3 TX name, such as PA8"
                        default "PC10"

                    config BSP_UART3_RX_PIN
                        string "UART3 RX name, such as PA9"
                        default "PC11"

                    config BSP_UART3_AFIO
                        string "UART3 alternate function, such as AF7"
                        default "AF8"

                    if BSP_USING_SERIAL_V2
                        config BSP_UART3_RX_USING_DMA
                            bool "Enable UART3 RX DMA"
                            depends on RT_SERIAL_USING_DMA
                            default n

                        config BSP_UART3_TX_USING_DMA
                            bool "Enable UART3 TX DMA"
                            depends on RT_SERIAL_USING_DMA
                            default n

                        config BSP_UART3_DMA_PING_BUFSIZE
                            int "Set UART3 RX DMA ping-pong buffer size"
                            range 16 65535
                            depends on BSP_UART3_RX_USING_DMA
                            default 64

                        config BSP_UART3_RX_BUFSIZE
                            int "Set UART3 RX buffer size"
                            range 64 65535
                            default 128

                        config BSP_UART3_TX_BUFSIZE
                            int "Set UART3 TX buffer size"
                            range 0 65535
                            default 128
                    endif
                endif

            menuconfig BSP_USING_UART4
                bool "Enable UART4"
                default n
                if BSP_USING_UART4
                    config BSP_UART4_TX_PIN
                        string "UART4 TX name, such as PB12"
                        default "PB12"

                    config BSP_UART4_RX_PIN
                        string "UART4 RX name, such as PB13"
                        default "PB13"

                    config BSP_UART4_AFIO
                        string "UART4 alternate function, such as AF14"
                        default "AF14"

                    if BSP_USING_SERIAL_V2
                        config BSP_UART4_RX_USING_DMA
                            bool "Enable UART4 RX DMA"
                            depends on RT_SERIAL_USING_DMA
                            default n

                        config BSP_UART4_TX_USING_DMA
                            bool "Enable UART4 TX DMA"
                            depends on RT_SERIAL_USING_DMA
                            default n

                        config BSP_UART4_DMA_PING_BUFSIZE
                            int "Set UART4 RX DMA ping-pong buffer size"
                            range 16 65535
                            depends on BSP_UART4_RX_USING_DMA
                            default 64

                        config BSP_UART4_RX_BUFSIZE
                            int "Set UART4 RX buffer size"
                            range 64 65535
                            default 512

                        config BSP_UART4_TX_BUFSIZE
                            int "Set UART4 TX buffer size"
                            range 0 65535
                            default 256
                    endif
                endif
        endif

    menuconfig BSP_USING_I2C
        bool "Enable I2C"
        default n
        if BSP_USING_I2C
            menuconfig BSP_USING_HARD_I2C
                bool "Enable hardware I2C"
                select RT_USING_I2C
                default n
                if BSP_USING_HARD_I2C
                    menuconfig BSP_USING_HARD_I2C1
                        bool "Enable I2C1 hardware bus"
                        default n
                        if BSP_USING_HARD_I2C1
                            config BSP_I2C1_SCL_PIN
                                string "I2C1 SCL pin name, such as PH4"
                                default "PH4"

                            config BSP_I2C1_SDA_PIN
                                string "I2C1 SDA pin name, such as PB11"
                                default "PB11"

                            config BSP_I2C1_AFIO
                                string "I2C1 alternate function, such as AF4"
                                default "AF4"
                        endif

                    menuconfig BSP_USING_HARD_I2C2
                        bool "Enable I2C2 hardware bus"
                        default n
                        if BSP_USING_HARD_I2C2
                            config BSP_I2C2_SCL_PIN
                                string "I2C2 SCL pin name, such as PA8"
                                default "PA8"

                            config BSP_I2C2_SDA_PIN
                                string "I2C2 SDA pin name, such as PC9"
                                default "PC9"

                            config BSP_I2C2_AFIO
                                string "I2C2 alternate function, such as AF4"
                                default "AF4"
                        endif

                    menuconfig BSP_USING_HARD_I2C3
                        bool "Enable I2C3 hardware bus"
                        default n
                        if BSP_USING_HARD_I2C3
                            config BSP_I2C3_SCL_PIN
                                string "I2C3 SCL pin name, such as PD12"
                                default "PD12"

                            config BSP_I2C3_SDA_PIN
                                string "I2C3 SDA pin name, such as PD13"
                                default "PD13"

                            config BSP_I2C3_AFIO
                                string "I2C3 alternate function, such as AF4"
                                default "AF4"
                        endif
                endif
        endif

    menuconfig BSP_USING_SPI
        bool "Enable SPI"
        select RT_USING_SPI
        default n
        if BSP_USING_SPI
            menuconfig BSP_USING_SPI3
                bool "Enable SPI3 hardware bus"
                default n
                if BSP_USING_SPI3
                    config BSP_SPI3_SCK_PIN
                        string "SPI3 SCK pin name, such as PE12"
                        default "PE12"

                    config BSP_SPI3_SCK_AFIO
                        string "SPI3 SCK alternate function, such as AF5"
                        default "AF5"

                    config BSP_SPI3_MISO_PIN
                        string "SPI3 MISO pin name, such as PF0"
                        default "PF0"

                    config BSP_SPI3_MISO_AFIO
                        string "SPI3 MISO alternate function, such as AF1"
                        default "AF1"

                    config BSP_SPI3_MOSI_PIN
                        string "SPI3 MOSI pin name, such as PF1"
                        default "PF1"

                    config BSP_SPI3_MOSI_AFIO
                        string "SPI3 MOSI alternate function, such as AF1"
                        default "AF1"
                endif
        endif

    menuconfig BSP_USING_OSPI0
        bool "Enable OSPI0 (QSPI)"
        select BSP_USING_GPIO
        select RT_USING_SPI
        select RT_USING_QSPI
        default n
        if BSP_USING_OSPI0
            config BSP_OSPI0_USING_MDMA
                bool "Enable OSPI0 MDMA transfer"
                default n

            config BSP_OSPI0_MDMA_CHANNEL
                int "OSPI0 MDMA channel (0-15)"
                range 0 15
                depends on BSP_OSPI0_USING_MDMA
                default 0

            config BSP_OSPI0_CS_PIN
                string "OSPI0 CS pin name, such as PC11"
                default "PC11"

            config BSP_OSPI0_CS_AFIO
                string "OSPI0 CS alternate function, such as AF9"
                default "AF9"

            config BSP_OSPI0_CLK_PIN
                string "OSPI0 CLK pin name, such as PF10"
                default "PF10"

            config BSP_OSPI0_CLK_AFIO
                string "OSPI0 CLK alternate function, such as AF9"
                default "AF9"

            config BSP_OSPI0_D0_PIN
                string "OSPI0/QSPI IO0 pin name, such as PF8"
                default "PF8"

            config BSP_OSPI0_D0_AFIO
                string "OSPI0/QSPI IO0 alternate function, such as AF10"
                default "AF10"

            config BSP_OSPI0_D1_PIN
                string "OSPI0/QSPI IO1 pin name, such as PF9"
                default "PF9"

            config BSP_OSPI0_D1_AFIO
                string "OSPI0/QSPI IO1 alternate function, such as AF10"
                default "AF10"

            config BSP_OSPI0_D2_PIN
                string "OSPI0/QSPI IO2 pin name, such as PF7"
                default "PF7"

            config BSP_OSPI0_D2_AFIO
                string "OSPI0/QSPI IO2 alternate function, such as AF10"
                default "AF10"

            config BSP_OSPI0_D3_PIN
                string "OSPI0/QSPI IO3 pin name, such as PA1"
                default "PA1"

            config BSP_OSPI0_D3_AFIO
                string "OSPI0/QSPI IO3 alternate function, such as AF9"
                default "AF9"

        endif

    menuconfig BSP_SDIO_USING_SDIO1
        bool "Enable SDIO1"
        select BSP_USING_GPIO
        select RT_USING_SDIO
        default n
        if BSP_SDIO_USING_SDIO1
            config BSP_SDIO_CLK_PIN
                string "SDIO CLK pin name, such as PD6"
                default "PD6"

            config BSP_SDIO_CLK_AFIO
                string "SDIO CLK alternate function, such as AF11"
                default "AF11"

            config BSP_SDIO_CMD_PIN
                string "SDIO CMD pin name, such as PD7"
                default "PD7"

            config BSP_SDIO_CMD_AFIO
                string "SDIO CMD alternate function, such as AF11"
                default "AF11"

            config BSP_SDIO_D0_PIN
                string "SDIO D0 pin name, such as PF4"
                default "PF4"

            config BSP_SDIO_D0_AFIO
                string "SDIO D0 alternate function, such as AF10"
                default "AF10"

            config BSP_SDIO_D1_PIN
                string "SDIO D1 pin name, such as PG10"
                default "PG10"

            config BSP_SDIO_D1_AFIO
                string "SDIO D1 alternate function, such as AF11"
                default "AF11"

            config BSP_SDIO_D2_PIN
                string "SDIO D2 pin name, such as PG11"
                default "PG11"

            config BSP_SDIO_D2_AFIO
                string "SDIO D2 alternate function, such as AF10"
                default "AF10"

            config BSP_SDIO_D3_PIN
                string "SDIO D3 pin name, such as PG12"
                default "PG12"

            config BSP_SDIO_D3_AFIO
                string "SDIO D3 alternate function, such as AF10"
                default "AF10"

            config BSP_SDIO_USING_CARD_DETECT
                bool "Enable SD card detect pin"
                default y

            if BSP_SDIO_USING_CARD_DETECT
                config BSP_SDIO_CD_PIN
                    string "SD card detect pin name, such as PE10"
                    default "PE10"

                config BSP_SDIO_CD_ACTIVE_LOW
                    bool "SD card detect is active low"
                    default y
            endif
        endif

    menuconfig BSP_USING_CAN
        bool "Enable CAN"
        select BSP_USING_GPIO
        select RT_USING_CAN
        default n
        if BSP_USING_CAN
            menuconfig BSP_USING_CAN1
                bool "Enable CAN1"
                default n
                if BSP_USING_CAN1
                    config BSP_CAN1_TX_PIN
                        string "CAN1 TX pin name, such as PB4"
                        default "PB4"

                    config BSP_CAN1_RX_PIN
                        string "CAN1 RX pin name, such as PB5"
                        default "PB5"

                    config BSP_CAN1_TX_AFIO
                        string "CAN1 TX alternate function, such as AF4"
                        default "AF4"

                    config BSP_CAN1_RX_AFIO
                        string "CAN1 RX alternate function, such as AF9"
                        default "AF9"
                endif
        endif

    menuconfig BSP_USING_PWM
        bool "Enable PWM"
        select BSP_USING_GPIO
        select RT_USING_PWM
        default n
        if BSP_USING_PWM
            menuconfig BSP_USING_PWM1
                bool "Enable TIMER1 PWM"
                default n
                help
                    TIMER1 CH0 on PA0 is exposed as channel 1 of the pwm1
                    device and is used by the LCD backlight.

            menuconfig BSP_USING_PWM2
                bool "Enable TIMER2 PWM"
                default n
                help
                    TIMER2 CH1 is exposed as channel 2 of the pwm2 device.
                if BSP_USING_PWM2
                    config BSP_PWM2_CH1_PIN
                        string "TIMER2 CH1 pin name, such as PA7"
                        default "PA7"

                    config BSP_PWM2_CH1_AFIO
                        string "TIMER2 CH1 alternate function, such as AF2"
                        default "AF2"
                endif

            menuconfig BSP_USING_PWM30
                bool "Enable TIMER30 PWM"
                default n
                help
                    TIMER30 CH2 is exposed as channel 3 of the pwm30 device.
                if BSP_USING_PWM30
                    config BSP_PWM30_CH2_PIN
                        string "TIMER30 CH2 pin name, such as PG7"
                        default "PG7"

                    config BSP_PWM30_CH2_AFIO
                        string "TIMER30 CH2 alternate function, such as AF4"
                        default "AF4"
                endif
        endif

    menuconfig BSP_USING_ONCHIP_RTC
        bool "Enable RTC"
        select RT_USING_RTC
        default n
        if BSP_USING_ONCHIP_RTC
            config BSP_USING_ALARM
                bool "Enable RTC alarm"
                select RT_USING_ALARM
                default n
            if BSP_USING_ALARM
                choice BSP_ALARM_SEL
                    prompt "Select rtc alarm device"
                    default BSP_USING_ALARM0

                    config BSP_USING_ALARM0
                        bool "Enable RTC Alarm0"

                    config BSP_USING_ALARM1
                        bool "Enable RTC Alarm1"
                endchoice
            endif
        endif

    source "$(BSP_DIR)/../libraries/gd32_drivers/Kconfig"

endmenu

menu "Board extended module Drivers"

    config AT_DEVICE_USING_GD32VW553
        bool
        default n

    config AT_DEVICE_GD32VW553_SOCKET
        bool
        select AT_USING_SOCKET
        default n

    menuconfig BSP_USING_GD32VW553_AT
        bool "Enable GD32VW553 AT Wi-Fi module"
        select BSP_USING_GPIO
        select BSP_USING_UART
        select BSP_USING_UART4
        select PKG_USING_AT_DEVICE
        select AT_DEVICE_USING_GD32VW553
        select AT_DEVICE_GD32VW553_SOCKET
        default n
        help
            Enable the onboard GD32VW553 Wi-Fi module through the RT-Thread
            at_device and AT socket framework. The default AT UART is UART4
            TX PB12 AF14 and RX PB13 AF14. The reset pin is PC5 and is
            active low.

        if BSP_USING_GD32VW553_AT

            config BSP_GD32VW553_AT_BAUDRATE
                int "GD32VW553 AT UART baud rate"
                range 9600 2000000
                default 115200

            config BSP_GD32VW553_WIFI_SSID
                string "Wi-Fi SSID"
                default "rtthread"

            config BSP_GD32VW553_WIFI_PASSWORD
                string "Wi-Fi password"
                default "12345678"

        endif

endmenu

endmenu
```
