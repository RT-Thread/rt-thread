## bsp/rockchip/common/drivers/Kconfig
```kconfig
menu "RT-Thread rockchip common drivers"

config RT_USING_RESET
    bool "Enable reset support"

config RT_USING_CACHE
    bool "Enable cache"
    default y

config RT_USING_UNCACHE_HEAP
    bool "Enable uncache heap"
    select RT_USING_MEMHEAP
    default n

    if RT_USING_UNCACHE_HEAP && ARCH_ARM_CORTEX_M
    config RT_UNCACHE_HEAP_ORDER
        hex "For MCU uncache heap size(0x0D=16KB, 0x0E=32KB, 0x0F=64KB)"
        range 0x0D 0x10
        depends on RT_USING_UNCACHE_HEAP
        default 0x0E
        help
            set uncache heap size, it in tail of sram
            Examples:
                0x0D   =>   16KB
                0x0E   =>   32KB
                0x0F   =>   64KB
                0x10   =>   128KB
    endif

config RT_USING_LARGE_HEAP
    bool "Enable large heap"
    select RT_USING_MEMHEAP
    default n

    if RT_USING_LARGE_HEAP
    config RT_LARGE_MALLOC_THRRESH
        int "large heap malloc threshold"
        default 512
        depends on RT_USING_LARGE_HEAP
        help
            the memory will allocate in large heap while the allocated size over this

    config RT_LARGE_HEAP_SIZE
        int "large heap size"
        default 524288
        depends on RT_USING_LARGE_HEAP
        help
            the remaining memory must be able to accommodate this heap

    endif

config RT_USING_PM_RUNTIME
    bool "Enable pm runtime"
    default n

endmenu
```

## bsp/rockchip/dm/adc/Kconfig
```kconfig
config RT_ADC_ROCKCHIP_SARADC
    bool "Rockchip SARADC driver"
    depends on RT_USING_ADC
    depends on RT_USING_RESET
    depends on RT_USING_REGULATOR
    default n
```

## bsp/rockchip/dm/can/Kconfig
```kconfig
config RT_CAN_CANFD_ROCKCHIP
    bool "Rockchip CANFD controller"
    depends on RT_CAN_USING_CANFD
    depends on RT_USING_RESET
    select RT_USING_DEVICE_IPC
    select RT_USING_SYSTEM_WORKQUEUE
    default n
```

## bsp/rockchip/dm/clk/Kconfig
```kconfig
menuconfig RT_CLK_ROCKCHIP_RK8XX_CLKOUT
    bool "Clock driver for RK805/RK808/RK809/RK817/RK818"
    depends on RT_MFD_RK8XX
    depends on RT_USING_OFW
    default n

menuconfig RT_CLK_ROCKCHIP_LINK
    bool "Rockchip link clock controller"
    depends on RT_USING_OFW
    default y

menuconfig RT_CLK_ROCKCHIP
    bool "Rockchip clock controller common"
    depends on RT_USING_OFW
    depends on RT_USING_RESET
    default y

config RT_CLK_ROCKCHIP_RK3308
    bool "Rockchip RK3308 clock controller support"
    depends on RT_CLK_ROCKCHIP
    default n

config RT_CLK_ROCKCHIP_RK3568
    bool "Rockchip RK3568 clock controller support"
    depends on RT_CLK_ROCKCHIP
    default n

config RT_CLK_ROCKCHIP_RK3576
    bool "Rockchip RK3576 clock controller support"
    depends on RT_CLK_ROCKCHIP
    default n

config RT_CLK_ROCKCHIP_RK3588
    bool "Rockchip RK3588 clock controller support"
    depends on RT_CLK_ROCKCHIP
    default n
```

## bsp/rockchip/dm/dvfs/cpufreq/Kconfig
```kconfig
config RT_DVFS_ROCKCHIP_CPUFREQ
    bool "Rockchip CPUfreq driver"
    depends on RT_USING_DVFS
    depends on RT_USING_OFW
    default y
    help
      Rockchip CPUfreq with OPP table parsing and optional nvmem
      bin/leakage voltage selection. Uses SCMI clock and DT cpu-supply
      regulator (e.g. FAN53555). Thermal throttling uses
      thermal-cool-dvfs on the cpufreq device.
```

## bsp/rockchip/dm/dvfs/devfreq/Kconfig
```kconfig
config RT_DVFS_ROCKCHIP_DMC
    bool "Rockchip DMC devfreq (DFI event test stub)"
    depends on RT_USING_DVFS
    depends on RT_USING_DVFS_EVENT
    select RT_DVFS_EVENT_ROCKCHIP_DFI
    default n
    help
        Minimal devfreq on the DMC node to bind DFI event and verify
        devfreq_load_from_event. Does not perform ATF/SIP DDR scaling.
```

## bsp/rockchip/dm/dvfs/event/Kconfig
```kconfig
config RT_DVFS_EVENT_ROCKCHIP_DFI
    bool "Rockchip DFI Devfreq event driver"
    depends on RT_USING_DVFS_EVENT
    default n
```

## bsp/rockchip/dm/hwspinlock/Kconfig
```kconfig
config RT_HWSPINLOCK_ROCKCHIP
    bool "Rockchip Hardware Spinlock device"
    default n
```

## bsp/rockchip/dm/hwtimer/Kconfig
```kconfig
config RT_CLOCK_TIMER_ROCKCHIP
    bool "RockChip Timer"
    depends on RT_USING_DM
    depends on RT_USING_CLOCK_TIME
    default n
```

## bsp/rockchip/dm/i2c/Kconfig
```kconfig
config RT_I2C_RK3X
    bool "Rockchip RK3xxx I2C adapter"
    depends on RT_MFD_SYSCON
    depends on RT_USING_PINCTRL
    default n
```

## bsp/rockchip/dm/input/misc/Kconfig
```kconfig
config RT_INPUT_MISC_PWRKEY_RK8XX
    bool "Rockchip RK805/RK806/RK817 PMIC power key support"
    depends on RT_INPUT_MISC
    depends on RT_MFD_RK8XX
    default n
```

## bsp/rockchip/dm/mailbox/Kconfig
```kconfig
config RT_MBOX_ROCKCHIP
    bool "Rockchip Soc Integrated Mailbox Support"
    default n
```

## bsp/rockchip/dm/mfd/Kconfig
```kconfig
config RT_MFD_RK8XX
    bool
    depends on RT_USING_PIC

config RT_MFD_RK8XX_I2C
    bool "Rockchip RK805/RK808/RK809/RK817/RK818 Power Management Chip"
    depends on RT_USING_OFW
    depends on RT_USING_I2C
    select RT_MFD_RK8XX
    select RT_MFD_SYSCON
    default n

config RT_MFD_RK8XX_SPI
    bool "Rockchip RK806 Power Management Chip"
    depends on RT_USING_OFW
    depends on RT_USING_SPI
    select RT_MFD_RK8XX
    select RT_MFD_SYSCON
    default n
```

## bsp/rockchip/dm/nvmem/Kconfig
```kconfig
config RT_NVMEM_ROCKCHIP_OTP
    bool "Rockchip OTP controller support"
    default n
```

## bsp/rockchip/dm/pin/Kconfig
```kconfig
config RT_PIN_ROCKCHIP
    bool "Rockchip GPIO support"
    depends on RT_USING_OFW
    default y
```

## bsp/rockchip/dm/pinctrl/Kconfig
```kconfig
config RT_PINCTRL_ROCKCHIP_RK8XX
    bool "Pinctrl and GPIO driver for RK805/RK806 PMIC"
    depends on RT_USING_PINCTRL
    depends on RT_MFD_RK8XX
    default n

config RT_PINCTRL_ROCKCHIP
    bool "Rockchip gpio and pinctrl driver"
    depends on RT_USING_PINCTRL
    depends on RT_MFD_SYSCON
    default y
```

## bsp/rockchip/dm/pmdomain/Kconfig
```kconfig
config RT_PMDOMAIN_ROCKCHIP
    bool "Rockchip"
    depends on RT_MFD_SYSCON
    depends on RT_USING_CLK
    depends on RT_USING_REGULATOR
    default y
```

## bsp/rockchip/dm/pwm/Kconfig
```kconfig
config RT_PWM_ROCKCHIP
    bool "Rockchip PWM support"
    depends on RT_USING_PWM
    depends on RT_USING_PINCTRL
    default n
```

## bsp/rockchip/dm/regulator/Kconfig
```kconfig
config RT_REGULATOR_RK8XX
    bool "Rockchip RK805/RK808/RK809/RK817/RK818 Power regulators"
    depends on RT_MFD_RK8XX
    depends on RT_USING_PIN
    default y
```

## bsp/rockchip/dm/rtc/Kconfig
```kconfig
config RT_RTC_RK8XX
    bool "Rockchip RK805/RK808/RK809/RK817/RK818 RTC"
    depends on RT_MFD_RK8XX

config RT_RTC_RK_TIMER
    bool "Rockchip RTC"
    default n
```

## bsp/rockchip/dm/spi/Kconfig
```kconfig
config RT_SPI_ROCKCHIP_SFC
    bool "Rockchip Serial Flash Controller (SFC)"
    depends on RT_USING_DM
    depends on RT_USING_SPI
    depends on RT_USING_QSPI
    depends on RT_USING_DMA
    depends on RT_USING_PIN
    depends on RT_USING_PINCTRL
    default n

config RT_SPI_ROCKCHIP
    bool "Rockchip SPI controller driver"
    depends on RT_USING_DM
    depends on RT_USING_SPI
    depends on RT_USING_DMA
    depends on RT_USING_PIN
    depends on RT_USING_PINCTRL
    default n
```

## bsp/rockchip/dm/thermal/Kconfig
```kconfig
config RT_THERMAL_ROCKCHIP_TSADC
    bool "Rockchip TS-ADC driver"
    depends on RT_USING_THERMAL
    depends on RT_MFD_SYSCON
    depends on RT_USING_RESET
    default n
```
