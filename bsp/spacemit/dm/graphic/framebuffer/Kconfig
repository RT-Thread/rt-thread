## components/dfs/Kconfig
```kconfig
menu "DFS: device virtual file system"

config RT_USING_DFS
    bool "DFS: device virtual file system"
    select RT_USING_MUTEX
    default y
    help
        The device file system is a light weight virtual file system.

if RT_USING_DFS
    config DFS_USING_POSIX
        bool "Using posix-like functions, open/read/write/close"
        default y

    config DFS_USING_WORKDIR
        bool "Using working directory"
        default y

if RT_USING_DFS_V1
    config RT_USING_DFS_MNTTABLE
        bool "Using mount table for file system"
        default n
        help
            User can use mount table for automatically mount, for example:
                const struct dfs_mount_tbl mount_table[] =
                {
                    {"flash0", "/", "elm", 0, 0},
                    {0}
                };
            The mount_table must be terminated with NULL.
endif

    config DFS_FD_MAX
        int "The maximal number of opened files"
        default 16

    choice RT_USING_DFS_VERSION
        prompt "The version of DFS"
        default RT_USING_DFS_V1
        default RT_USING_DFS_V2 if RT_USING_SMART

        config RT_USING_DFS_V1
            bool "DFS v1.0"
            depends on !RT_USING_SMART

        config RT_USING_DFS_V2
            bool "DFS v2.0"
            select RT_USING_DEVICE_OPS
    endchoice

if RT_USING_DFS_V1
    config DFS_FILESYSTEMS_MAX
        int "The maximal number of mounted file system"
        default 4

    config DFS_FILESYSTEM_TYPES_MAX
        int "The maximal number of file system type"
        default 4
endif

    config RT_USING_DFS_ELMFAT
        bool "Enable elm-chan fatfs"
        default n
        help
            FatFs is a generic FAT/exFAT file system module for small embedded systems.

    if RT_USING_DFS_ELMFAT
        menu "elm-chan's FatFs, Generic FAT Filesystem Module"
        config RT_DFS_ELM_CODE_PAGE
            int "OEM code page"
            default 437

        config RT_DFS_ELM_WORD_ACCESS
            bool "Using RT_DFS_ELM_WORD_ACCESS"
            default y

        choice RT_DFS_ELM_USE_LFN_NAME
            prompt "Support long file name"
            default RT_DFS_ELM_USE_LFN_3

            config RT_DFS_ELM_USE_LFN_0
                bool "0: LFN disable"

            config RT_DFS_ELM_USE_LFN_1
                bool "1: LFN with static LFN working buffer"

            config RT_DFS_ELM_USE_LFN_2
                bool "2: LFN with dynamic LFN working buffer on the stack"

            config RT_DFS_ELM_USE_LFN_3
                bool "3: LFN with dynamic LFN working buffer on the heap"
        endchoice

        config RT_DFS_ELM_USE_LFN
            int
            default 0 if RT_DFS_ELM_USE_LFN_0
            default 1 if RT_DFS_ELM_USE_LFN_1
            default 2 if RT_DFS_ELM_USE_LFN_2
            default 3 if RT_DFS_ELM_USE_LFN_3

        choice RT_DFS_ELM_LFN_UNICODE_NAME
            prompt "Support unicode for long file name"
            default RT_DFS_ELM_LFN_UNICODE_0

            config RT_DFS_ELM_LFN_UNICODE_0
                bool "0: ANSI/OEM in current CP (TCHAR = char)"

            config RT_DFS_ELM_LFN_UNICODE_1
                bool "1: Unicode in UTF-16 (TCHAR = WCHAR)"

            config RT_DFS_ELM_LFN_UNICODE_2
                bool "2: Unicode in UTF-8 (TCHAR = char)"

            config RT_DFS_ELM_LFN_UNICODE_3
                bool "3: Unicode in UTF-32 (TCHAR = DWORD)"
        endchoice

        config RT_DFS_ELM_LFN_UNICODE
            int
            default 0 if RT_DFS_ELM_LFN_UNICODE_0
            default 1 if RT_DFS_ELM_LFN_UNICODE_1
            default 2 if RT_DFS_ELM_LFN_UNICODE_2
            default 3 if RT_DFS_ELM_LFN_UNICODE_3

        config RT_DFS_ELM_MAX_LFN
            int "Maximal size of file name length"
            range 12 255
            default 255

        config RT_DFS_ELM_DRIVES
            int "Number of volumes (logical drives) to be used."
            default 2

        config RT_DFS_ELM_MAX_SECTOR_SIZE
            int "Maximum sector size to be handled."
            default 512
            help
                If you use some spi nor flash for fatfs, please set this the erase sector size, for example 4096.

        config RT_DFS_ELM_NFATS
            int "Number of FATs (File Allocation Tables) on the volume"
            range 1 2
            default 1
            help
                Number of copies of the FAT table. Setting 1 saves space while 2
                provides redundancy for fault tolerance. Used by f_mkfs().

        choice
            prompt "Cluster size in bytes (allocation unit size) used by f_mkfs()"
            default RT_DFS_ELM_CLUSTER_SIZE_0
            help
                Cluster size (allocation unit size) passed to f_mkfs().
                Must be a power of 2 and >= sector size (RT_DFS_ELM_MAX_SECTOR_SIZE).
                Select "Auto" to let f_mkfs auto-select based on volume size.
                A value smaller than the sector size (e.g. 512 on a 4096-byte
                sector device) is invalid and will be silently overridden by
                f_mkfs with its auto-selection, so pick a value >= sector size.

            config RT_DFS_ELM_CLUSTER_SIZE_0
                bool "Auto (0 = let f_mkfs decide)"
            config RT_DFS_ELM_CLUSTER_SIZE_512
                bool "512 bytes"
            config RT_DFS_ELM_CLUSTER_SIZE_1024
                bool "1024 bytes"
            config RT_DFS_ELM_CLUSTER_SIZE_2048
                bool "2048 bytes"
            config RT_DFS_ELM_CLUSTER_SIZE_4096
                bool "4096 bytes"
            config RT_DFS_ELM_CLUSTER_SIZE_8192
                bool "8192 bytes"
            config RT_DFS_ELM_CLUSTER_SIZE_16384
                bool "16384 bytes"
            config RT_DFS_ELM_CLUSTER_SIZE_32768
                bool "32768 bytes"
            config RT_DFS_ELM_CLUSTER_SIZE_65536
                bool "65536 bytes"
            config RT_DFS_ELM_CLUSTER_SIZE_131072
                bool "131072 bytes (128K) - exFAT recommended"
                depends on RT_DFS_ELM_USE_EXFAT
            config RT_DFS_ELM_CLUSTER_SIZE_262144
                bool "262144 bytes (256K) - exFAT recommended"
                depends on RT_DFS_ELM_USE_EXFAT
            config RT_DFS_ELM_CLUSTER_SIZE_524288
                bool "524288 bytes (512K) - exFAT recommended"
                depends on RT_DFS_ELM_USE_EXFAT
            config RT_DFS_ELM_CLUSTER_SIZE_1048576
                bool "1048576 bytes (1M) - exFAT recommended"
                depends on RT_DFS_ELM_USE_EXFAT
            config RT_DFS_ELM_CLUSTER_SIZE_2097152
                bool "2097152 bytes (2M) - exFAT recommended"
                depends on RT_DFS_ELM_USE_EXFAT
            config RT_DFS_ELM_CLUSTER_SIZE_4194304
                bool "4194304 bytes (4M) - exFAT recommended"
                depends on RT_DFS_ELM_USE_EXFAT
            config RT_DFS_ELM_CLUSTER_SIZE_8388608
                bool "8388608 bytes (8M) - exFAT recommended"
                depends on RT_DFS_ELM_USE_EXFAT
            config RT_DFS_ELM_CLUSTER_SIZE_16777216
                bool "16777216 bytes (16M, FatFs max) - exFAT recommended"
                depends on RT_DFS_ELM_USE_EXFAT
        endchoice

        config RT_DFS_ELM_CLUSTER_SIZE
            int
            range 0 16777216
            default 0          if RT_DFS_ELM_CLUSTER_SIZE_0
            default 512        if RT_DFS_ELM_CLUSTER_SIZE_512
            default 1024       if RT_DFS_ELM_CLUSTER_SIZE_1024
            default 2048       if RT_DFS_ELM_CLUSTER_SIZE_2048
            default 4096       if RT_DFS_ELM_CLUSTER_SIZE_4096
            default 8192       if RT_DFS_ELM_CLUSTER_SIZE_8192
            default 16384      if RT_DFS_ELM_CLUSTER_SIZE_16384
            default 32768      if RT_DFS_ELM_CLUSTER_SIZE_32768
            default 65536      if RT_DFS_ELM_CLUSTER_SIZE_65536
            default 131072     if RT_DFS_ELM_CLUSTER_SIZE_131072
            default 262144     if RT_DFS_ELM_CLUSTER_SIZE_262144
            default 524288     if RT_DFS_ELM_CLUSTER_SIZE_524288
            default 1048576    if RT_DFS_ELM_CLUSTER_SIZE_1048576
            default 2097152    if RT_DFS_ELM_CLUSTER_SIZE_2097152
            default 4194304    if RT_DFS_ELM_CLUSTER_SIZE_4194304
            default 8388608    if RT_DFS_ELM_CLUSTER_SIZE_8388608
            default 16777216   if RT_DFS_ELM_CLUSTER_SIZE_16777216

        config RT_DFS_ELM_USE_ERASE
            bool "Enable sector erase feature"
            default n

        config RT_DFS_ELM_REENTRANT
            bool "Enable the reentrancy (thread safe) of the FatFs module"
            default y

        config RT_DFS_ELM_MUTEX_TIMEOUT
            int "Timeout of thread-safe protection mutex"
            range 0 1000000
            default 3000
            depends on RT_DFS_ELM_REENTRANT

        config RT_DFS_ELM_USE_EXFAT
            bool "Enable exFAT filesystem support"
            default n
            depends on RT_DFS_ELM_USE_LFN >= 1
            help
              exFAT (Extended File Allocation Table) is a file system
              designed for large-capacity storage devices.

              Key features and recommendations:
              - Target scenarios: Primarily used for storage media requiring
                support for very large files (>4GB) or large partitions
                (>32GB), such as high-capacity SD cards or USB drives.

              - Resource cost: Enabling exFAT support will significantly
                increase the code size (ROM footprint) of the file system.

              - Recommendation:
                For small-capacity storage devices (e.g., SPI Flash or
                eMMC under 32GB), the standard FAT16 or FAT32 file
                systems are perfectly adequate. It is strongly recommended
                to keep this option disabled unless you absolutely need to
                handle large-capacity storage, in order to conserve
                valuable code space.

        endmenu
    endif

    config RT_USING_DFS_DEVFS
        bool "Using devfs for device objects"
        default y

if RT_USING_DFS_V1
    config RT_USING_DFS_9PFS
        bool "Using Plan 9 remote filesystem"
        select RT_USING_ADT_BITMAP
        depends on RT_USING_MEMHEAP
        default n

    config RT_USING_DFS_ISO9660
        bool "Using ISO9660 filesystem"
        depends on RT_USING_MEMHEAP
        default n
endif

    menuconfig RT_USING_DFS_ROMFS
        bool "Enable ReadOnly file system on flash"
        default n

    if RT_USING_DFS_ROMFS
        config RT_USING_DFS_ROMFS_USER_ROOT
            bool "Use user's romfs root"
            depends on RT_USING_DFS_V1
            default n
    endif

if RT_USING_SMART
    config RT_USING_DFS_PTYFS
        bool "Using Pseudo-Teletype Filesystem (UNIX98 PTY)"
        depends on RT_USING_DFS_DEVFS
        default y
    config RT_USING_DFS_PROCFS
        bool "Enable proc file system"
        default y
endif

    config RT_USING_DFS_CROMFS
        bool "Enable ReadOnly compressed file system on flash"
        default n
        # select PKG_USING_ZLIB

if RT_USING_DFS_V1
    config RT_USING_DFS_RAMFS
        bool "Enable RAM file system"
        select RT_USING_MEMHEAP
        default n
endif

    config RT_USING_DFS_TMPFS
        bool "Enable TMP file system"
        default y if RT_USING_SMART
        default n

    config RT_USING_DFS_MQUEUE
        bool "Enable MQUEUE file system"
        select RT_USING_DEV_BUS
        default y if RT_USING_SMART
        default n

if RT_USING_DFS_V1
    config RT_USING_DFS_NFS
        bool "Using NFS v3 client file system"
        depends on RT_USING_LWIP
        default n

    if RT_USING_DFS_NFS
        config RT_NFS_HOST_EXPORT
            string "NFSv3 host export"
            default "192.168.1.5:/"
    endif
endif

if RT_USING_DFS_V2
    config RT_USING_PAGECACHE
        bool "Enable page cache"
        default y if RT_USING_SMART
        depends on RT_USING_SMART

    if RT_USING_PAGECACHE
        menu "page cache config"
        config RT_PAGECACHE_COUNT
            int "page cache max total pages."
            default 4096

        config RT_PAGECACHE_ASPACE_COUNT
            int "aspace max active pages."
            default 1024

        config RT_PAGECACHE_PRELOAD
            int "max pre load pages."
            default 4

        config RT_PAGECACHE_HASH_NR
            int "page cache hash size."
            default 1024

        config RT_PAGECACHE_GC_WORK_LEVEL
            int "page cache gc work trigger min percentage, default 90%."
            default 90

        config RT_PAGECACHE_GC_STOP_LEVEL
            int "page cache gc to min percentage, default 70%."
            default 70
        endmenu
    endif
endif

endif

endmenu
```

## components/dfs/dfs_v2/filesystems/cromfs/utest/Kconfig
```kconfig
menu "cromfs Testcase"

config RT_UTEST_DFS_CROMFS
    bool "cromfs dirent name bound test"
    default n
    depends on RT_USING_DFS_V2 && RT_USING_DFS_CROMFS
    select RT_USING_DFS_TMPFS
    help
        Mount a crafted cromfs image from memory and check that a directory
        entry whose name_size does not fit into struct dirent::d_name is
        rejected instead of being copied.

endmenu
```

## components/dfs/dfs_v2/filesystems/tmpfs/utest/Kconfig
```kconfig
menu "Tmpfs Testcase"

config RT_UTEST_TMPFS_CP
    bool "tmpfs cp test"
    default n

config RT_UTEST_DFS_RECORD_LOCK
    bool "DFS POSIX record lock test"
    default n
    depends on RT_USING_POSIX_FS && RT_USING_DFS_TMPFS
    help
        Enable POSIX advisory record-lock tests on tmpfs.

endmenu
```
