## bsp/gd32/arm/gd32h759i-eval/board/Kconfig
```kconfig
menu "Hardware Drivers Config"

config SOC_SERIES_GD32H7xx
    bool
    default y

config SOC_GD32H759I
    bool
    select SOC_SERIES_GD32H7xx
    select RT_USING_COMPONENTS_INIT
    select RT_USING_USER_MAIN
    default y

menu "Onboard Peripheral Drivers"

endmenu

menu "On-chip Peripheral Drivers"

    config BSP_USING_GPIO
        bool "Enable GPIO"
        select RT_USING_PIN
        default y

    menuconfig BSP_USING_UART
        bool "Enable UART"
        default y
        select RT_USING_SERIAL
        if BSP_USING_UART
            config BSP_USING_UART0
                bool "Enable UART0"
                default y

            config BSP_UART0_RX_USING_DMA
                bool "Enable UART0 RX DMA"
                depends on BSP_USING_UART0
                select RT_SERIAL_USING_DMA
                default n

            config BSP_USING_UART1
                bool "Enable UART1"
                default n

            config BSP_UART1_RX_USING_DMA
                bool "Enable UART1 RX DMA"
                depends on BSP_USING_UART1
                select RT_SERIAL_USING_DMA
                default n

            config BSP_USING_UART2
                bool "Enable UART2"
                default n

            config BSP_UART2_RX_USING_DMA
                bool "Enable UART2 RX DMA"
                depends on BSP_USING_UART2
                select RT_SERIAL_USING_DMA
                default n

            config BSP_USING_UART3
                bool "Enable UART3"
                default n

            config BSP_UART3_RX_USING_DMA
                bool "Enable UART3 RX DMA"
                depends on BSP_USING_UART3
                select RT_SERIAL_USING_DMA
                default n

        endif

    menuconfig BSP_USING_I2C
        bool "Enable I2C"
        default n
        if BSP_USING_I2C
            menuconfig BSP_USING_HARD_I2C
                bool "Enable Hardware I2C"
                default n
                select RT_USING_I2C
                if BSP_USING_HARD_I2C
                    config BSP_USING_HARD_I2C0
                        bool "Enable I2C0 Hardware BUS"
                        default n                    
                    config BSP_USING_HARD_I2C1
                        bool "Enable I2C1 Hardware BUS"
                        default n
                    config BSP_USING_HARD_I2C2
                        bool "Enable I2C2 Hardware BUS"
                        default n
                    config BSP_USING_HARD_I2C3
                        bool "Enable I2C3 Hardware BUS"
                        default n
                    config BSP_USING_HARD_I2C4
                        bool "Enable I2C4 Hardware BUS"
                        default n
                    config BSP_USING_HARD_I2C5
                        bool "Enable I2C5 Hardware BUS"
                        default n
                endif
        endif

    menuconfig BSP_USING_SPI
        bool "Enable SPI BUS"
        default n
        select RT_USING_SPI
        if BSP_USING_SPI
            config BSP_USING_SPI0
                bool "Enable SPI0 BUS"
                default n
            config BSP_USING_SPI1
                bool "Enable SPI1 BUS"
                default n
            config BSP_USING_SPI2
                bool "Enable SPI2 BUS"
                default n
            config BSP_USING_SPI3
                bool "Enable SPI3 BUS"
                default n
            config BSP_USING_SPI4
                bool "Enable SPI4 BUS"
                default n
            config BSP_USING_SPI5
                bool "Enable SPI5 BUS"
                default n
        endif

    source "$(BSP_DIR)/../libraries/gd32_drivers/Kconfig"        
endmenu

menu "Board extended module Drivers"

endmenu

endmenu
```

## bsp/gd32/arm/gd32h759i-start/board/Kconfig
```kconfig
menu "Hardware Drivers Config"

config SOC_SERIES_GD32H7xx
    bool
    default y

config SOC_GD32H759IM
    bool
    select SOC_SERIES_GD32H7xx
    select RT_USING_COMPONENTS_INIT
    select RT_USING_USER_MAIN
    default y

menu "Onboard Peripheral Drivers"

endmenu

menu "On-chip Peripheral Drivers"

    config BSP_USING_GPIO
        bool "Enable GPIO"
        select RT_USING_PIN
        default y

    menuconfig BSP_USING_UART
        bool "Enable UART"
        default y
        if BSP_USING_UART
            choice
                prompt "Select UART framework version"
                default BSP_USING_SERIAL_V1
                
                config BSP_USING_SERIAL_V1
                    bool "Use Serial V1 framework"
                    select RT_USING_SERIAL
                    
                config BSP_USING_SERIAL_V2
                    bool "Use Serial V2 framework"
                    select RT_USING_SERIAL_V2
            endchoice

            menuconfig BSP_USING_UART0
                bool "Enable UART0"
                default y
                if BSP_USING_UART0
                    config BSP_UART0_TX_PIN
                        string "UART0 TX name, such as PA8"
                        default "PF4"
                        
                    config BSP_UART0_RX_PIN
                        string "UART0 RX name, such as PA9"
                        default "PF5"
                        
                    config BSP_UART0_AFIO
                        string "UART0 alternate function, such as AF7"
                        default "AF4"
                        
                    if BSP_USING_SERIAL_V2
                        config BSP_UART0_RX_USING_DMA
                            bool "Enable UART0 RX DMA"
                            depends on RT_SERIAL_USING_DMA
                            default n

                        config BSP_UART0_TX_USING_DMA
                            bool "Enable UART0 TX DMA"
                            depends on RT_SERIAL_USING_DMA
                            default n

                        config BSP_UART0_DMA_PING_BUFSIZE
                            int "Set UART0 RX DMA ping-pong buffer size"
                            range 16 65535
                            depends on BSP_UART0_RX_USING_DMA
                            default 64

                        config BSP_UART0_RX_BUFSIZE
                            int "Set UART0 RX buffer size"
                            range 64 65535
                            default 128

                        config BSP_UART0_TX_BUFSIZE
                            int "Set UART0 TX buffer size"
                            range 0 65535
                            default 128
                    endif
                endif

            menuconfig BSP_USING_UART1
                bool "Enable UART1"
                default y
                if BSP_USING_UART1
                    config BSP_UART1_TX_PIN
                        string "UART1 TX name, such as PA8"
                        default "PA2"
                        
                    config BSP_UART1_RX_PIN
                        string "UART1 RX name, such as PA9"
                        default "PA3"
                        
                    config BSP_UART1_AFIO
                        string "UART1 alternate function, such as AF7"
                        default "AF7"
                        
                    if BSP_USING_SERIAL_V2
                        config BSP_UART1_RX_USING_DMA
                            bool "Enable UART1 RX DMA"
                            depends on RT_SERIAL_USING_DMA
                            default n

                        config BSP_UART1_TX_USING_DMA
                            bool "Enable UART1 TX DMA"
                            depends on RT_SERIAL_USING_DMA
                            default n

                        config BSP_UART1_DMA_PING_BUFSIZE
                            int "Set UART1 RX DMA ping-pong buffer size"
                            range 16 65535
                            depends on BSP_UART1_RX_USING_DMA
                            default 64

                        config BSP_UART1_RX_BUFSIZE
                            int "Set UART1 RX buffer size"
                            range 64 65535
                            default 128

                        config BSP_UART1_TX_BUFSIZE
                            int "Set UART1 TX buffer size"
                            range 0 65535
                            default 128
                    endif
                endif

            menuconfig BSP_USING_UART2
                bool "Enable UART2"
                default n
                if BSP_USING_UART2
                    config BSP_UART2_TX_PIN
                        string "UART2 TX name, such as PA8"
                        default "PB10"
                        
                    config BSP_UART2_RX_PIN
                        string "UART2 RX name, such as PA9"
                        default "PB11"
                        
                    config BSP_UART2_AFIO
                        string "UART2 alternate function, such as AF7"
                        default "AF7"
                        
                    if BSP_USING_SERIAL_V2
                        config BSP_UART2_RX_USING_DMA
                            bool "Enable UART2 RX DMA"
                            depends on RT_SERIAL_USING_DMA
                            default n

                        config BSP_UART2_TX_USING_DMA
                            bool "Enable UART2 TX DMA"
                            depends on RT_SERIAL_USING_DMA
                            default n

                        config BSP_UART2_DMA_PING_BUFSIZE
                            int "Set UART2 RX DMA ping-pong buffer size"
                            range 16 65535
                            depends on BSP_UART2_RX_USING_DMA
                            default 64

                        config BSP_UART2_RX_BUFSIZE
                            int "Set UART2 RX buffer size"
                            range 64 65535
                            default 128

                        config BSP_UART2_TX_BUFSIZE
                            int "Set UART2 TX buffer size"
                            range 0 65535
                            default 128
                    endif
                endif

            menuconfig BSP_USING_UART3
                bool "Enable UART3"
                default n
                if BSP_USING_UART3
                    config BSP_UART3_TX_PIN
                        string "UART3 TX name, such as PA8"
                        default "PC10"
                        
                    config BSP_UART3_RX_PIN
                        string "UART3 RX name, such as PA9"
                        default "PC11"
                        
                    config BSP_UART3_AFIO
                        string "UART3 alternate function, such as AF7"
                        default "AF8"
                        
                    if BSP_USING_SERIAL_V2
                        config BSP_UART3_RX_USING_DMA
                            bool "Enable UART3 RX DMA"
                            depends on RT_SERIAL_USING_DMA
                            default n

                        config BSP_UART3_TX_USING_DMA
                            bool "Enable UART3 TX DMA"
                            depends on RT_SERIAL_USING_DMA
                            default n

                        config BSP_UART3_DMA_PING_BUFSIZE
                            int "Set UART3 RX DMA ping-pong buffer size"
                            range 16 65535
                            depends on BSP_UART3_RX_USING_DMA
                            default 64

                        config BSP_UART3_RX_BUFSIZE
                            int "Set UART3 RX buffer size"
                            range 64 65535
                            default 128

                        config BSP_UART3_TX_BUFSIZE
                            int "Set UART3 TX buffer size"
                            range 0 65535
                            default 128
                    endif
                endif
        endif

    menuconfig BSP_USING_ONCHIP_RTC
        bool "Enable RTC"
        select RT_USING_RTC
        default n
        if BSP_USING_ONCHIP_RTC
            config BSP_USING_ALARM
                bool "Enable RTC alarm"
                select RT_USING_ALARM
                default n
            if BSP_USING_ALARM
                choice
                    prompt "Select rtc alarm device"
                    default BSP_USING_ALARM0

                    config BSP_USING_ALARM0
                        bool "Enable RTC Alarm0"

                    config BSP_USING_ALARM1
                        bool "Enable RTC Alarm1"
                endchoice
            endif
        endif

    source "$(BSP_DIR)/../libraries/gd32_drivers/Kconfig"

endmenu

menu "Board extended module Drivers"

endmenu

endmenu
```

## bsp/gd32/arm/libraries/Kconfig
```kconfig
config SOC_FAMILY_GD32
    bool
    select PKG_USING_GD32_ARM_SERIES_DRIVER

config SOC_SERIES_GD32E50x
    bool
    select SOC_FAMILY_GD32

config SOC_SERIES_GD32F10x
    bool
    select ARCH_ARM_CORTEX_M3
    select SOC_FAMILY_GD32

config SOC_SERIES_GD32F20x
    bool
    select ARCH_ARM_CORTEX_M3
    select SOC_FAMILY_GD32

config SOC_SERIES_GD32F30x
    bool
    select ARCH_ARM_CORTEX_M4
    select SOC_FAMILY_GD32

config SOC_SERIES_GD32F4xx
    bool
    select ARCH_ARM_CORTEX_M4
    select SOC_FAMILY_GD32

config SOC_SERIES_GD32H7xx
    bool
    select ARCH_ARM_CORTEX_M7
    select SOC_FAMILY_GD32

config SOC_SERIES_GD32F5xx
    bool
    select ARCH_ARM_CORTEX_M33
    select SOC_FAMILY_GD32

config SOC_SERIES_GD32E23x
    bool
    select ARCH_ARM_CORTEX_M23
    select SOC_FAMILY_GD32
```
