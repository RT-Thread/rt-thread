## bsp/allwinner/libraries/sunxi-hal/hal/source/regulator/Kconfig
```kconfig
menu "REGULATOR Devices"

config DRIVERS_REGULATOR
    bool "enable regulator driver"
        default y

endmenu
```

## bsp/allwinner/libraries/sunxi-hal/hal/source/rtc/Kconfig
```kconfig
menu "RTC Devices"

config DRIVERS_RTC
    bool "enable rtc driver"
        default y

config HAL_TEST_RTC
    bool "enable rtc hal APIs test command"
    depends on DRIVERS_RTC
        default n

endmenu
```

## bsp/allwinner/libraries/sunxi-hal/hal/source/sdmmc/Kconfig
```kconfig
menu "SDMMC Devices"

config DRIVERS_SDMMC
    bool "enable SDMMC drivers"
        default y

if DRIVERS_SDMMC

config USE_SD
    bool "enable SD"
    default y

config USE_SDIO
    bool "enable SDIO"
    default y

config USE_MMC
    bool "enable mmc"
    default n

config DETECT_CARD
    bool "enable detect card"
    default y

config SDC_DMA_USED
    bool "enable dma transmission"
    default y

config SDIO_IRQ_SUPPORT
    bool "enable sdio irq"
    default y

config SD_TEST
    select USE_SD
    bool "enable SD Card test case."
    default y

config SDC_DMA_BUF_SIZE
    int "SD Card Align DMA Buffer Size(Kbyte)."
    depends on SDC_DMA_USED
    default 64

config DRIVERS_SDC_CDPIN_PRESENT_VAL
    int "sdc card detect pin present value"
    default 0

endif
endmenu
```

## bsp/allwinner/libraries/sunxi-hal/hal/source/sdmmc/cmd/Kconfig
```kconfig
menu "sdmmc test applicaion"

config SDMMC_TEST
    bool "SDMMC test applicaiton"
        default n

endmenu
```

## bsp/allwinner/libraries/sunxi-hal/hal/source/sdmmc/osal/os/Kconfig
```kconfig
menu "sdmmc free rtos osal"

config DRIVERS_SDMMC_FREE_RTOS_OSAL
    bool "enable SDMMC device drivers freertos oal"
        default y
endmenu
```

## bsp/allwinner/libraries/sunxi-hal/hal/source/sound/Kconfig
```kconfig
menuconfig DRIVERS_SOUND
    bool "Sound card support"
    default y

if DRIVERS_SOUND
rsource "codecs/Kconfig"
rsource "platform/Kconfig"
rsource "component/Kconfig"
endif # SOUND
```

## bsp/allwinner/libraries/sunxi-hal/hal/source/sound/codecs/Kconfig
```kconfig
menu "AllWinner CODEC drivers"

config SND_CODEC_SUNXI_RWFUNC
    bool
    default n

config SND_CODEC_SUN8IW18_AUDIOCODEC
    bool "Allwinner AudioCodec support"
    default n
    select SND_PLATFORM_SUNXI_CPUDAI
    select SND_PLATFORM_SUNXI_PCM
    select SND_CODEC_SUNXI_RWFUNC
    depends on (ARCH_SUN8IW18P1 || ARCH_SUN8IW18)
    help
      Select Y to add support the Codec embedded in the Allwinner
      sun8iw18 and affiliated SoCs.

config SND_CODEC_SUN8IW19_AUDIOCODEC
    bool "Allwinner AudioCodec support"
    default n
    select SND_PLATFORM_SUNXI_CPUDAI
    select SND_PLATFORM_SUNXI_PCM
    depends on (ARCH_SUN8IW19P1 || ARCH_SUN8IW19)
    help
      Select Y to add support the Codec embedded in the Allwinner
      sun8iw19 and affiliated SoCs.

config SND_CODEC_SUN8IW20_AUDIOCODEC
    bool "Allwinner AudioCodec support"
    default n
    select SND_PLATFORM_SUNXI_CPUDAI
    select SND_PLATFORM_SUNXI_PCM
    depends on SOC_SUN20IW1P1
    help
      Select Y to add support the Codec embedded in the Allwinner
      sun8iw20 and affiliated SoCs.

config SND_CODEC_AC108
    bool "Sunxi AC108 codec"
    default n

endmenu
```

## bsp/allwinner/libraries/sunxi-hal/hal/source/sound/component/Kconfig
```kconfig
menu "AW Sound Compenents"

config COMPONENTS_AW_ALSA_LIB
    bool "Allwinner alsa library"
    depends on DRIVERS_SOUND
    default n
    help
      This is library package for aw-alsa, only used for Allwinner FreeRTOS.

config COMPONENTS_AW_ALSA_UTILS
    bool "Allwinner alsa utilities"
    depends on COMPONENTS_AW_ALSA_LIB
    default n
    help
      This is package for aw-alsa-lib utilities, only used for Allwinner Tina RTOS.

config BUILTIN_WAV_FILE
    bool "builtin wav file"
    depends on COMPONENTS_AW_ALSA_UTILS
    default y
    help
      Say Y to use builtin wav file.

endmenu
```

## bsp/allwinner/libraries/sunxi-hal/hal/source/sound/platform/Kconfig
```kconfig
menu "Platform(Audio Interface) drivers"

config SND_PLATFORM_SUNXI_PCM
    bool
    default n

config SND_PLATFORM_SUNXI_CPUDAI
    bool "Allwinner internal cpudai"
    select SND_PLATFORM_SUNXI_PCM
    default n
    help
      Only support for the Codec embedded in the Allwinner SoCs.

config SND_PLATFORM_SUNXI_DAUDIO
    bool "Allwinner Digital Audio Support"
    select SND_PLATFORM_SUNXI_PCM
    depends on (!ARCH_SUN8IW19)
    default n
    help
      Select Y to add support for I2S/PCM/TDM module in Allwinner SoCs.

config SND_PLATFORM_SUN8IW19_DAUDIO
    bool "Allwinner Digital Audio Support"
    select SND_PLATFORM_SUNXI_PCM
    depends on (ARCH_SUN8IW19P1 || ARCH_SUN8IW19)
    default n
    help
      Select Y to add support for I2S/PCM/TDM module in Allwinner SoCs.

if SND_PLATFORM_SUNXI_DAUDIO || SND_PLATFORM_SUN8IW19_DAUDIO
menu "Allwinner Digital Audio Choose"
config SND_PLATFORM_SUNXI_DAUDIO0
    bool "Allwinner Daudio0 Support"
    default n
    help
      Select Y to add support for Daudio0.

config SND_PLATFORM_SUNXI_DAUDIO1
    bool "Allwinner Daudio1 Support"
    default n
    help
      Select Y to add support for Daudio1.

config SND_PLATFORM_SUNXI_DAUDIO2
    bool "Allwinner Daudio2 Support"
    depends on (!SND_PLATFORM_SUN8IW19_DAUDIO)
    default n
    help
      Select Y to add support for Daudio2.

config SND_PLATFORM_SUNXI_DAUDIO3
    bool "Allwinner Daudio3 Support"
    depends on (!SND_PLATFORM_SUN8IW19_DAUDIO)
    default n
    help
      Select Y to add support for Daudio3.
endmenu
endif

config SND_PLATFORM_SUNXI_DMIC
    bool "Allwinner DMIC Support"
    select SND_PLATFORM_SUNXI_PCM
    select SND_CODEC_DUMMY
    default n
    help
      Select Y to add support for DMIC module in Allwinner SoCs.

config SND_PLATFORM_SUNXI_SPDIF
    bool "Allwinner SPDIF Support"
    select SND_PLATFORM_SUNXI_PCM
    select SND_CODEC_DUMMY
    default n
    help
      Select Y to add support for SPDIF module in Allwinner SoCs.

config SND_SUNXI_DEBUG
    bool "Allwinner Audio Debug Support"
    default n
    help
      Select Y to add support for audio debug in Allwinner SoCs.

endmenu
```

## bsp/allwinner/libraries/sunxi-hal/hal/source/spi/Kconfig
```kconfig
menu "SPI Devices"

config DRIVERS_SPI
    bool "enable spi driver"
        default y

config HAL_TEST_SPI
    bool "enable spi hal APIs test command"
    depends on DRIVERS_SPI
        default n

endmenu
```

## bsp/allwinner/libraries/sunxi-hal/hal/source/spinor/Kconfig
```kconfig
menu "SPINOR Devices"

config DRIVERS_SPINOR
    bool "enable spinor driver"
        default y

config HAL_TEST_SPINOR
    bool "enable spinor hal APIs test command"
    depends on DRIVERS_SPINOR
        default n

config DRIVERS_SPINOR_FREQ
    int "spinor frequency (MHz)"
    depends on DRIVERS_SPINOR
    range 10 100
    default 50
    help
      The frequency for spi master.

config DRIVERS_SPINOR_4K_SECTORS
    bool "Use small 4096 B erase sectors"
    depends on DRIVERS_SPINOR
    default y
    help
      This only tells the upper layer that the block size is 4K and the upper
      layer can do 4K erase. In fact, the driver still supports 32K or 64K
      erase and it may try to do 64K or 32K erase as far as possible if you
      enable cache since it does really improve performance. Erasing should be
      mush faster when using 64K block instead of 16 * 4K.

      Why we should need this option? Even most filesystems save a file in
      unit block, which is equal to nor block size generally. The larger block
      is, the much space waste for a small file. Take an example, to save a 1K
      size file, the filesystem allocate a block for it and waste 3K size
      for 4K block size, even 63K size for 64K block size.

      To balance waste-space and performance, we really support to eanble
      4K block and nor cache to get more operations together.

      If unsure, please says Y.

config DRIVERS_SPINOR_CACHE
    bool "Enable spinor cache layer"
    depends on DRIVERS_SPINOR
    default n
    help
      To improve write performance by merging 4K page erase operation to
      32K/64K erase operation. This cache layer holds a 64K buffer. It just
      will cache sequential erase/write operation. There are three ways to
      flush cache.

      1. block buffer is fullly.
      2. operate over a block.
         Once operate over a 64K block, this layer will write-back directly
         avoiding lose data.
      3. upper layer call hal_spinor_sync()

      This cache layer with the littlefs turns out no loss of data, but the
      others need more tested. The upper layer (fs) should takes care of the
      following issues.

      1. after writing meta data, upper must call hal_spinor_sync() to flush
         cache. Also, you can flush cache for fatal data too. In a word,
         sync() is called only immediately after data that affects filesystem
         consistency is written. The littlefs is checked ok.
      2. contecting to sync()/fsync() for user in case of user codes writing
         fatal file.

      If unsure, please says N.

config DRIVERS_SPINOR_WRITE_LOCK
    bool "Use nor dynamic write limit if support"
    depends on DRIVERS_SPINOR
    default y
    help
      Some nor flash support write protection. This feature is much usefull
      for power lose case to avoid data corruption. Most of them support zone
      protection, which cost much for status register and to protect
      a continuous space from head or tail. That's NOT what we need. What this
      option used, is individual block protection. Before we do write/erase
      operation, we unlock (unprotect) the individual block we want and still
      protect other blocks. As you see, the unit to lock/unlock is a block.
      Beside, it just rewrite a volatile memory, not status register, which
      has less time and wear costs.

      In a word, It spends very little time to protect data if power lose.

      If unsure, please says Y.

endmenu
```

## bsp/allwinner/libraries/sunxi-hal/hal/source/thermal/Kconfig
```kconfig
menu "THERMAL Devices"

config DRIVERS_THERMAL
    bool "enable thermal driver"
    select DRIVERS_EFUSE
        default y

config HAL_TEST_THERMAL
    bool "enable thermal hal APIs test command"
    depends on DRIVERS_THERMAL
        default n


endmenu
```

## bsp/allwinner/libraries/sunxi-hal/hal/source/timer/Kconfig
```kconfig
menu "TIMER Devices"

config DRIVERS_TIMER
    bool "enable timer driver"
        default y

config HAL_TEST_TIMER
    bool "enable timer hal APIs test command"
        depends on DRIVERS_TIMER
        default n

config DRIVERS_HTIMER
    bool "enable hrtimer driver"
        default n

endmenu
```

## bsp/allwinner/libraries/sunxi-hal/hal/source/tpadc/Kconfig
```kconfig
menu "TPADC Devices"

config DRIVERS_TPADC
    bool "enable tpadc driver"
        default n

config HAL_TEST_TPADC
    bool "enable tpadc hal APIs test command"
    depends on DRIVERS_TPADC
        default n

endmenu
```

## bsp/allwinner/libraries/sunxi-hal/hal/source/twi/Kconfig
```kconfig
menu "TWI Devices"

config DRIVERS_TWI
    bool "enable twi driver"
        default y

config HAL_TEST_TWI
    bool "enable twi hal APIs test command"
    depends on DRIVERS_TWI
        default n

endmenu
```

## bsp/allwinner/libraries/sunxi-hal/hal/source/uart/Kconfig
```kconfig
menu "UART Devices"

config DRIVERS_UART
    bool "enable uart driver"
        default y

config HAL_TEST_UART
    bool "enable uart hal APIs test command"
    depends on DRIVERS_UART
        default n

config SUNXI_UART_SUPPORT_POLL
    bool "support poll APIs"
    depends on DRIVERS_UART
        default n

config SUNXI_UART_REGISTER_UART0
    bool "support uart0 device"
    depends on DRIVERS_UART
        default n

config SUNXI_UART_REGISTER_UART1
    bool "support uart1 device"
    depends on DRIVERS_UART
        default n

config SUNXI_UART_REGISTER_UART2
    bool "support uart2 device"
    depends on DRIVERS_UART
        default n

config SUNXI_UART_REGISTER_UART3
    bool "support uart3 device"
    depends on DRIVERS_UART
        default n

endmenu
```

## bsp/allwinner/libraries/sunxi-hal/hal/source/usb/Kconfig
```kconfig
menuconfig DRIVERS_USB
    bool "USB Drivers"
    default y

if DRIVERS_USB
menu "USB HOST"

config USB_HOST
    bool "enable usb host driver"
    default n

config HAL_TEST_HCI
    bool "enable HCI hal APIs test command"
    depends on USB_HOST
    default n

config USB_STORAGE
    bool "USB Mass Storage support"
    depends on USB_HOST
    default n

config USB_CAMERA
    bool "UVC support"
    depends on USB_HOST
    default n

config USB_HID
    bool "USB HID support"
    depends on USB_HOST
    default n
endmenu

menu "USB DEVICE"

config USB_DEVICE
    bool "enable usb device driver"
    default y

config HAL_TEST_UDC
    bool "enable udc hal APIs test command"
    depends on USB_DEVICE
    default y
endmenu

config USB_MANAGER
    bool "USB Manager support"
    default n
endif
```

## bsp/allwinner/libraries/sunxi-hal/hal/source/watchdog/Kconfig
```kconfig
menu "WATCHDOG Devices"

config DRIVERS_WATCHDOG
    bool "enable watchdog driver"
        default n

endmenu
```

## bsp/allwinner_tina/Kconfig
```kconfig
mainmenu "RT-Thread Configuration"

BSP_DIR := .

RTT_DIR := ../..

# you can change the RTT_ROOT default "../.." to your rtthread_root,
# example : default "F:/git_repositories/rt-thread"

PKGS_DIR := packages

source "$(RTT_DIR)/Kconfig"
osource "$PKGS_DIR/Kconfig"

config SOC_TINA
    bool
    select ARCH_ARM_ARM9
    select RT_USING_CACHE
    select RT_USING_COMPONENTS_INIT
    select RT_USING_USER_MAIN
    default y

source "$(BSP_DIR)/drivers/Kconfig"
```

## bsp/allwinner_tina/drivers/Kconfig
```kconfig
config TINA_USING_UART0
    bool "Using UART0"
    select RT_USING_SERIAL
    default n

config TINA_USING_UART1
    bool "Using UART1"
    select RT_USING_SERIAL
    default y

config TINA_USING_UART2
    bool "Using UART2"
    select RT_USING_SERIAL
    default y

config TINA_USING_SDIO0
    bool "Using SDIO0"
    select RT_USING_SDIO
    default y

config TINA_USING_SPI0
    bool "Using spi0"
    select RT_USING_SPI
    default y

config TINA_USING_SPI1
    bool "Using spi1"
    select RT_USING_SPI
    default y

config TINA_USING_SPI_FLASH
    bool "Using flash"
    select TINA_USING_SPI0
    select RT_USING_SFUD
    default y
```

## bsp/amebaz/Kconfig
```kconfig
mainmenu "RT-Thread Configuration"

BSP_DIR := .

RTT_DIR := ../..

# you can change the RTT_ROOT default "../.." to your rtthread_root,
# example : default "F:/git_repositories/rt-thread"

PKGS_DIR := packages

ENV_DIR := /

source "$(RTT_DIR)/Kconfig"
osource "$PKGS_DIR/Kconfig"
osource "$ENV_DIR/tools/scripts/cmds/Kconfig"
source "$(BSP_DIR)/libraries/Kconfig"
source "$(BSP_DIR)/drivers/Kconfig"

config SOC_AMEBAZ
    bool
    select PKG_USING_REALTEK_AMEBA
    select RT_USING_COMPONENTS_INIT
    select RT_USING_USER_MAIN
    default y
```

## bsp/amebaz/drivers/Kconfig
```kconfig
config BSP_USING_UART0
    bool "Using UART0"
    select RT_USING_SERIAL
    default y

config BSP_USING_WIFI
    bool "Using WIFI"
    select RT_USING_WIFI
    default y
```

## bsp/amebaz/libraries/Kconfig
```kconfig
menu "External Libraries"

    config RT_USING_SMARTCONFIG_LIB
        bool "Using RT-Thread SmartConfig Library"
        default n

endmenu
```
