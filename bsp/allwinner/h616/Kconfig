## bsp/hpmicro/hpm5e00evk/board/Kconfig
```kconfig
menu "Hardware Drivers Config"

config SOC_HPM5E00
    bool
    select SOC_SERIES_HPM5E00
    select RT_USING_COMPONENTS_INIT
    select RT_USING_USER_MAIN
    default y

config BSP_USING_ENET_PHY_RTL8211
    bool
    default n

if BSP_USING_ETH
    config LWIP_SUPPORT_CUSTOM_PBUF
    int
    default 1
endif

menu "On-chip Peripheral Drivers"
    config BSP_USING_GPIO
        bool "Enable GPIO"
        select RT_USING_PIN if BSP_USING_GPIO
        default n
        if BSP_USING_GPIO
            config BSP_GPIO_IRQ_PRIORITY
            int "GPIO Interrupt Priority"
            range 1 7
            default 1
        endif

    menuconfig BSP_USING_UART
        bool "Enable UART"
        default y
        select RT_USING_SERIAL
        if BSP_USING_UART
            menuconfig BSP_USING_UART0
                bool "Enable UART0 (Debugger)"
                default y
                if BSP_USING_UART0
                    config BSP_UART0_RX_USING_DMA
                        bool "Enable UART0 RX DMA"
                        depends on BSP_USING_UART0 && RT_SERIAL_USING_DMA
                        default n
                    config BSP_UART0_TX_USING_DMA
                        bool "Enable UART0 TX DMA"
                        depends on BSP_USING_UART0 && RT_SERIAL_USING_DMA
                        default n
                    config BSP_UART0_RX_BUFSIZE
                        int "Set UART0 RX buffer size"
                        range 64 65535
                        depends on RT_USING_SERIAL_V2
                        default 128
                    config BSP_UART0_TX_BUFSIZE
                        int "Set UART0 TX buffer size"
                        range 0 65535
                        depends on RT_USING_SERIAL_V2
                        default 0
                    config BSP_UART0_IRQ_PRIORITY
                        int "UART0 Interrupt Priority"
                        range 1 7
                        default 1
                endif

            menuconfig BSP_USING_UART1
                bool "Enable UART1"
                default n
                if BSP_USING_UART1
                    config BSP_UART1_RX_USING_DMA
                        bool "Enable UART1 RX DMA"
                        depends on BSP_USING_UART1 && RT_SERIAL_USING_DMA
                        default n
                    config BSP_UART1_TX_USING_DMA
                        bool "Enable UART1 TX DMA"
                        depends on BSP_USING_UART1 && RT_SERIAL_USING_DMA
                        default n
                    config BSP_UART1_RX_BUFSIZE
                        int "Set UART1 RX buffer size"
                        range 64 65535
                        depends on RT_USING_SERIAL_V2
                        default 1024
                    config BSP_UART1_TX_BUFSIZE
                        int "Set UART1 TX buffer size"
                        range 0 65535
                        depends on RT_USING_SERIAL_V2
                        default 0
                    config BSP_UART1_IRQ_PRIORITY
                        int "UART1 Interrupt Priority"
                        range 1 7
                        default 1
                    config BSP_UART1_DMA_PINGPONG_BUFSIZE
                        int "Set UART1 RX DMA ping-pong buffer size"
                        range 32 8192
                        depends on RT_USING_SERIAL_V2 && BSP_UART1_RX_USING_DMA
                        default 128
                endif
            menuconfig BSP_USING_UART2
                bool "Enable UART2"
                default n
                if BSP_USING_UART2
                    config BSP_UART2_RX_USING_DMA
                        bool "Enable UART2 RX DMA"
                        depends on BSP_USING_UART2 && RT_SERIAL_USING_DMA
                        default n
                    config BSP_UART2_TX_USING_DMA
                        bool "Enable UART2 TX DMA"
                        depends on BSP_USING_UART2 && RT_SERIAL_USING_DMA
                        default n
                    config BSP_UART2_RX_BUFSIZE
                        int "Set UART2 RX buffer size"
                        range 64 65535
                        depends on RT_USING_SERIAL_V2
                        default 1024
                    config BSP_UART2_TX_BUFSIZE
                        int "Set UART2 TX buffer size"
                        range 0 65535
                        depends on RT_USING_SERIAL_V2
                        default 0
                    config BSP_UART2_IRQ_PRIORITY
                        int "UART2 Interrupt Priority"
                        range 1 7
                        default 1
                    config BSP_UART2_DMA_PINGPONG_BUFSIZE
                        int "Set UART2 RX DMA ping-pong buffer size"
                        range 32 8192
                        depends on RT_USING_SERIAL_V2 && BSP_UART2_RX_USING_DMA
                        default 128
                endif
            menuconfig BSP_USING_UART3
                bool "Enable UART3"
                default n
                if BSP_USING_UART3
                    config BSP_UART3_RX_USING_DMA
                        bool "Enable UART3 RX DMA"
                        depends on BSP_USING_UART3 && RT_SERIAL_USING_DMA
                        default n
                    config BSP_UART3_TX_USING_DMA
                        bool "Enable UART3 TX DMA"
                        depends on BSP_USING_UART3 && RT_SERIAL_USING_DMA
                        default n
                    config BSP_UART3_RX_BUFSIZE
                        int "Set UART3 RX buffer size"
                        range 64 65535
                        depends on RT_USING_SERIAL_V2
                        default 1024
                    config BSP_UART3_TX_BUFSIZE
                        int "Set UART3 TX buffer size"
                        range 0 65535
                        depends on RT_USING_SERIAL_V2
                        default 0
                    config BSP_UART3_IRQ_PRIORITY
                        int "UART3 Interrupt Priority"
                        range 1 7
                        default 1
                    config BSP_UART3_DMA_PINGPONG_BUFSIZE
                        int "Set UART3 RX DMA ping-pong buffer size"
                        range 32 8192
                        depends on RT_USING_SERIAL_V2 && BSP_UART3_RX_USING_DMA
                        default 128
                endif
            menuconfig BSP_USING_UART4
                bool "Enable UART4"
                default y
                if BSP_USING_UART4
                    config BSP_UART4_RX_USING_DMA
                        bool "Enable UART4 RX DMA"
                        depends on BSP_USING_UART4 && RT_SERIAL_USING_DMA
                        default n
                    config BSP_UART4_TX_USING_DMA
                        bool "Enable UART4 TX DMA"
                        depends on BSP_USING_UART4 && RT_SERIAL_USING_DMA
                        default n
                    config BSP_UART4_RX_BUFSIZE
                        int "Set UART4 RX buffer size"
                        range 64 65535
                        depends on RT_USING_SERIAL_V2
                        default 1024
                    config BSP_UART4_TX_BUFSIZE
                        int "Set UART4 TX buffer size"
                        range 0 65535
                        depends on RT_USING_SERIAL_V2
                        default 0
                    config BSP_UART4_IRQ_PRIORITY
                        int "UART4 Interrupt Priority"
                        range 1 7
                        default 1
                    config BSP_UART4_DMA_PINGPONG_BUFSIZE
                        int "Set UART4 RX DMA ping-pong buffer size"
                        range 32 8192
                        depends on RT_USING_SERIAL_V2 && BSP_UART4_RX_USING_DMA
                        default 128
                endif
            menuconfig BSP_USING_UART5
                bool "Enable UART5"
                default n
                if BSP_USING_UART5
                    config BSP_UART5_RX_USING_DMA
                        bool "Enable UART5 RX DMA"
                        depends on BSP_USING_UART5 && RT_SERIAL_USING_DMA
                        default n
                    config BSP_UART5_TX_USING_DMA
                        bool "Enable UART5 TX DMA"
                        depends on BSP_USING_UART5 && RT_SERIAL_USING_DMA
                        default n
                    config BSP_UART5_RX_BUFSIZE
                        int "Set UART5 RX buffer size"
                        range 64 65535
                        depends on RT_USING_SERIAL_V2
                        default 1024
                    config BSP_UART5_TX_BUFSIZE
                        int "Set UART5 TX buffer size"
                        range 0 65535
                        depends on RT_USING_SERIAL_V2
                        default 0
                    config BSP_UART5_IRQ_PRIORITY
                        int "UART5 Interrupt Priority"
                        range 1 7
                        default 1
                    config BSP_UART5_DMA_PINGPONG_BUFSIZE
                        int "Set UART5 RX DMA ping-pong buffer size"
                        range 32 8192
                        depends on RT_USING_SERIAL_V2 && BSP_UART5_RX_USING_DMA
                        default 128
                endif
            menuconfig BSP_USING_UART6
                bool "Enable UART6"
                default n
                if BSP_USING_UART6
                    config BSP_UART6_RX_USING_DMA
                        bool "Enable UART6 RX DMA"
                        depends on BSP_USING_UART6 && RT_SERIAL_USING_DMA
                        default n
                    config BSP_UART6_TX_USING_DMA
                        bool "Enable UART6 TX DMA"
                        depends on BSP_USING_UART6 && RT_SERIAL_USING_DMA
                        default n
                    config BSP_UART6_RX_BUFSIZE
                        int "Set UART6 RX buffer size"
                        range 64 65535
                        depends on RT_USING_SERIAL_V2
                        default 1024
                    config BSP_UART6_TX_BUFSIZE
                        int "Set UART6 TX buffer size"
                        range 0 65535
                        depends on RT_USING_SERIAL_V2
                        default 0
                    config BSP_UART6_IRQ_PRIORITY
                        int "UART6 Interrupt Priority"
                        range 1 7
                        default 1
                    config BSP_UART6_DMA_PINGPONG_BUFSIZE
                        int "Set UART6 RX DMA ping-pong buffer size"
                        range 32 8192
                        depends on RT_USING_SERIAL_V2 && BSP_UART6_RX_USING_DMA
                        default 128
                endif
            menuconfig BSP_USING_UART7
                bool "Enable UART7"
                default n
                if BSP_USING_UART7
                    config BSP_UART7_RX_USING_DMA
                        bool "Enable UART7 RX DMA"
                        depends on BSP_USING_UART7 && RT_SERIAL_USING_DMA
                        default n
                    config BSP_UART7_TX_USING_DMA
                        bool "Enable UART7 TX DMA"
                        depends on BSP_USING_UART7 && RT_SERIAL_USING_DMA
                        default n
                    config BSP_UART7_RX_BUFSIZE
                        int "Set UART7 RX buffer size"
                        range 64 65535
                        depends on RT_USING_SERIAL_V2
                        default 1024
                    config BSP_UART7_TX_BUFSIZE
                        int "Set UART7 TX buffer size"
                        range 0 65535
                        depends on RT_USING_SERIAL_V2
                        default 0
                    config BSP_UART7_IRQ_PRIORITY
                        int "UART7 Interrupt Priority"
                        range 1 7
                        default 1
                    config BSP_UART7_DMA_PINGPONG_BUFSIZE
                        int "Set UART7 RX DMA ping-pong buffer size"
                        range 32 8192
                        depends on RT_USING_SERIAL_V2 && BSP_UART7_RX_USING_DMA
                        default 128
                endif
            menuconfig BSP_USING_PUART
                bool "Enable PUART"
                default n
                if BSP_USING_PUART
                    config BSP_PUART_RX_BUFSIZE
                        int "Set PUART RX buffer size"
                        range 64 65535
                        depends on RT_USING_SERIAL_V2
                        default 1024
                    config BSP_PUART_TX_BUFSIZE
                        int "Set PUART TX buffer size"
                        range 0 65535
                        depends on RT_USING_SERIAL_V2
                        default 128
                    config BSP_PUART_IRQ_PRIORITY
                        int "PUART Interrupt Priority"
                        range 1 7
                        default 1
                endif
        endif

    menuconfig BSP_USING_SPI
        bool "Enable SPI"
        default n
        select RT_USING_SPI if BSP_USING_SPI
        if BSP_USING_SPI
            config BSP_USING_SPI0
                bool "Enable SPI0"
                default n
                if BSP_USING_SPI0
                    config BSP_SPI0_USING_DMA
                        bool "Enable SPI0 DMA"
                        default n
                    config BSP_SPI0_IRQ_PRIORITY
                        int "SPI0 Interrupt Priority"
                        range 1 7
                        default 1
                    choice
                        prompt "Select SPI0 CS TYPE"
                        default BSP_SPI0_USING_SOFT_CS
                        config BSP_SPI0_USING_SOFT_CS
                            bool "Enable SPI0 software cs"
                        config BSP_SPI0_USING_HARD_CS
                            bool "Enable SPI0 hardware cs"
                    endchoice
                    choice
                        prompt "Select SPI0 IO mode"
                        default BSP_SPI0_USING_SINGLE_IO
                        config BSP_SPI0_USING_SINGLE_IO
                            bool "Enable SPI0 single IO mode"
                        config BSP_SPI0_USING_DUAL_IO
                            bool "Enable SPI0 dual IO mode"
                        config BSP_SPI0_USING_QUAD_IO
                            bool "Enable SPI0 quad IO mode"
                    endchoice
                endif
            config BSP_USING_SPI1
                bool "Enable SPI1"
                default y
                if BSP_USING_SPI1
                    config BSP_SPI1_USING_DMA
                        bool "Enable SPI1 DMA"
                        default n
                    config BSP_SPI1_IRQ_PRIORITY
                        int "SPI1 Interrupt Priority"
                        range 1 7
                        default 1
                    choice
                        prompt "Select SPI1 CS TYPE"
                        default BSP_SPI1_USING_SOFT_CS
                        config BSP_SPI1_USING_SOFT_CS
                            bool "Enable SPI1 software cs"
                        config BSP_SPI1_USING_HARD_CS
                            bool "Enable SPI1 hardware cs"
                    endchoice
                    choice
                        prompt "Select SPI1 IO mode"
                        default BSP_SPI1_USING_SINGLE_IO
                        config BSP_SPI1_USING_SINGLE_IO
                            bool "Enable SPI1 single IO mode"
                        config BSP_SPI1_USING_DUAL_IO
                            bool "Enable SPI1 dual IO mode"
                        config BSP_SPI1_USING_QUAD_IO
                            bool "Enable SPI1 quad IO mode"
                    endchoice
                endif
            config BSP_USING_SPI2
                bool "Enable SPI2"
                default n
                if BSP_USING_SPI2
                    config BSP_SPI2_USING_DMA
                    bool "Enable SPI2 DMA"
                    default n
                    config BSP_SPI2_IRQ_PRIORITY
                        int "SPI2 Interrupt Priority"
                        range 1 7
                        default 1
                    choice
                        prompt "Select SPI2 CS TYPE"
                        default BSP_SPI2_USING_SOFT_CS
                        config BSP_SPI2_USING_SOFT_CS
                            bool "Enable SPI2 software cs"
                        config BSP_SPI2_USING_HARD_CS
                            bool "Enable SPI2 hardware cs"
                    endchoice
                    choice
                        prompt "Select SPI2 IO mode"
                        default BSP_SPI2_USING_SINGLE_IO
                        config BSP_SPI2_USING_SINGLE_IO
                            bool "Enable SPI2 single IO mode"
                        config BSP_SPI2_USING_DUAL_IO
                            bool "Enable SPI2 dual IO mode"
                        config BSP_SPI2_USING_QUAD_IO
                            bool "Enable SPI2 quad IO mode"
                    endchoice
                endif
            config BSP_USING_SPI3
                bool "Enable SPI3"
                default n
                if BSP_USING_SPI3
                    config BSP_SPI3_USING_DMA
                    bool "Enable SPI3 DMA"
                    default n
                    config BSP_SPI3_IRQ_PRIORITY
                        int "SPI3 Interrupt Priority"
                        range 1 7
                        default 1
                    choice
                        prompt "Select SPI3 CS TYPE"
                        default BSP_SPI3_USING_SOFT_CS
                        config BSP_SPI3_USING_SOFT_CS
                            bool "Enable SPI3 software cs"
                        config BSP_SPI3_USING_HARD_CS
                            bool "Enable SPI3 hardware cs"
                    endchoice
                    choice
                        prompt "Select SPI3 IO mode"
                        default BSP_SPI3_USING_SINGLE_IO
                        config BSP_SPI3_USING_SINGLE_IO
                            bool "Enable SPI3 single IO mode"
                        config BSP_SPI3_USING_DUAL_IO
                            bool "Enable SPI3 dual IO mode"
                        config BSP_SPI3_USING_QUAD_IO
                            bool "Enable SPI3 quad IO mode"
                    endchoice
                endif
        endif

    menuconfig BSP_USING_ETH
       bool "Enable Ethernet"
       default n

       select RT_USING_ETH if BSP_USING_ETH
       select RT_USING_PHY if BSP_USING_ETH

       if BSP_USING_ETH
           choice
               prompt "ETH"
               default BSP_USING_ETH0

               config BSP_USING_ETH0
               bool "Enable ETH0"
               select BSP_USING_ENET_PHY_RTL8211
           endchoice
       endif

    menuconfig BSP_USING_GPTMR
        bool "Enable GPTMR"
        default n
        select RT_USING_CLOCK_TIME if BSP_USING_GPTMR
        if BSP_USING_GPTMR
            config BSP_USING_GPTMR0
                bool "Enable GPTMR0"
                depends on !HPM_USING_VECTOR_PREEMPTED_MODE
                default n
                if BSP_USING_GPTMR0
                    config BSP_GPTMR0_IRQ_PRIORITY
                    int "GPTMR0 Interrupt Priority"
                    range 1 7
                    default 1
                endif
            config BSP_USING_GPTMR1
                bool "Enable GPTMR1"
                default n
                if BSP_USING_GPTMR1
                    config BSP_GPTMR1_IRQ_PRIORITY
                    int "GPTMR1 Interrupt Priority"
                    range 1 7
                    default 1
                endif
            config BSP_USING_GPTMR2
                bool "Enable GPTMR2"
                default n
                if BSP_USING_GPTMR2
                    config BSP_GPTMR2_IRQ_PRIORITY
                    int "GPTMR2 Interrupt Priority"
                    range 1 7
                    default 1
                endif
            config BSP_USING_GPTMR3
                bool "Enable GPTMR3"
                default n
                if BSP_USING_GPTMR3
                    config BSP_GPTMR3_IRQ_PRIORITY
                    int "GPTMR3 Interrupt Priority"
                    range 1 7
                    default 1
                endif
            config BSP_USING_PTMR
                bool "Enable PTMR"
                default n
                if BSP_USING_PTMR
                    config BSP_PTMR_IRQ_PRIORITY
                    int "PTMR Interrupt Priority"
                    range 1 7
                    default 1
                endif
        endif

    menuconfig BSP_USING_I2C
        bool "Enable I2C"
        default n
        select RT_USING_I2C if BSP_USING_I2C
        if BSP_USING_I2C
            config BSP_USING_I2C0
                bool "Enable I2C0"
                default y
                if BSP_USING_I2C0
                    config BSP_I2C0_USING_DMA
                        bool "Enable I2C0 DMA"
                        default n
                    config BSP_I2C0_IRQ_PRIORITY
                        int "I2C0 Interrupt Priority"
                        range 1 7
                        default 1
                endif
            config BSP_USING_I2C1
                bool "Enable I2C1"
                default n
                if BSP_USING_I2C1
                    config BSP_I2C1_USING_DMA
                        bool "Enable I2C1 DMA"
                        default n
                    config BSP_I2C1_IRQ_PRIORITY
                        int "I2C1 Interrupt Priority"
                        range 1 7
                        default 1
                endif
            config BSP_USING_I2C2
                bool "Enable I2C2"
                default n
                if BSP_USING_I2C2
                    config BSP_I2C2_USING_DMA
                        bool "Enable I2C2 DMA"
                        default n
                    config BSP_I2C2_IRQ_PRIORITY
                        int "I2C2 Interrupt Priority"
                        range 1 7
                        default 1
                endif
            config BSP_USING_I2C3
                bool "Enable I2C3"
                default n
                if BSP_USING_I2C3
                    config BSP_I2C3_USING_DMA
                        bool "Enable I2C3 DMA"
                        default n
                    config BSP_I2C3_IRQ_PRIORITY
                        int "I2C3 Interrupt Priority"
                        range 1 7
                        default 1
                endif
        endif

    menuconfig BSP_USING_XPI_FLASH
        bool "Enable XPI FLASH"
        default n
        select RT_USING_FAL if BSP_USING_XPI_FLASH

    menuconfig BSP_USING_DAO
        bool "Enable Audio DAO play"
        default n
        select RT_USING_AUDIO if BSP_USING_DAO

    menuconfig BSP_USING_PDM
        bool "Enable Audio PDM record"
        default n
        select RT_USING_AUDIO if BSP_USING_PDM

    menuconfig BSP_USING_I2S
        bool "Enable Audio I2S device"
        default n
        select RT_USING_AUDIO if BSP_USING_I2S
        if BSP_USING_I2S
            config BSP_USING_I2S3
                bool "Enable I2S3"
                default y
            config BSP_USING_AUDIO_CODEC_WM8960
                bool "Enable audio codec on board"
                default y
        endif

    menuconfig BSP_USING_USB
       bool "Enable USB"
       default n
       if BSP_USING_USB
            config BSP_USING_USB_DEVICE
                bool "Enable USB Device"
                select RT_USING_CACHE
                default n
            config BSP_USING_USB_HOST
                bool "Enable USB Host"
                select RT_USING_CACHE
                default n
       endif

    menuconfig BSP_USING_EWDG
        bool "Enable EWDG"
        default n
        select RT_USING_WDT if BSP_USING_EWDG
        if BSP_USING_EWDG
            config BSP_USING_EWDG0
                bool "Enable EWDG0"
                default n
            config BSP_USING_EWDG1
                bool "Enable EWDG1"
                default n
        endif

    menuconfig BSP_USING_PWMV2
        bool "Enable PWM"
        default n
        select RT_USING_PWM

    menuconfig BSP_USING_MCAN
        bool "Enable MCAN"
        default n
        select RT_USING_CAN if BSP_USING_MCAN
        if BSP_USING_MCAN
            config BSP_USING_MCAN0
                bool "Enable MCAN0"
                default n
                if BSP_USING_MCAN0
                    config BSP_MCAN0_IRQ_PRIORITY
                        int "MCAN0 Interrupt Priority"
                        range 1 7
                        default 1
                endif
            config BSP_USING_MCAN1
                bool "Enable MCAN1"
                default n
                if BSP_USING_MCAN1
                    config BSP_MCAN1_IRQ_PRIORITY
                        int "MCAN1 Interrupt Priority"
                        range 1 7
                        default 1
                endif
            config BSP_USING_MCAN2
                bool "Enable MCAN2"
                default n
                if BSP_USING_MCAN2
                    config BSP_MCAN2_IRQ_PRIORITY
                        int "MCAN2 Interrupt Priority"
                        range 1 7
                        default 1
                endif
            config BSP_USING_MCAN3
                bool "Enable MCAN3"
                default n
                if BSP_USING_MCAN3
                    config BSP_MCAN3_IRQ_PRIORITY
                        int "MCAN3 Interrupt Priority"
                        range 1 7
                        default 1
                endif
        endif

    menuconfig BSP_USING_ADC
        bool "Enable ADC"
        default n
        select RT_USING_ADC
        if BSP_USING_ADC
            menuconfig BSP_USING_ADC16
                bool "Enable ADC16"
                default n
                if BSP_USING_ADC16
                    config BSP_USING_ADC0
                        bool "Enable ADC0"
                        default n
                    config BSP_USING_ADC1
                        bool "Enable ADC1"
                        default n
                endif
         endif

    menuconfig BSP_USING_WDG
        bool "Enable WDG"
        default n
        select RT_USING_WDT if BSP_USING_WDG

    menuconfig BSP_USING_ACMP
        bool "Enable ACMP (Analog Comparator)"
        default n

    menuconfig BSP_USING_CRC
        bool "Enable CRC"
        default n

    menuconfig BSP_USING_TSNS
        bool "Enable TSNS (Temperature Sensor)"
        default n

    menuconfig BSP_USING_OWR
        bool "Enable OWR (One Wire)"
        default n

    menuconfig BSP_USING_QEIV2
        bool "Enable QEIV2 (Quadrature Encoder Interface V2)"
        default n

    menuconfig BSP_USING_QEOV2
        bool "Enable QEOV2 (Quadrature Encoder Output V2)"
        default n

    menuconfig BSP_USING_SDM
        bool "Enable SDM (Sigma-Delta Modulator)"
        default n

    menuconfig BSP_USING_PLB
        bool "Enable PLB"
        default n

    menuconfig BSP_USING_PPI
        bool "Enable PPI (Parallel Port Interface)"
        default n

    menuconfig BSP_USING_LOBS
        bool "Enable LOBS"
        default n

    menuconfig BSP_USING_PTPC
        bool "Enable PTPC (PTP Controller)"
        default n

    menuconfig BSP_USING_ESC
        bool "Enable ESC (EtherCAT Slave Controller)"
        default n

    menuconfig BSP_USING_MCHTMR
        bool "Enable MCHTMR (Machine Timer)"
        default n

    menuconfig BSP_USING_SOFT_I2C
        bool "Enable Software I2C"
        default n
        select RT_USING_I2C if BSP_USING_SOFT_I2C
        if BSP_USING_SOFT_I2C

            config BSP_USING_SOFT_I2C_TIMING_DELAY_US
                int "Soft I2C timing delay in microseconds"
                range 1 1000
                default 1

            config BSP_USING_SOFT_I2C_TIMING_TIMEOUT
                int "Soft I2C timing timeout"
                range 10 10000
                default 100
            
            config BSP_USING_SOFT_I2C0
                bool "Enable Soft I2C0"
                default n
            if BSP_USING_SOFT_I2C0
                config BSP_SOFT_I2C0_SCL_PIN
                    string "Soft I2C0 SCL pin name"
                    default "None"
                config BSP_SOFT_I2C0_SDA_PIN
                    string "Soft I2C0 SDA pin name"
                    default "None"
            endif

            config BSP_USING_SOFT_I2C1
                bool "Enable Soft I2C1"
                default n
            if BSP_USING_SOFT_I2C1
                config BSP_SOFT_I2C1_SCL_PIN
                    string "Soft I2C1 SCL pin name"
                    default "None"
                config BSP_SOFT_I2C1_SDA_PIN
                    string "Soft I2C1 SDA pin name"
                    default "None"
            endif

            config BSP_USING_SOFT_I2C2
                bool "Enable Soft I2C2"
                default n
            if BSP_USING_SOFT_I2C2
                config BSP_SOFT_I2C2_SCL_PIN
                    string "Soft I2C2 SCL pin name"
                    default "None"
                config BSP_SOFT_I2C2_SDA_PIN
                    string "Soft I2C2 SDA pin name"
                    default "None"
            endif

            config BSP_USING_SOFT_I2C3
                bool "Enable Soft I2C3"
                default n
            if BSP_USING_SOFT_I2C3
                config BSP_SOFT_I2C3_SCL_PIN
                    string "Soft I2C3 SCL pin name"
                    default "None"
                config BSP_SOFT_I2C3_SDA_PIN
                    string "Soft I2C3 SDA pin name"
                    default "None"
            endif

            config BSP_USING_SOFT_I2C4
                bool "Enable Soft I2C4"
                default n
            if BSP_USING_SOFT_I2C4
                config BSP_SOFT_I2C4_SCL_PIN
                    string "Soft I2C4 SCL pin name"
                    default "None"
                config BSP_SOFT_I2C4_SDA_PIN
                    string "Soft I2C4 SDA pin name"
                    default "None"
            endif

            config BSP_USING_SOFT_I2C5
                bool "Enable Soft I2C5"
                default n
            if BSP_USING_SOFT_I2C5
                config BSP_SOFT_I2C5_SCL_PIN
                    string "Soft I2C5 SCL pin name"
                    default "None"
                config BSP_SOFT_I2C5_SDA_PIN
                    string "Soft I2C5 SDA pin name"
                    default "None"
            endif

            config BSP_USING_SOFT_I2C6
                bool "Enable Soft I2C6"
                default n
            if BSP_USING_SOFT_I2C6
                config BSP_SOFT_I2C6_SCL_PIN
                    string "Soft I2C6 SCL pin name"
                    default "None"
                config BSP_SOFT_I2C6_SDA_PIN
                    string "Soft I2C6 SDA pin name"
                    default "None"
            endif

            config BSP_USING_SOFT_I2C7
                bool "Enable Soft I2C7"
                default n
            if BSP_USING_SOFT_I2C7
                config BSP_SOFT_I2C7_SCL_PIN
                    string "Soft I2C7 SCL pin name"
                    default "None"
                config BSP_SOFT_I2C7_SDA_PIN
                    string "Soft I2C7 SDA pin name"
                    default "None"
            endif

            config BSP_USING_SOFT_I2C8
                bool "Enable Soft I2C8"
                default n
            if BSP_USING_SOFT_I2C8
                config BSP_SOFT_I2C8_SCL_PIN
                    string "Soft I2C8 SCL pin name"
                    default "None"
                config BSP_SOFT_I2C8_SDA_PIN
                    string "Soft I2C8 SDA pin name"
                    default "None"
            endif

        endif

    menuconfig BSP_USING_SOFT_SPI
        bool "Enable Software SPI"
        default n
        select RT_USING_SPI if BSP_USING_SOFT_SPI
        select RT_USING_PIN if BSP_USING_SOFT_SPI
        select RT_USING_SPI_BITOPS if BSP_USING_SOFT_SPI
        if BSP_USING_SOFT_SPI

            config BSP_USING_SOFT_SPI_TIMING_DELAY_US
                int "Soft SPI timing delay in microseconds"
                range 1 1000
                default 1

            config BSP_USING_SOFT_SPI0
                bool "Enable Soft SPI0"
                default n
            if BSP_USING_SOFT_SPI0
                config BSP_SOFT_SPI0_SCK_PIN
                    string "Soft SPI0 SCK pin name"
                    default "None"
                config BSP_SOFT_SPI0_MOSI_PIN
                    string "Soft SPI0 MOSI pin name"
                    default "None"
                config BSP_SOFT_SPI0_MISO_PIN
                    string "Soft SPI0 MISO pin name"
                    default "None"
            endif

            config BSP_USING_SOFT_SPI1
                bool "Enable Soft SPI1"
                default n
            if BSP_USING_SOFT_SPI1
                config BSP_SOFT_SPI1_SCK_PIN
                    string "Soft SPI1 SCK pin name"
                    default "None"
                config BSP_SOFT_SPI1_MOSI_PIN
                    string "Soft SPI1 MOSI pin name"
                    default "None"
                config BSP_SOFT_SPI1_MISO_PIN
                    string "Soft SPI1 MISO pin name"
                    default "None"
            endif

            config BSP_USING_SOFT_SPI2
                bool "Enable Soft SPI2"
                default n
            if BSP_USING_SOFT_SPI2
                config BSP_SOFT_SPI2_SCK_PIN
                    string "Soft SPI2 SCK pin name"
                    default "None"
                config BSP_SOFT_SPI2_MOSI_PIN
                    string "Soft SPI2 MOSI pin name"
                    default "None"
                config BSP_SOFT_SPI2_MISO_PIN
                    string "Soft SPI2 MISO pin name"
                    default "None"
            endif

        endif

endmenu

menu "HPMicro Interrupt Config"
endmenu

menu "HPMicro RT-Thread Interrupt Framework"
endmenu

menu "HPMicro Use Generic Startup Implementation"
    config HPM_BSP_USING_GENERIC_STARTUP
        bool "Enable this to use the common/startup/generic implementation"
        default n
        depends on HPM_USING_RTTHREAD_INTERRUPT_FRAMEWORK
        help
            Enable this to use the common/startup/generic implementation.
            This option is only available when RT-Thread Interrupt Framework is enabled.
endmenu

menu "HPMicro RT-Thread backtrace configuration (experimental)"
    config HPM_ENABLE_RTTHREAD_BACKTRACE_PORT
        bool "Enable RT-Thread Backtrace for HPMicro BSP"
        default n
        help
            Enable RT-Thread Backtrace to support backtrace feature

    config HPM_USE_RTTHREAD_BACKTRACE_IN_EXCEPTION_HANDLER
        select HPM_ENABLE_RTTHREAD_BACKTRACE_PORT
        bool "Use RT-Thread Backtrace in Exception Handler"
        default n
        help
            Use RT-Thread Backtrace in Exception Handler to print backtrace information
endmenu
 
endmenu

menu "Third-Party Add-ons"

menu "Segger SystemView Config"
    config BSP_USING_SYSTEMVIEW
        select RT_USING_SYSTEMVIEW
        select RT_USING_LEGACY
        bool "Enable Segger SystemView"
        default n

    if BSP_USING_SYSTEMVIEW
        menuconfig BSP_SYSTEMVIEW_RTT_SECTION
            bool "enable SystemView RTT section"
            default y
            if BSP_SYSTEMVIEW_RTT_SECTION
                config SEGGER_RTT_SECTION
                    string "segger rtt section"
                    default ".noncacheable.bss"
                config SEGGER_RTT_BUFFER_SECTION
                    string "segger rtt buffer section"
                    default ".noncacheable.bss"
                config SEGGER_SYSVIEW_SECTION
                    string "segger sysview section"
                    default ".noncacheable.bss"
            endif
    endif
endmenu

menu "RT-Thread Insight Config"
    config BSP_USING_RTI
        select BSP_USING_MCHTMR
        select RT_USING_RTI
        select RT_USING_RT_TUNNEL
        bool "Enable RT-Thread Insight(experimental)"
        default n

    if BSP_USING_RTI
        config RT_TUNNEL_USE_NONCACHE_RAM
            bool "Enable RT-Thread Insight Non-cacheable RAM support"
            default y
            help
                Enable this to use non-cacheable RAM for RT-Thread Insight data transfer.
                This option is useful when RT-Thread Insight is used with cache enabled.

    endif

endmenu

endmenu
```
