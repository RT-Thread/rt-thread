## bsp/imxrt/imxrt1021-nxp-evk/board/Kconfig
```kconfig
menu "Hardware Drivers"

config BSP_USING_QSPIFLASH
    bool
    default y

config SOC_IMXRT1021DAG5A
    bool
    select SOC_MIMXRT1020_SERIES
    select RT_USING_COMPONENTS_INIT
    select RT_USING_USER_MAIN
    select SOC_IMXRT1020_SERIES
    default y


menu "On-chip Peripheral Drivers"

    config BSP_USING_DMA
        bool "Enable DMA"
        default n

    config BSP_USING_GPIO
        bool "Enable GPIO"
        select RT_USING_PIN
        default y

    menuconfig BSP_USING_CAN
        bool "Enable CAN"
        select RT_USING_CAN
        default n

        if BSP_USING_CAN
            config BSP_USING_CAN1
                bool "Enable CAN1"
                default y
        endif

    menuconfig BSP_USING_LPUART
        bool "Enable UART"
        select RT_USING_SERIAL
        default y

        if BSP_USING_LPUART
            config BSP_USING_LPUART1
                bool "Enable LPUART1"
                default y

                config BSP_LPUART1_RX_USING_DMA
                    bool "Enable LPUART1 RX DMA"
                    depends on BSP_USING_LPUART1
                    select BSP_USING_DMA
                    select RT_SERIAL_USING_DMA
                    default n

                    config BSP_LPUART1_RX_DMA_CHANNEL
                        depends on BSP_LPUART1_RX_USING_DMA
                        int "Set LPUART1 RX DMA channel (0-32)"
                        default 0

                config BSP_LPUART1_TX_USING_DMA
                    bool "Enable LPUART1 TX DMA"
                    depends on BSP_USING_LPUART1
                    select BSP_USING_DMA
                    select RT_SERIAL_USING_DMA
                    default n

                    config BSP_LPUART1_TX_DMA_CHANNEL
                        depends on BSP_LPUART1_TX_USING_DMA
                        int "Set LPUART1 TX DMA channel (0-32)"
                        default 1
        endif
    menuconfig BSP_USING_HWTIMER
            bool "Enable GPT"
            default n
            select RT_USING_HWTIMER
            if BSP_USING_TIM
                config BSP_USING_HWTIMER1
                    bool "Enable GPT1"
                    default n

                config BSP_USING_HWTIMER2
                    bool "Enable GPT2"
                    default n
            endif
    menuconfig BSP_USING_PWM
        bool "Enable PWM"
        default n
        select RT_USING_PWM
        if BSP_USING_PWM
            menuconfig BSP_USING_PWM1
                bool "Enable output pwm1"
                default n
                if BSP_USING_PWM1
                    config BSP_USING_PWM1_CH3
                        bool "Enable PWM1 channel3"
                        default n
                endif

            menuconfig BSP_USING_PWM4
                bool "Enable output pwm4"
                default n
                if BSP_USING_PWM4
                    config BSP_USING_PWM4_CH0
                        bool "Enable PWM4 channel0"
                        default n

                    config BSP_USING_PWM4_CH1
                        bool "Enable PWM4 channel1"
                        default n
                endif
        endif

    menuconfig BSP_USING_I2C
        bool "Enable I2C"
        select RT_USING_I2C
        default n
        if BSP_USING_I2C
            config BSP_USING_I2C1
                bool "Enable I2C1"
                default n
            choice
                prompt "Select I2C1 badurate"
                default HW_I2C1_BADURATE_100kHZ

                config HW_I2C1_BADURATE_100kHZ
                    bool "Badurate 100kHZ"

                config HW_I2C1_BADURATE_400kHZ
                    bool "Badurate 400kHZ"
            endchoice
        endif

    menuconfig BSP_USING_ADC
        bool "Enable ADC"
        default n
        select RT_USING_ADC
        if BSP_USING_ADC
            config BSP_USING_ADC1
                bool "Enable ADC1"
                default n
        endif
    config BSP_USING_RTC
        bool "Enable RTC"
        select RT_USING_RTC
        default n
	config BSP_USING_CACHE
        bool "Enable CACHE"
        default n	

endmenu

menu "Onboard Peripheral Drivers"
    config BSP_USING_RGB
            bool "Enable RGB LED (PWM1_CH3A, PWM4_CH0A and PWM4_CH1A)"
            select BSP_USING_PWM1
            select BSP_USING_PWM4
            select BSP_USING_PWM1_CH3
            select BSP_USING_PWM4_CH0
            select BSP_USING_PWM4_CH1
            default n

        config BSP_USING_MPU6050
            bool "Enable MPU6050 (I2C1:J11 --> SCL; K11 --> SDA)"
            select BSP_USING_I2C1
            select PKG_USING_MPU6XXX
            default n

        menuconfig BSP_USING_AP3216C
            bool "Enable AP3216C (I2C1:J11 --> SCL; K11 --> SDA)"
            select BSP_USING_I2C1
            select PKG_USING_AP3216C
            default n
            if BSP_USING_AP3216C
                config AP3216C_USING_HW_INT
                bool "Enable interrupt"
                default n
            endif

        config BSP_USING_EEPROM
            bool "Enable I2C EEPROM (I2C1:J11 --> SCL; K11 --> SDA)"
            select BSP_USING_I2C1
            select  PKG_USING_AT24CXX
            default n

        config BSP_USING_RS232
            bool "Enable RS232"
            select BSP_USING_LPUART2
            default n

        config BSP_USING_RS485
            bool "Enable RS485"
            select BSP_USING_LPUART5
            default n
	menuconfig BSP_USING_ETH
        bool "Enable Ethernet"
        select RT_USING_NETDEV
        select RT_USING_LWIP
        default n

    if BSP_USING_ETH
        config BSP_USING_PHY
            select RT_USING_PHY
            bool "Enable ethernet phy"
            default y

        if BSP_USING_PHY
            config PHY_USING_KSZ8081
                bool "i.MX RT1020EVK uses ksz8081 phy"
                default y

            if PHY_USING_KSZ8081
                config PHY_KSZ8081_ADDRESS
                int "Specify address of phy device"
                default 2

                config PHY_RESET_KSZ8081_PORT
                    int "indicate port of reset"
                    default 1

                config PHY_RESET_KSZ8081_PIN
                    int "indicate pin of reset"
                    default 4

                config FSL_FEATURE_PHYKSZ8081_USE_RMII50M_MODE
                    bool "Enable the PHY ksz8081 RMII50M mode"
                    depends on PHY_USING_KSZ8081
                    default y
            endif
        endif
    endif					

endmenu

menu "Board extended module Drivers"

endmenu

endmenu
```

## bsp/imxrt/imxrt1050-ArchMix/Kconfig
```kconfig
mainmenu "RT-Thread Configuration"

config $BSP_DIR
    string
    option env="BSP_ROOT"
    default "."

config $RTT_DIR
    string
    option env="RTT_ROOT"
    default "../../.."

config $PKGS_DIR
    string
    option env="PKGS_ROOT"
    default "packages"

source "$RTT_DIR/Kconfig"
source "$PKGS_DIR/Kconfig"

config SOC_IMXRT1052
    bool 
    select ARCH_ARM_CORTEX_M7
    select ARCH_ARM_CORTEX_FPU
    default y
    
# RT1050 board config!
config BOARD_RT1050_ArchMix
    bool
    default y

# RT1050 flash select!
config BOARD_USING_QSPIFLASH
	bool
	default y

menu "RT1050 Bsp Config" 

menu "Select uart drivers"
    config RT_USING_UART1
        bool "Using uart1"
        select RT_USING_SERIAL
        default y 
    config RT_USING_UART2
        bool "Using uart2"
        select RT_USING_SERIAL
        default n 
    config RT_USING_UART3
        bool "Using uart3"
        select RT_USING_SERIAL
        default n 
    config RT_USING_UART8
        bool "Using uart8"
        select RT_USING_SERIAL
        default n 
endmenu

menu "Select spi bus and dev drivers"
    choice 
        prompt "SPI bus clock source"
        default LPSPI_CLK_SOURCE_FROM_PLL3PFD1

        config LPSPI_CLK_SOURCE_FROM_PLL3PFD1
            bool "PLL3PFD1"
        config LPSPI_CLK_SOURCE_FROM_PLL3PFD0
            bool "PLL3PFD0"
        config LPSPI_CLK_SOURCE_FROM_PLL2
            bool "PLL2"
        config LPSPI_CLK_SOURCE_FROM_PLL2PFD2
            bool "PLL2PFD2"
    endchoice
    config LPSPI_CLK_SOURCE
        int
        default 0 if LPSPI_CLK_SOURCE_FROM_PLL3PFD1
        default 1 if LPSPI_CLK_SOURCE_FROM_PLL3PFD0
        default 2 if LPSPI_CLK_SOURCE_FROM_PLL2
        default 3 if LPSPI_CLK_SOURCE_FROM_PLL2PFD2

    config LPSPI_CLK_SOURCE_DIVIDER
        int "SPI bus clock source divider"
        range 1 8
        default 8

    config RT_USING_SPIBUS3
        bool "Using spi3 bus"
        select RT_USING_SPI
        default n 
    choice
        prompt "spi3 bus sck io choice"
        default LPSPI3_SCK_GPIO_1
        depends on RT_USING_SPIBUS3
        config LPSPI3_SCK_GPIO_1
            bool "GPIO_AD_B1_15"
    endchoice
    choice
        prompt "spi3 bus sdo io choice"
        default LPSPI3_SDO_GPIO_1
        depends on RT_USING_SPIBUS3
        config LPSPI3_SDO_GPIO_1
            bool "GPIO_AD_B1_14"
    endchoice
    choice
        prompt "spi3 bus sdi io choice"
        default LPSPI3_SDI_GPIO_1
        depends on RT_USING_SPIBUS3
        config LPSPI3_SDI_GPIO_1
            bool "GPIO_AD_B1_13"
    endchoice

    config RT_USING_SPIBUS4
        bool "Using spi4 bus"
        select RT_USING_SPI
        default y 
    choice
        prompt "spi4 bus sck io choice"
        default LPSPI4_SCK_GPIO_1
        depends on RT_USING_SPIBUS4
        config LPSPI4_SCK_GPIO_2
            bool "GPIO_B1_07"
    endchoice
    choice
        prompt "spi4 bus sdo io choice"
        default LPSPI4_SDO_GPIO_1
        depends on RT_USING_SPIBUS4
        config LPSPI4_SDO_GPIO_2
            bool "GPIO_B1_06"
    endchoice
    choice
        prompt "spi4 bus sdi io choice"
        default LPSPI4_SDI_GPIO_1
        depends on RT_USING_SPIBUS4
        config LPSPI4_SDI_GPIO_2
            bool "GPIO_B1_05"
    endchoice

    config RT_USING_SPI_FLASH
        bool "Using spi flash with sfud"
        default n 
        select RT_USING_SPI
        select RT_USING_SFUD
        select RT_USING_PIN
    choice 
        prompt "SPI flash using spibus"
        default SPI_FLASH_USING_SPIBUS4
        depends on RT_USING_SPI_FLASH

        config SPI_FLASH_USING_SPIBUS1
            bool "spi1"
            select RT_USING_SPIBUS1
        config SPI_FLASH_USING_SPIBUS2
            bool "spi2"
            select RT_USING_SPIBUS2
        config SPI_FLASH_USING_SPIBUS3
            bool "spi3"
            select RT_USING_SPIBUS3
        config SPI_FLASH_USING_SPIBUS4
            bool "spi4"
            select RT_USING_SPIBUS4
    endchoice
    config SPI_FLASH_USING_SPIBUS_NAME
        string
        default "spi1" if SPI_FLASH_USING_SPIBUS1
        default "spi2" if SPI_FLASH_USING_SPIBUS2
        default "spi3" if SPI_FLASH_USING_SPIBUS3
        default "spi4" if SPI_FLASH_USING_SPIBUS4

    config SPI_FLASH_NAME
        string "SPI flash device name"
        default "flash0" 
        depends on RT_USING_SPI_FLASH

    config SPI_FLASH_USING_CS_PIN
        int "SPI flash cs pin index"
        default 79 
        range 1 127
        depends on RT_USING_SPI_FLASH
endmenu

menu "Select iic bus drivers"

    config RT_USING_HW_I2C1
        bool "using hardware i2c1"
        select RT_USING_I2C
        default y 
    choice
        prompt "i2c1 bus badurate choice"
        default HW_I2C1_BADURATE_100kHZ
        depends on RT_USING_HW_I2C1
        config HW_I2C1_BADURATE_100kHZ
            bool "100kHZ"
        config HW_I2C1_BADURATE_400kHZ
            bool "400kHZ"
    endchoice

    config RT_USING_HW_I2C3
        bool "using hardware i2c3"
        select RT_USING_I2C
        default n 
    choice
        prompt "i2c3 bus badurate choice"
        default HW_I2C3_BADURATE_100kHZ
        depends on RT_USING_HW_I2C3
        config HW_I2C3_BADURATE_100kHZ
            bool "100kHZ"
        config HW_I2C3_BADURATE_400kHZ
            bool "400kHZ"
    endchoice
	
    config RT_USING_HW_I2C4
        bool "using hardware i2c4"
        select RT_USING_I2C
        default n 
    choice
        prompt "i2c4 bus badurate choice"
        default HW_I2C4_BADURATE_100kHZ
        depends on RT_USING_HW_I2C4
        config HW_I2C4_BADURATE_100kHZ
            bool "100kHZ"
        config HW_I2C4_BADURATE_400kHZ
            bool "400kHZ"
    endchoice

endmenu

menu "Select lcd driver"

    if RT_USING_LCD
    comment "Notice: Arch Mix Board para: 480*272 4 4 8 2 40 10 127 45" 
    endif
    
    config RT_USING_LCD
        bool "Using lcd"
        default n 

    config LCD_WIDTH
        int "Width pixel num"
        default 480
        depends on RT_USING_LCD
    config LCD_HEIGHT
        int "Height pixel num" 
        default 272
        depends on RT_USING_LCD
    config LCD_HFP
        int "HFP"
        default 4
        depends on RT_USING_LCD
    config LCD_VFP
        int "VFP"
        default 4
        depends on RT_USING_LCD
    config LCD_HBP
        int "HBP"
        default 8
        depends on RT_USING_LCD
    config LCD_VBP
        int "VBP"
        default 2
        depends on RT_USING_LCD
    config LCD_HSW
        int "HSW"
        default 40
        depends on RT_USING_LCD
    config LCD_VSW
        int "VSW"
        default 10
        depends on RT_USING_LCD 
    config LCD_BL_PIN
        int "Backlight pin index"
        default 127
        depends on RT_USING_LCD 
    config LCD_RST_PIN
        int "Reset pin index"
        default 45
        depends on RT_USING_LCD 
endmenu

#menu "Select SDRAM driver"
    config RT_USING_SDRAM
        bool "Using sdram"
        default y 
#endmenu

#menu "Select RTC driver"
    config RT_USING_RTC_HP
        bool "Using hp rtc"
        select RT_USING_RTC
        default n 
#endmenu

if RT_USING_USB_DEVICE
    choice
        prompt "select usb device controller"
        default RT_USING_EHCI0_AS_DEVICE

        config RT_USING_EHCI0_AS_DEVICE
            bool "set EHCI0 as device"
        config RT_USING_EHCI1_AS_DEVICE
            bool "set EHCI1 as device"
    endchoice
endif

endmenu
```
