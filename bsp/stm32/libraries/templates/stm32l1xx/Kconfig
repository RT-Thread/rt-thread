## bsp/stm32/stm32f103-blue-pill/board/Kconfig
```kconfig
menu "Hardware Drivers Config"

config SOC_STM32F103C8
    bool
    select SOC_SERIES_STM32F1
    select RT_USING_COMPONENTS_INIT
    select RT_USING_USER_MAIN
    default y

menu "Onboard Peripheral Drivers"

    config BSP_USING_USB_TO_USART
        bool "Enable USB TO USART (uart1)"
        select BSP_USING_UART
        select BSP_USING_UART1
        default y

    config BSP_USING_ARDUINO
        bool "Compatible with Arduino Ecosystem (RTduino)"
        select PKG_USING_RTDUINO
        select BSP_USING_STLINK_TO_USART
        select BSP_USING_UART2
        select BSP_USING_UART3
        select BSP_USING_GPIO
        select BSP_USING_ADC
        select BSP_USING_ADC1
        select BSP_USING_PWM
        select BSP_USING_PWM2
        select BSP_USING_PWM2_CH1
        select BSP_USING_PWM2_CH2
        select BSP_USING_PWM3
        select BSP_USING_PWM3_CH1
        select BSP_USING_PWM3_CH2
        select BSP_USING_PWM3_CH3
        select BSP_USING_PWM3_CH4
        select BSP_USING_I2C
        select BSP_USING_I2C1
        select BSP_USING_SPI
        select BSP_USING_SPI2
        imply RTDUINO_USING_SERVO
        imply RTDUINO_USING_WIRE
        imply RTDUINO_USING_SPI
        default n

endmenu

menu "On-chip Peripheral Drivers"

    config BSP_USING_GPIO
        bool "Enable GPIO"
        select RT_USING_PIN
        default y

    menuconfig BSP_USING_UART
        bool "Enable UART"
        default y
        select RT_USING_SERIAL
        if BSP_USING_UART
            config BSP_USING_UART1
                bool "Enable UART1"
                default y

            config BSP_UART1_RX_USING_DMA
                bool "Enable UART1 RX DMA"
                depends on BSP_USING_UART1 && RT_SERIAL_USING_DMA
                default n

            config BSP_USING_UART2
                bool "Enable UART2"
                default n

            config BSP_UART2_RX_USING_DMA
                bool "Enable UART2 RX DMA"
                depends on BSP_USING_UART2 && RT_SERIAL_USING_DMA
                default n

            config BSP_USING_UART3
                bool "Enable UART3"
                default n

            config BSP_UART3_RX_USING_DMA
                bool "Enable UART3 RX DMA"
                depends on BSP_USING_UART3 && RT_SERIAL_USING_DMA
                default n
        endif

    menuconfig BSP_USING_I2C1
        bool "Enable I2C1 BUS (software simulation)"
        default n
        select RT_USING_I2C
        select RT_USING_I2C_BITOPS
        select RT_USING_PIN
        if BSP_USING_I2C1
            config BSP_I2C1_SCL_PIN
                int "i2c1 scl pin number (PB8)"
                range 0 143
                default 24
            config BSP_I2C1_SDA_PIN
                int "I2C1 sda pin number (PB9)"
                range 0 143
                default 25
        endif

    menuconfig BSP_USING_PWM
        bool "Enable PWM"
        default n
        select RT_USING_PWM
        if BSP_USING_PWM
        menuconfig BSP_USING_PWM2
            bool "Enable timer2 output PWM"
            default n
            if BSP_USING_PWM2
                config BSP_USING_PWM2_CH1
                    bool "Enable PWM2 channel1"
                    default n

                config BSP_USING_PWM2_CH2
                    bool "Enable PWM2 channel2"
                    default n
            endif

        menuconfig BSP_USING_PWM3
            bool "Enable timer3 output PWM"
            default n
            if BSP_USING_PWM3
                config BSP_USING_PWM3_CH1
                    bool "Enable PWM3 channel1"
                    default n

                config BSP_USING_PWM3_CH2
                    bool "Enable PWM3 channel2"
                    default n

                config BSP_USING_PWM3_CH3
                    bool "Enable PWM3 channel3"
                    default n

                config BSP_USING_PWM3_CH4
                    bool "Enable PWM3 channel4"
                    default n
            endif
        endif

    menuconfig BSP_USING_ONCHIP_RTC
        bool "Enable RTC"
        select RT_USING_RTC
        default n
        if BSP_USING_ONCHIP_RTC
            choice
                prompt "Select clock source"
                default BSP_RTC_USING_LSE

                config BSP_RTC_USING_LSE
                    bool "RTC USING LSE"

                config BSP_RTC_USING_LSI
                    bool "RTC USING LSI"
            endchoice
        endif

    menuconfig BSP_USING_SPI
        bool "Enable SPI BUS"
        default n
        select RT_USING_SPI
        if BSP_USING_SPI
            config BSP_USING_SPI2
                bool "Enable SPI2 BUS"
                default n

            config BSP_SPI2_TX_USING_DMA
                bool "Enable SPI2 TX DMA"
                depends on BSP_USING_SPI2
                default n

            config BSP_SPI2_RX_USING_DMA
                bool "Enable SPI2 RX DMA"
                depends on BSP_USING_SPI2
                select BSP_SPI2_TX_USING_DMA
                default n
        endif

     menuconfig BSP_USING_ADC
        bool "Enable ADC"
        default n
        select RT_USING_ADC
        if BSP_USING_ADC
            config BSP_USING_ADC1
                bool "Enable ADC1"
                default n

        endif

    config BSP_USING_USBD
        bool "Enable USB device"
        select RT_USING_USB_DEVICE
        default n

    source "../libraries/HAL_Drivers/Kconfig"

endmenu

menu "Board extended module Drivers"

endmenu

endmenu
```

## bsp/stm32/stm32f103-dofly-M3S/board/Kconfig
```kconfig
menu "Hardware Drivers Config"

menu "Onboard Peripheral Drivers"

    config BSP_USING_SDIO_SDCARD
        bool "Enable SDCARD (sdio)"
        select BSP_USING_SDIO
        select RT_USING_DFS
        select RT_USING_DFS_ELMFAT
        select RT_USING_PIN
        default n

    config BSP_USING_SPI_SDCARD
        bool "Enable SDCARD (spi2)"
        select BSP_USING_SPI
        select BSP_USING_SPI2
        select RT_USING_SPI_MSD
        select RT_USING_DFS
        select RT_USING_DFS_ELMFAT
        default n

    config BSP_USING_SPI_FLASH
        bool "Enable SPI FLASH (W25Q64 spi2)"
        select BSP_USING_SPI
        select BSP_USING_SPI2
        select RT_USING_SFUD
        select RT_SFUD_USING_SFDP
        default n

    config BSP_USING_EEPROM
        bool "Enable I2C EEPROM (i2c0)"
        select RT_USING_I2C
        select RT_USING_SOFT_I2C
        select RT_USING_SOFT_I2C0
        default n
endmenu

menu "On-chip Peripheral Drivers"

    config BSP_USING_GPIO
        bool "Enable GPIO"
        select RT_USING_PIN
        default y

    menuconfig BSP_USING_UART
        bool "Enable UART"
        default y
        select RT_USING_SERIAL
        if BSP_USING_UART
            config BSP_USING_UART1
                bool "Enable UART1"
                default y

        endif

    menuconfig BSP_USING_SPI
        bool "Enable SPI BUS"
        default n
        select RT_USING_SPI
        if BSP_USING_SPI
            config BSP_USING_SPI1
                bool "Enable SPI1 BUS"
                default n

            config BSP_SPI1_TX_USING_DMA
                bool "Enable SPI1 TX DMA"
                depends on BSP_USING_SPI1
                default n

            config BSP_SPI1_RX_USING_DMA
                bool "Enable SPI1 RX DMA"
                depends on BSP_USING_SPI1
                select BSP_SPI1_TX_USING_DMA
                default n

            config BSP_USING_SPI2
                bool "Enable SPI2 BUS"
                default n

            config BSP_SPI2_TX_USING_DMA
                bool "Enable SPI2 TX DMA"
                depends on BSP_USING_SPI2
                default n

            config BSP_SPI2_RX_USING_DMA
                bool "Enable SPI2 RX DMA"
                depends on BSP_USING_SPI2
                select BSP_SPI2_TX_USING_DMA
                default n

            config BSP_USING_SPI3
                bool "Enable SPI3 BUS"
                default n

            config BSP_SPI3_TX_USING_DMA
                bool "Enable SPI3 TX DMA"
                depends on BSP_USING_SPI3
                default n

            config BSP_SPI3_RX_USING_DMA
                bool "Enable SPI3 RX DMA"
                depends on BSP_USING_SPI3
                select BSP_SPI3_TX_USING_DMA
                default n
        endif

    config RT_USING_I2C
        bool
        default n
        if RT_USING_I2C
            config RT_USING_SOFT_I2C
                bool "Enable software I2C BUS"
                default n
                if RT_USING_SOFT_I2C
                    menuconfig RT_USING_SOFT_I2C0
                        bool "Enable I2C0 Bus (software simulation)"
                        default n
                        if RT_USING_SOFT_I2C0
                            comment "Please refer to the 'bsp_io.h' file to configure the pins"
                            config RT_SOFT_I2C0_SCL_PIN
                                int "i2c0 scl pin number"
                                range 0 175
                                default 26
                            config RT_SOFT_I2C0_SDA_PIN
                                int "i2c0 sda pin number"
                                range 0 175
                                default 27
                            config RT_SOFT_I2C0_BUS_NAME
                                string "Bus name"
                                default "i2c0"
                            config RT_SOFT_I2C0_TIMING_DELAY
                                int "Timing delay (us)"
                                range 0 32767
                                default 10
                            config RT_SOFT_I2C0_TIMING_TIMEOUT
                                int "Timing timeout (tick)"
                                range 0 32767
                                default 10
                        endif
                endif
        endif

    config BSP_USING_ON_CHIP_FLASH
        bool "Enable on-chip FLASH"
        default n

    config BSP_USING_SDIO
        bool "Enable SDIO"
        select RT_USING_SDIO
        select RT_USING_DFS
        default n
    source "$(BSP_DIR)/../libraries/HAL_Drivers/drivers/Kconfig"

endmenu

menu "Board extended module Drivers"

    config BSP_USING_NRF24L01
        bool "Enable NRF24L01"
        select BSP_USING_SPI
        select BSP_USING_SPI2
        select PKG_USING_NRF24L01
        default n

endmenu

endmenu
```

## bsp/stm32/stm32f103-dofly-lyc8/board/Kconfig
```kconfig
menu "Hardware Drivers Config"

config SOC_STM32F103C8
    bool
    select SOC_SERIES_STM32F1
    select RT_USING_COMPONENTS_INIT
    select RT_USING_USER_MAIN
    default y

menu "Onboard Peripheral Drivers"

endmenu

menu "On-chip Peripheral Drivers"

    config BSP_USING_GPIO
        bool "Enable GPIO"
        select RT_USING_PIN
        default y

    menuconfig BSP_USING_UART
        bool "Enable UART"
        default y
        select RT_USING_SERIAL
        if BSP_USING_UART
            config BSP_USING_UART1
                bool "Enable UART1"
                default y

            config BSP_UART1_RX_USING_DMA
                bool "Enable UART1 RX DMA"
                depends on BSP_USING_UART1 && RT_SERIAL_USING_DMA
                default n
        endif
    source "../libraries/HAL_Drivers/Kconfig"

endmenu

menu "Board extended module Drivers"

endmenu

endmenu
```
