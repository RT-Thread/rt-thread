## bsp/ESP/libraries/drivers/Kconfig
```kconfig
config SOC_ESPRESSIF
    bool 

choice
    prompt "Espressif SoC"
    default SOC_ESP32_C3

config SOC_ESP32_C3
    bool "ESP32-C3"
    select SOC_ESPRESSIF
    select RT_USING_COMPONENTS_INIT
    select RT_USING_USER_MAIN
    select PKG_USING_ESP_IDF
    select PKG_USING_FREERTOS_WRAPPER
    select PKG_FREERTOS_USING_CONFIG_H

config SOC_ESP32_C6
    bool "ESP32-C6"
    select SOC_ESPRESSIF
    select RT_USING_COMPONENTS_INIT
    select RT_USING_USER_MAIN
    select PKG_USING_ESP_IDF
    select PKG_USING_FREERTOS_WRAPPER
    select PKG_FREERTOS_USING_CONFIG_H
endchoice

menu "Hardware Drivers Config"

choice BSP_BOARD_SEL
    prompt "Select BSP board "
    default BSP_BOARD_ESP32C6_DEVKITC1 if SOC_ESP32_C6
    default BSP_BOARD_LUATOS_ESP32C3

    config BSP_BOARD_LUATOS_ESP32C3
        bool "LUATOS ESP32C3 board"
        depends on SOC_ESP32_C3

    config BSP_BOARD_HX_EXP32C3
        bool "HONGXU ESP32C3 board"
        depends on SOC_ESP32_C3

    config BSP_BOARD_ESP32C6_DEVKITC1
        bool "ESP32-C6-DevKitC-1"
        depends on SOC_ESP32_C6
endchoice

menu "Onboard Peripheral Drivers"
    config RT_BSP_LED_PIN
        int "LED GPIO PIN SET"
        default 12 if BSP_BOARD_LUATOS_ESP32C3
        default 8 if BSP_BOARD_HX_EXP32C3
        depends on BSP_USING_GPIO && !BSP_BOARD_ESP32C6_DEVKITC1

    config RT_BSP_UART_PORT
        int "UART PORT SET"
        default 0
        depends on BSP_USING_UART

    config RT_BSP_UART_TX_PIN
        int "UART TX PIN SET"
        default 21 if BSP_BOARD_LUATOS_ESP32C3
        default 16 if BSP_BOARD_ESP32C6_DEVKITC1
        depends on BSP_USING_UART

    config RT_BSP_UART_RX_PIN
        int "UART RX PIN SET"
        default 20 if BSP_BOARD_LUATOS_ESP32C3
        default 17 if BSP_BOARD_ESP32C6_DEVKITC1
        depends on BSP_USING_UART

    config RT_BSP_SPI_CS_PIN
        int "SPI GPIO PIN SET"
        default 10 if BSP_BOARD_LUATOS_ESP32C3
        depends on BSP_USING_SPI2

endmenu


menu "On-chip Peripheral Drivers"
    config BSP_USING_GPIO
        bool "Enable GPIO"
        select RT_USING_PIN
        default y
    
    config BSP_USING_UART
		bool "Enable UART"
        select RT_USING_SERIAL
        select RT_USING_SERIAL_V1
        default y

    menuconfig BSP_USING_I2C
        bool "Enable I2C"
        depends on SOC_ESP32_C3
        default n
        select RT_USING_I2C
        if BSP_USING_I2C
            menuconfig BSP_USING_HW_I2C
                bool "Enable HardWare I2C"
                default n
            menuconfig BSP_USING_SOFT_I2C
                bool "Enable software I2C (swi2c)"
                default n
                select RT_USING_I2C
                select RT_USING_SOFT_I2C
                if BSP_USING_SOFT_I2C
                menuconfig BSP_USING_SOFT_I2C0
                    bool "Enable software I2C0 Bus (swi2c0)"
                    default n
                    select RT_USING_SOFT_I2C0
                    if BSP_USING_SOFT_I2C0
                        config RT_SOFT_I2C0_SCL_PIN
                            int "swi2c0 SCL pin number"
                            default 19
                        config RT_SOFT_I2C0_SDA_PIN
                            int "swi2c0 SDA pin number"
                            default 18
                    endif
            endif


        endif

    menuconfig BSP_USING_SPI
        bool "Enable SPI"
        depends on SOC_ESP32_C3
        default n
        select RT_USING_SPI
        if BSP_USING_SPI
            config BSP_USING_SPI2
                bool "Enable SPI2"
                default n
        endif 
    
    config BSP_USING_WIFI
        bool "Enable WIFI"
        depends on SOC_ESP32_C3
        select RT_USING_WIFI
        default n
    
    config BSP_USING_BLE
        bool "Enable BLE"
        depends on SOC_ESP32_C3
        default n

    menuconfig BSP_USING_CLOCK_TIMER
        bool "Enable CLOCK_TIMER"
        depends on SOC_ESP32_C3
        select RT_USING_CLOCK_TIME
        default n
        if BSP_USING_CLOCK_TIMER
            config BSP_USING_TIMER0
                bool "Enable CLOCK_TIMER0"
                default n
        endif

    menuconfig BSP_USING_ADC
        bool "Enable ADC"
        depends on SOC_ESP32_C3 || SOC_ESP32_C6
        default y if SOC_ESP32_C6
        default n
        select RT_USING_ADC
        if BSP_USING_ADC
            config BSP_USING_ADC1
                bool "Enable ADC1"
                default y if SOC_ESP32_C6
                default n
        endif

    menuconfig BSP_USING_PWM
        bool "Enable PWM"
        depends on SOC_ESP32_C3
        default n
        select RT_USING_PWM
        if BSP_USING_PWM
            menuconfig BSP_USING_PWM0
                bool "Enable PWM0"
                default n
                if BSP_USING_PWM0
                    config BSP_LEDC_CH0_GPIO
                        int "LEDC CH0 GPIO PIN SET"
                        default 12
                    config BSP_LEDC_CH1_GPIO
                        int "LEDC CH1 GPIO PIN SET"
                        default 6
                    config BSP_LEDC_CH2_GPIO
                        int "LEDC CH2 GPIO PIN SET"
                        default 2
                    config BSP_LEDC_CH3_GPIO
                        int "LEDC CH3 GPIO PIN SET"
                        default 10
                    config BSP_LEDC_CH4_GPIO
                        int "LEDC CH4 GPIO PIN SET"
                        default 8
                    config BSP_LEDC_CH5_GPIO
                        int "LEDC CH5 GPIO PIN SET"
                        default 18
                endif
        endif

endmenu

config BSP_ENABLE_GDBSTUB
    bool "Enable ESP_GDBSTUB compontent"
    depends on SOC_ESPRESSIF
    default n

    config RT_SOFT_I2C0_HAS_PIN_DEFAULT
        bool
        default y if RT_USING_SOFT_I2C0

    config RT_SOFT_I2C0_SCL_PIN_DEFAULT
        int
        default 19 if RT_USING_SOFT_I2C0

    config RT_SOFT_I2C0_SDA_PIN_DEFAULT
        int
        default 18 if RT_USING_SOFT_I2C0

endmenu
```

## bsp/allwinner/dm/adc/Kconfig
```kconfig
config RT_ADC_SUNXI_GPADC
    bool "Allwinner Sunxi GPADC"
    depends on RT_USING_ADC
    depends on RT_USING_DM
    depends on RT_USING_CLK
    depends on RT_USING_RESET
    default n
    help
      Enable the General Purpose ADC found on supported Allwinner SoCs.

config RT_INPUT_SUNXI_LRADC
    bool "Allwinner Sunxi LRADC ladder keys"
    depends on RT_USING_INPUT
    depends on RT_USING_CLK
    depends on RT_USING_DM
    depends on RT_USING_OFW
    depends on RT_USING_RESET
    default n
    help
      Enable the low-resolution ADC keypad controller found on supported
      Allwinner SoCs. The driver reads key voltage/code child nodes from the
      LRADC device-tree node and registers one input device.
```

## bsp/allwinner/dm/audio/Kconfig
```kconfig
config RT_AUDIO_SUNXI_CODEC
    bool "Allwinner Sunxi integrated audio codec"
    depends on RT_USING_AUDIO
    depends on RT_USING_CLK
    depends on RT_USING_DM
    depends on RT_USING_HEAP
    depends on RT_USING_PIN
    depends on RT_USING_RESET
    select RT_USING_DMA
    select RT_DMA_SUNXI
    select RT_USING_SYSTEM_WORKQUEUE
    default n
    help
      Enable playback through the F101 integrated DAC. The driver uses the
      standard RT-Thread audio and DMA interfaces and supports 48 kHz-family
      PCM sample rates with 16-, 24-, or 32-bit mono and stereo streams.

config RT_AUDIO_SUN50I_H616_CODEC
    bool "Allwinner H616 integrated audio codec"
    depends on RT_USING_AUDIO
    depends on RT_USING_CLK
    depends on RT_USING_DM
    depends on RT_USING_HEAP
    depends on RT_USING_RESET
    select RT_USING_DMA
    select RT_DMA_SUNXI
    select RT_USING_SYSTEM_WORKQUEUE
    default n
    help
      Enable PCM playback through the H616 internal DAC and LINEOUT pins.
      The driver supports 16- and 24/32-bit mono or stereo PCM in both
      44.1 kHz and 48 kHz sample-rate families.

config RT_AUDIO_SUN50I_H616_AHUB
    bool "Allwinner H616 AHUB HDMI output"
    depends on RT_USING_AUDIO
    depends on RT_USING_CLK
    depends on RT_USING_DM
    depends on RT_USING_HEAP
    depends on RT_USING_OFW
    depends on RT_USING_RESET
    depends on RT_GRAPHIC_FB_SUN50I_H616_DE33
    select RT_USING_DMA
    select RT_DMA_SUNXI
    select RT_USING_SYSTEM_WORKQUEUE
    default n
    help
      Enable PCM playback through the H616 Audio Hub's fixed APBIF0 to
      internal HDMI I2S1 route. The driver pairs the AHUB DAUDIO node with
      the APBIF0 DMA node supplied by firmware and supports 16-, 24-, and
      32-bit HDMI LPCM streams with up to eight channels.

config RT_AUDIO_SUNXI_I2S0
    bool "Allwinner Sunxi I2S0 output"
    depends on RT_USING_AUDIO
    depends on RT_USING_CLK
    depends on RT_USING_DM
    depends on RT_USING_HEAP
    depends on RT_USING_PIN
    depends on RT_USING_RESET
    select RT_USING_DMA
    select RT_DMA_SUNXI
    select RT_USING_SYSTEM_WORKQUEUE
    default n
    help
      Enable the F101 I2S0 controller as a standard RT-Thread audio output.
      The controller is configured as an I2S clock master and supports the
      48 kHz-family PCM rates up to 192 kHz with 16-, 24-, or 32-bit samples.

config RT_AUDIO_SUNXI_OWA
    bool "Allwinner Sunxi OWA output"
    depends on RT_USING_AUDIO
    depends on RT_USING_CLK
    depends on RT_USING_DM
    depends on RT_USING_HEAP
    depends on RT_USING_PIN
    depends on RT_USING_RESET
    select RT_USING_DMA
    select RT_DMA_SUNXI
    select RT_USING_SYSTEM_WORKQUEUE
    default n
    help
      Enable the F101 OWA (S/PDIF) controller as a standard RT-Thread audio
      output. It emits IEC 60958 PCM through the OWA TX pin and supports the
      48 kHz-family PCM rates up to 192 kHz.
```

## bsp/allwinner/dm/clk/Kconfig
```kconfig
config RT_CLK_SUN50I_H616
    bool "Allwinner H616 main and R clock/reset controllers"
    depends on RT_USING_CLK && RT_USING_OFW
    select RT_USING_RESET
    select RT_USING_RTC
    select RT_USING_ALARM
    select RT_RTC_SUNXI
    default n
    help
      Read firmware-programmed peripheral PLL and bus dividers, and provide
      peripheral bus gates, CPU DVFS, MMC and display clocks and resets on
      the original CCU nodes. Display dividers use firmware-configured PLL
      rates.
      Requires the H616 RTC driver for the oscillator clock outputs.
      Starts disabled display PLLs at 600 MHz (DE) or 594 MHz (video),
      with a bounded lock wait. Running PLL frequencies are preserved.
      Display rates unavailable from the running PLLs are rejected rather
      than changing shared PLL settings. Also provides DE33 bus enumeration,
      internal clocks/resets and the H6/H616 TCON TOP clock and routing block.

config RT_CLK_SUN252I_F101
    bool "Allwinner Sun252i F101 clock/reset controller"
    depends on RT_USING_CLK
    depends on RT_USING_OFW
    select RT_USING_RESET
    select RT_RESET_SUN252I_F101
    default n
    help
      Provide the F101 CCU clock gates and reset controller used by the
      UART, TWI, SPI, and SMHC peripheral blocks.
```

## bsp/allwinner/dm/clock_time/Kconfig
```kconfig
config RT_CLOCK_TIMER_SUNXI
    bool "Allwinner Sunxi timer and high-speed timer"
    depends on RT_USING_CLOCK_TIME
    depends on RT_USING_DM
    depends on RT_USING_CLK
    depends on RT_USING_RESET
    default n
    help
      Enable the F101's two 24 MHz timers and two high-speed timers as
      clock_time timer devices. The RISC-V CLINT remains the system timer.
```

## bsp/allwinner/dm/dma/Kconfig
```kconfig
config RT_DMA_SUNXI
    bool "Allwinner Sunxi DMA controller"
    depends on RT_USING_CLK
    depends on RT_USING_DMA
    depends on RT_USING_DM
    depends on RT_USING_RESET
    default n
```

## bsp/allwinner/dm/dvfs/cpufreq/Kconfig
```kconfig
config RT_DVFS_SUN252I_F101_CPUFREQ
    bool "Allwinner Sun252i F101 CPUfreq driver"
    depends on RT_USING_DVFS
    default y
    help
      Register the C907 CPU as a frequency-only DVFS device. The CPU PLL
      supports linear frequency modulation; YuzukiNeko OPPs are supplied by
      its device tree and do not require a controllable CPU regulator.
```

## bsp/allwinner/dm/graphic/framebuffer/Kconfig
```kconfig
config RT_GRAPHIC_FB_SUNXI_DE
    bool "Allwinner Sunxi DE0/TCON0 framebuffer"
    depends on RT_USING_GRAPHIC
    depends on RT_USING_OFW
    depends on RT_USING_CLK
    depends on RT_USING_RESET
    depends on RT_USING_PINCTRL
    depends on RT_USING_HEAP
    default n
    help
      Enable the Allwinner DE0 and TCON0 framebuffer. The F101 backend can
      drive a parallel RGB, single-link LVDS, or MIPI-DSI video
      output selected by allwinner,output in the device tree.
      The enabled device tree node must supply display-timings, a default
      pinctrl state, and allwinner,tcon-dclk-div. A MIPI-DSI panel must use
      rgb888 video mode and describe dsi,lanes. Panel power and backlight
      remain board concerns.

config RT_GRAPHIC_FB_SUN50I_H616_DE33
    bool "Allwinner H616 DE33 HDMI framebuffer"
    depends on RT_USING_GRAPHIC
    depends on RT_USING_OFW
    depends on RT_USING_CLK
    depends on RT_USING_RESET
    depends on RT_USING_HEAP
    default n
    help
      Enable the H616 DE33 mixer, TCON-TV, and DW-HDMI framebuffer path.
      This backend is separate from the F101 DE0/TCON0 driver. It uses the
      timing supplied by display-timings when present; otherwise it starts in
      the conservative CEA-861 1280x720@60 mode, reads the connected sink's
      base EDID over DDC, and applies its preferred detailed timing. HDMI
      audio is provided separately by the AHUB/I2S driver.
```

## bsp/allwinner/dm/hwcrypto/Kconfig
```kconfig
config RT_HWCRYPTO_SUNXI_CE
    bool "Allwinner Sunxi CE 0.6 crypto engine"
    depends on RT_USING_CLK
    depends on RT_USING_DM
    depends on RT_USING_HWCRYPTO
    depends on RT_USING_OFW
    depends on RT_USING_RESET
    select RT_HWCRYPTO_USING_AES
    select RT_HWCRYPTO_USING_AES_CBC
    select RT_HWCRYPTO_USING_AES_CTR
    select RT_HWCRYPTO_USING_RNG
    default n
    help
      Enable the PIO-backed Allwinner CE 0.6 driver. It provides AES ECB,
      CBC and CTR operations plus the CE pseudo-random-number generator.

      Hash algorithms are deliberately not selected here: this CE revision
      exposes only one-shot hashing while RT-Thread's hwcrypto hash API is
      streaming.

config RT_HWCRYPTO_SUN50I_H616_CE
    bool "Allwinner H616 CE task-DMA crypto engine"
    depends on RT_USING_CLK
    depends on RT_USING_DM
    depends on RT_USING_HWCRYPTO
    depends on RT_USING_OFW
    depends on RT_USING_RESET
    select RT_HWCRYPTO_USING_AES
    select RT_HWCRYPTO_USING_AES_CBC
    select RT_HWCRYPTO_USING_RNG
    default n
    help
      Enable H616's task-descriptor DMA Crypto Engine. It supports AES ECB
      and CBC with 128-, 192-, or 256-bit keys plus the H616 TRNG. This is a
      separate CE generation from the F101 PIO engine.
```

## bsp/allwinner/dm/i2c/Kconfig
```kconfig
config RT_I2C_SUNXI
    bool "Allwinner Sunxi TWI controller"
    depends on RT_USING_I2C
    depends on RT_USING_DM
    depends on RT_USING_CLK
    depends on RT_USING_RESET
    default n
```

## bsp/allwinner/dm/input/touchscreen/Kconfig
```kconfig
config RT_INPUT_TOUCHSCREEN_SUNXI_TPADC
    bool "Allwinner Sunxi TPADC resistive touchscreen"
    depends on RT_INPUT_TOUCHSCREEN
    depends on RT_USING_CLK
    depends on RT_USING_RESET
    depends on RT_USING_OFW
    depends on RT_USING_PINCTRL
    default n
```

## bsp/allwinner/dm/inputcapture/Kconfig
```kconfig
config RT_INPUT_CAPTURE_SUNXI_IRRX
    bool "Allwinner Sunxi IR receiver"
    depends on RT_USING_INPUT_CAPTURE
    depends on RT_USING_CLK
    depends on RT_USING_RESET
    depends on RT_USING_OFW
    depends on RT_USING_PINCTRL
    default n
```
