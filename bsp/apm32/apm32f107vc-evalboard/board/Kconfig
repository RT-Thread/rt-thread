## bsp/avr32/at32uc3a0256/Kconfig
```kconfig
mainmenu "RT-Thread Configuration"

BSP_DIR := .

RTT_DIR := ../../..

# you can change the RTT_ROOT default "../.." to your rtthread_root,
# example : default "F:/git_repositories/rt-thread"

PKGS_DIR := packages

ENV_DIR := /

source "$(RTT_DIR)/Kconfig"
osource "$PKGS_DIR/Kconfig"

menu "Hardware Drivers Config"

config SOC_AVR32
    bool
    default y

choice
    prompt "Select BSP board"
    default BSP_BOARD_MIZAR32B

    config BSP_BOARD_MIZAR32B
        bool "Mizar32-B"
endchoice

menu "On-chip Peripheral Drivers"

    config BSP_USING_PIN
        bool "Enable GPIO"
        select RT_USING_PIN
        default y

    menuconfig BSP_USING_UART
        bool "Enable UART"
        select RT_USING_SERIAL
        default y
        if BSP_USING_UART
            config BSP_USING_UART0
                bool "Enable UART0"
                default n
            if BSP_USING_UART0
                choice
                    prompt "uart0 tx pin number (GP)"
                    depends on BSP_USING_UART0
                    default BSP_UART0_TX_PIN_43
                    config BSP_UART0_TX_PIN_19
                        bool "19"
                    config BSP_UART0_TX_PIN_43
                        bool "43"
                endchoice
                config BSP_UART0_TX_PIN
                    int
                    default 19 if BSP_UART0_TX_PIN_19
                    default 43 if BSP_UART0_TX_PIN_43
                config BSP_UART0_TX_PIN_FUNCTION
                    int
                    default 0 if BSP_UART0_TX_PIN_19
                    default 2 if BSP_UART0_TX_PIN_43
                choice
                    prompt "uart0 rx pin number (GP)"
                    depends on BSP_USING_UART0
                    default BSP_UART0_RX_PIN_42
                    config BSP_UART0_RX_PIN_18
                        bool "18"
                    config BSP_UART0_RX_PIN_42
                        bool "42"
                endchoice
                config BSP_UART0_RX_PIN
                    int
                    default 18 if BSP_UART0_RX_PIN_18
                    default 42 if BSP_UART0_RX_PIN_42
		config BSP_UART0_RX_PIN_FUNCTION
		    int
		    default 0 if BSP_UART0_RX_PIN_18
		    default 2 if BSP_UART0_RX_PIN_42
            endif

            config BSP_USING_UART1
                bool "Enable UART1"
                default y
            if BSP_USING_UART1
                choice
                    prompt "uart1 tx pin number (GP)"
                    depends on BSP_USING_UART1
                    default BSP_UART1_TX_PIN_6
                    config BSP_UART1_TX_PIN_6
                        bool "6"
                    config BSP_UART1_TX_PIN_95
                        bool "95"
                endchoice
                config BSP_UART1_TX_PIN
                    int
                    default 6 if BSP_UART1_TX_PIN_6
                    default 95 if BSP_UART1_TX_PIN_95
		config BSP_UART1_TX_PIN_FUNCTION
		    int
		    default 0 if BSP_UART1_TX_PIN_6
		    default 1 if BSP_UART1_TX_PIN_95
                choice
                    prompt "uart1 rx pin number (GP)"
                    depends on BSP_USING_UART1
                    default BSP_UART1_RX_PIN_5
                    config BSP_UART1_RX_PIN_5
                        bool "5"
                    config BSP_UART1_RX_PIN_96
                        bool "96"
                endchoice
                config BSP_UART1_RX_PIN
                    int
                    default 5 if BSP_UART1_RX_PIN_5
                    default 96 if BSP_UART1_RX_PIN_96
                 config BSP_UART1_RX_PIN_FUNCTION
                    int
                    default 0 if BSP_UART1_RX_PIN_5
                    default 1 if BSP_UART1_RX_PIN_96
            endif
        endif

    menuconfig BSP_USING_SOFT_I2C
        bool "Enable I2C BUS (software simulation)"
        default n
        select RT_USING_I2C
        select RT_USING_I2C_BITOPS
        select RT_USING_PIN
        if BSP_USING_SOFT_I2C
            config BSP_USING_SOFT_I2C1
                bool "Enable I2C1 Bus (software simulation)"
                default n
                if BSP_USING_SOFT_I2C1
                    config BSP_SOFT_I2C1_SCL_PIN
                        int "I2C1 SCL pin number (GP)"
                        default 30
                    config BSP_SOFT_I2C1_SDA_PIN
                        int "I2C1 SDA pin number (GP)"
                        default 29
                endif
        endif
endmenu
endmenu
```

## bsp/avr32/at32uc3b0256/Kconfig
```kconfig
mainmenu "RT-Thread Configuration"

BSP_DIR := .

RTT_DIR := ../../..

# you can change the RTT_ROOT default "../.." to your rtthread_root,
# example : default "F:/git_repositories/rt-thread"

PKGS_DIR := packages

ENV_DIR := /

source "$(RTT_DIR)/Kconfig"
osource "$PKGS_DIR/Kconfig"

menu "Hardware Drivers Config"

config SOC_AVR32
    bool
    default y

choice
    prompt "Select BSP board"
    default BSP_BOARD_MCUZONE_AVR32DEV1

    config BSP_BOARD_MCUZONE_AVR32DEV1
        bool "MCUZone AVR32DEV1 Kit"
endchoice

menu "On-chip Peripheral Drivers"

    config BSP_USING_PIN
        bool "Enable GPIO"
        select RT_USING_PIN
        default y

    menuconfig BSP_USING_UART
        bool "Enable UART"
        select RT_USING_SERIAL
        default y
        if BSP_USING_UART
            config BSP_USING_UART0
                bool "Enable UART0"
                default n
            if BSP_USING_UART0
                choice
                    prompt "uart0 tx pin number (GP)"
                    depends on BSP_USING_UART0
                    default BSP_UART0_TX_PIN_43
                    config BSP_UART0_TX_PIN_19
                        bool "19"
                    config BSP_UART0_TX_PIN_43
                        bool "43"
                endchoice
                config BSP_UART0_TX_PIN
                    int
                    default 19 if BSP_UART0_TX_PIN_19
                    default 43 if BSP_UART0_TX_PIN_43
                config BSP_UART0_TX_PIN_FUNCTION
                    int
                    default 0 if BSP_UART0_TX_PIN_19
                    default 2 if BSP_UART0_TX_PIN_43
                choice
                    prompt "uart0 rx pin number (GP)"
                    depends on BSP_USING_UART0
                    default BSP_UART0_RX_PIN_42
                    config BSP_UART0_RX_PIN_18
                        bool "18"
                    config BSP_UART0_RX_PIN_42
                        bool "42"
                endchoice
                config BSP_UART0_RX_PIN
                    int
                    default 18 if BSP_UART0_RX_PIN_18
                    default 42 if BSP_UART0_RX_PIN_42
		config BSP_UART0_RX_PIN_FUNCTION
		    int
		    default 0 if BSP_UART0_RX_PIN_18
		    default 2 if BSP_UART0_RX_PIN_42
            endif

            config BSP_USING_UART1
                bool "Enable UART1"
                default y
            if BSP_USING_UART1
                choice
                    prompt "uart1 tx pin number (GP)"
                    depends on BSP_USING_UART1
                    default BSP_UART1_TX_PIN_34
                    config BSP_UART1_TX_PIN_34
                        bool "34"
                    config BSP_UART1_TX_PIN_23
                        bool "23"
                endchoice
                config BSP_UART1_TX_PIN
                    int
                    default 34 if BSP_UART1_TX_PIN_34
                    default 23 if BSP_UART1_TX_PIN_23
		config BSP_UART1_TX_PIN_FUNCTION
		    int
		    default 2 if BSP_UART1_TX_PIN_34
		    default 0 if BSP_UART1_TX_PIN_23
                choice
                    prompt "uart1 rx pin number (GP)"
                    depends on BSP_USING_UART1
                    default BSP_UART1_RX_PIN_35
                    config BSP_UART1_RX_PIN_35
                        bool "35"
                    config BSP_UART1_RX_PIN_24
                        bool "24"
                endchoice
                config BSP_UART1_RX_PIN
                    int
                    default 35 if BSP_UART1_RX_PIN_35
                    default 24 if BSP_UART1_RX_PIN_24
                 config BSP_UART1_RX_PIN_FUNCTION
                    int
                    default 2 if BSP_UART1_RX_PIN_35
                    default 0 if BSP_UART1_RX_PIN_24
            endif
        endif
endmenu
endmenu
```

## bsp/avr32uc3b0/Kconfig
```kconfig
mainmenu "RT-Thread Configuration"

config BSP_DIR
    string
    option env="BSP_ROOT"
    default "."

config RTT_DIR
    string
    option env="RTT_ROOT"
    default "../.."

# you can change the RTT_ROOT default "../.." to your rtthread_root,
# example : default "F:/git_repositories/rt-thread"

config PKGS_DIR
    string
    option env="PKGS_ROOT"
    default "packages"

config ENV_DIR
    string
    option env="ENV_ROOT"
    default "/"

source "$RTT_DIR/Kconfig"
source "$PKGS_DIR/Kconfig"
```

## bsp/beaglebone/Kconfig
```kconfig
mainmenu "RT-Thread Configuration"

BSP_DIR := .

RTT_DIR := ../..

# you can change the RTT_ROOT default "../.." to your rtthread_root,
# example: default "F:/git_repositories/rt-thread"

PKGS_DIR := packages

ENV_DIR := /

source "$(RTT_DIR)/Kconfig"
osource "$PKGS_DIR/Kconfig"

config SOC_AM335X
    bool
    select RT_USING_CACHE
    select RT_USING_COMPONENTS_INIT
    select RT_USING_USER_MAIN
    default y

config RT_USING_UART0
    bool "Using RT_USING_UART0"
    default n

config RT_USING_UART1
    bool "Using RT_USING_UART1"
    default y
```

## bsp/bl808/m0/drivers/Kconfig
```kconfig
menu "BL808_M0 Hardware Drivers Config"
config SOC_BL808
    bool
    select RT_USING_COMPONENTS_INIT
    select RT_USING_USER_MAIN
    select ARCH_RISCV_FPU_S
    default y


config BSP_USING_JTAG_M0
    bool "Enable M0 JTAG "
    default n

menu "On-chip Peripheral Drivers"

    config BSP_USING_GPIO
        bool "Enable GPIO"
        select RT_USING_PIN
        default y

    menuconfig BSP_USING_I2C1
        bool "Enable I2C1 BUS (software simulation)"
        default n
        select RT_USING_I2C
        select RT_USING_I2C_BITOPS
        select RT_USING_PIN
        if BSP_USING_I2C1
            config BSP_I2C1_SCL_PIN
                int "i2c1 scl pin number"
                range 0 33
                default 20
            config BSP_I2C1_SDA_PIN
                int "I2C1 sda pin number"
                range 0 33
                default 21
        endif

    menuconfig BSP_USING_UART
        bool "Enable UART"
        default y
        select RT_USING_SERIAL
        if BSP_USING_UART
            config BSP_USING_UART0
                bool "Enable UART0"
                default y

            if BSP_USING_UART0
                config BSP_UART0_TXD_PIN
                    int "uart0 TXD pin number"
                    default 14

                config BSP_UART0_RXD_PIN
                    int "uart0 RXD pin number"
                    default 15

            endif

        endif

endmenu

endmenu
```

## bsp/bluetrum/ab32vg1-ab-prougen/Kconfig
```kconfig
mainmenu "RT-Thread Project Configuration"

BSP_DIR := .

RTT_DIR := ../../..

PKGS_DIR := packages

source "$(RTT_DIR)/Kconfig"
osource "$PKGS_DIR/Kconfig"
rsource "board/Kconfig"

config BOARD_BLUETRUM_EVB
    bool
    select RT_USING_COMPONENTS_INIT
    select RT_USING_USER_MAIN
    default y
```
