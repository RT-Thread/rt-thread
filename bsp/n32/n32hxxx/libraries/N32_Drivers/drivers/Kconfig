## bsp/n32/n32hxxx/libraries/N32_Drivers/drivers/Kconfig
```kconfig
if BSP_USING_USBD
    config BSP_USBD_TYPE_FS
        bool
        # "USB Full Speed (FS) Core"
    config BSP_USBD_TYPE_HS
        bool
        # "USB High Speed (HS) Core"

    config BSP_USBD_SPEED_HS
        bool
        # "USB High Speed (HS) Mode"
    config BSP_USBD_SPEED_HSINFS
        bool
        # "USB High Speed (HS) Core in FS mode"
endif
```

## bsp/n32/n32hxxx/n32h760zil7-stb/Kconfig
```kconfig
mainmenu "RT-Thread Configuration"

BSP_DIR := .

RTT_DIR := ../../../..

PKGS_DIR := packages

config SOC_N32H760ZIL7
    bool
    select SOC_SERIES_N32H7xx
    select RT_USING_COMPONENTS_INIT
    select RT_USING_USER_MAIN
    default y

source "$(RTT_DIR)/Kconfig"
osource "$PKGS_DIR/Kconfig"
rsource "../libraries/Kconfig"

if !RT_USING_NANO
rsource "board/Kconfig"
endif
```
