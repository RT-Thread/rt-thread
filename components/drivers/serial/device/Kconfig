## components/drivers/spi/Kconfig
```kconfig
menuconfig RT_USING_SPI
    bool "Using SPI Bus/Device device drivers"
    default n

    if RT_USING_SPI

        menuconfig RT_USING_SPI_ISR
            bool "Enable interrupt-safe SPI operations (using spinlocks in ISR context)"
            default y
        
        config RT_USING_SPI_BITOPS
            bool "Enable SPI bit-bang operation functions"
            default n

        menuconfig RT_USING_SOFT_SPI
            bool "Use GPIO to simulate SPI (swspi)"
            default n
            select RT_USING_PIN
            select RT_USING_SPI_BITOPS
            if RT_USING_SOFT_SPI
                config RT_SOFT_SPI0_HAS_PIN_DEFAULT
                    bool

                config RT_SOFT_SPI0_SCK_PIN_DEFAULT
                    int

                config RT_SOFT_SPI0_MISO_PIN_DEFAULT
                    int

                config RT_SOFT_SPI0_MOSI_PIN_DEFAULT
                    int

                config RT_SOFT_SPI0_HAS_BUS_NAME_DEFAULT
                    bool

                config RT_SOFT_SPI0_BUS_NAME_DEFAULT
                    string

                menuconfig RT_USING_SOFT_SPI0
                    bool "Enable software SPI0 Bus (swspi0)"
                    default n
                    if RT_USING_SOFT_SPI0
                        config RT_SOFT_SPI0_SCK_PIN
                            int "SCK pin number"
                            range 0 32767
                            default RT_SOFT_SPI0_SCK_PIN_DEFAULT if RT_SOFT_SPI0_HAS_PIN_DEFAULT
                            default 1
                        config RT_SOFT_SPI0_MISO_PIN
                            int "MISO pin number"
                            range 0 32767
                            default RT_SOFT_SPI0_MISO_PIN_DEFAULT if RT_SOFT_SPI0_HAS_PIN_DEFAULT
                            default 2
                        config RT_SOFT_SPI0_MOSI_PIN
                            int "MOSI pin number"
                            range 0 32767
                            default RT_SOFT_SPI0_MOSI_PIN_DEFAULT if RT_SOFT_SPI0_HAS_PIN_DEFAULT
                            default 3
                        config RT_SOFT_SPI0_BUS_NAME
                            string "Bus name"
                            default RT_SOFT_SPI0_BUS_NAME_DEFAULT if RT_SOFT_SPI0_HAS_BUS_NAME_DEFAULT
                            default "swspi0"
                        config RT_SOFT_SPI0_TIMING_DELAY
                            int "Timing delay (us)"
                            range 0 32767
                            default 1
                    endif
                config RT_SOFT_SPI1_HAS_PIN_DEFAULT
                    bool

                config RT_SOFT_SPI1_SCK_PIN_DEFAULT
                    int

                config RT_SOFT_SPI1_MISO_PIN_DEFAULT
                    int

                config RT_SOFT_SPI1_MOSI_PIN_DEFAULT
                    int

                config RT_SOFT_SPI1_HAS_BUS_NAME_DEFAULT
                    bool

                config RT_SOFT_SPI1_BUS_NAME_DEFAULT
                    string

                menuconfig RT_USING_SOFT_SPI1
                    bool "Enable software SPI1 Bus (swspi1)"
                    default n
                    if RT_USING_SOFT_SPI1
                        config RT_SOFT_SPI1_SCK_PIN
                            int "SCK pin number"
                            range 0 32767
                            default RT_SOFT_SPI1_SCK_PIN_DEFAULT if RT_SOFT_SPI1_HAS_PIN_DEFAULT
                            default 4
                        config RT_SOFT_SPI1_MISO_PIN
                            int "MISO pin number"
                            range 0 32767
                            default RT_SOFT_SPI1_MISO_PIN_DEFAULT if RT_SOFT_SPI1_HAS_PIN_DEFAULT
                            default 5
                        config RT_SOFT_SPI1_MOSI_PIN
                            int "MOSI pin number"
                            range 0 32767
                            default RT_SOFT_SPI1_MOSI_PIN_DEFAULT if RT_SOFT_SPI1_HAS_PIN_DEFAULT
                            default 6
                        config RT_SOFT_SPI1_BUS_NAME
                            string "Bus name"
                            default RT_SOFT_SPI1_BUS_NAME_DEFAULT if RT_SOFT_SPI1_HAS_BUS_NAME_DEFAULT
                            default "swspi1"
                        config RT_SOFT_SPI1_TIMING_DELAY
                            int "Timing delay (us)"
                            range 0 32767
                            default 1
                    endif
                config RT_SOFT_SPI2_HAS_PIN_DEFAULT
                    bool

                config RT_SOFT_SPI2_SCK_PIN_DEFAULT
                    int

                config RT_SOFT_SPI2_MISO_PIN_DEFAULT
                    int

                config RT_SOFT_SPI2_MOSI_PIN_DEFAULT
                    int

                config RT_SOFT_SPI2_HAS_BUS_NAME_DEFAULT
                    bool

                config RT_SOFT_SPI2_BUS_NAME_DEFAULT
                    string

                menuconfig RT_USING_SOFT_SPI2
                    bool "Enable software SPI2 Bus (swspi2)"
                    default n
                    if RT_USING_SOFT_SPI2
                        config RT_SOFT_SPI2_SCK_PIN
                            int "SCK pin number"
                            range 0 32767
                            default RT_SOFT_SPI2_SCK_PIN_DEFAULT if RT_SOFT_SPI2_HAS_PIN_DEFAULT
                            default 7
                        config RT_SOFT_SPI2_MISO_PIN
                            int "MISO pin number"
                            range 0 32767
                            default RT_SOFT_SPI2_MISO_PIN_DEFAULT if RT_SOFT_SPI2_HAS_PIN_DEFAULT
                            default 8
                        config RT_SOFT_SPI2_MOSI_PIN
                            int "MOSI pin number"
                            range 0 32767
                            default RT_SOFT_SPI2_MOSI_PIN_DEFAULT if RT_SOFT_SPI2_HAS_PIN_DEFAULT
                            default 9
                        config RT_SOFT_SPI2_BUS_NAME
                            string "Bus name"
                            default RT_SOFT_SPI2_BUS_NAME_DEFAULT if RT_SOFT_SPI2_HAS_BUS_NAME_DEFAULT
                            default "swspi2"
                        config RT_SOFT_SPI2_TIMING_DELAY
                            int "Timing delay (us)"
                            range 0 32767
                            default 1
                    endif
                config RT_SOFT_SPI3_HAS_PIN_DEFAULT
                    bool

                config RT_SOFT_SPI3_SCK_PIN_DEFAULT
                    int

                config RT_SOFT_SPI3_MISO_PIN_DEFAULT
                    int

                config RT_SOFT_SPI3_MOSI_PIN_DEFAULT
                    int

                config RT_SOFT_SPI3_HAS_BUS_NAME_DEFAULT
                    bool

                config RT_SOFT_SPI3_BUS_NAME_DEFAULT
                    string

                menuconfig RT_USING_SOFT_SPI3
                    bool "Enable software SPI3 Bus (swspi3)"
                    default n
                    if RT_USING_SOFT_SPI3
                        config RT_SOFT_SPI3_SCK_PIN
                            int "SCK pin number"
                            range 0 32767
                            default RT_SOFT_SPI3_SCK_PIN_DEFAULT if RT_SOFT_SPI3_HAS_PIN_DEFAULT
                            default 10
                        config RT_SOFT_SPI3_MISO_PIN
                            int "MISO pin number"
                            range 0 32767
                            default RT_SOFT_SPI3_MISO_PIN_DEFAULT if RT_SOFT_SPI3_HAS_PIN_DEFAULT
                            default 11
                        config RT_SOFT_SPI3_MOSI_PIN
                            int "MOSI pin number"
                            range 0 32767
                            default RT_SOFT_SPI3_MOSI_PIN_DEFAULT if RT_SOFT_SPI3_HAS_PIN_DEFAULT
                            default 12
                        config RT_SOFT_SPI3_BUS_NAME
                            string "Bus name"
                            default RT_SOFT_SPI3_BUS_NAME_DEFAULT if RT_SOFT_SPI3_HAS_BUS_NAME_DEFAULT
                            default "swspi3"
                        config RT_SOFT_SPI3_TIMING_DELAY
                            int "Timing delay (us)"
                            range 0 32767
                            default 1
                    endif
                config RT_SOFT_SPI4_HAS_PIN_DEFAULT
                    bool

                config RT_SOFT_SPI4_SCK_PIN_DEFAULT
                    int

                config RT_SOFT_SPI4_MISO_PIN_DEFAULT
                    int

                config RT_SOFT_SPI4_MOSI_PIN_DEFAULT
                    int

                config RT_SOFT_SPI4_HAS_BUS_NAME_DEFAULT
                    bool

                config RT_SOFT_SPI4_BUS_NAME_DEFAULT
                    string

                menuconfig RT_USING_SOFT_SPI4
                    bool "Enable software SPI4 Bus (swspi4)"
                    default n
                    if RT_USING_SOFT_SPI4
                        config RT_SOFT_SPI4_SCK_PIN
                            int "SCK pin number"
                            range 0 32767
                            default RT_SOFT_SPI4_SCK_PIN_DEFAULT if RT_SOFT_SPI4_HAS_PIN_DEFAULT
                            default 13
                        config RT_SOFT_SPI4_MISO_PIN
                            int "MISO pin number"
                            range 0 32767
                            default RT_SOFT_SPI4_MISO_PIN_DEFAULT if RT_SOFT_SPI4_HAS_PIN_DEFAULT
                            default 14
                        config RT_SOFT_SPI4_MOSI_PIN
                            int "MOSI pin number"
                            range 0 32767
                            default RT_SOFT_SPI4_MOSI_PIN_DEFAULT if RT_SOFT_SPI4_HAS_PIN_DEFAULT
                            default 15
                        config RT_SOFT_SPI4_BUS_NAME
                            string "Bus name"
                            default RT_SOFT_SPI4_BUS_NAME_DEFAULT if RT_SOFT_SPI4_HAS_BUS_NAME_DEFAULT
                            default "swspi4"
                        config RT_SOFT_SPI4_TIMING_DELAY
                            int "Timing delay (us)"
                            range 0 32767
                            default 1
                    endif
                config RT_SOFT_SPI5_HAS_PIN_DEFAULT
                    bool

                config RT_SOFT_SPI5_SCK_PIN_DEFAULT
                    int

                config RT_SOFT_SPI5_MISO_PIN_DEFAULT
                    int

                config RT_SOFT_SPI5_MOSI_PIN_DEFAULT
                    int

                config RT_SOFT_SPI5_HAS_BUS_NAME_DEFAULT
                    bool

                config RT_SOFT_SPI5_BUS_NAME_DEFAULT
                    string

                menuconfig RT_USING_SOFT_SPI5
                    bool "Enable software SPI5 Bus (swspi5)"
                    default n
                    if RT_USING_SOFT_SPI5
                        config RT_SOFT_SPI5_SCK_PIN
                            int "SCK pin number"
                            range 0 32767
                            default RT_SOFT_SPI5_SCK_PIN_DEFAULT if RT_SOFT_SPI5_HAS_PIN_DEFAULT
                            default 16
                        config RT_SOFT_SPI5_MISO_PIN
                            int "MISO pin number"
                            range 0 32767
                            default RT_SOFT_SPI5_MISO_PIN_DEFAULT if RT_SOFT_SPI5_HAS_PIN_DEFAULT
                            default 17
                        config RT_SOFT_SPI5_MOSI_PIN
                            int "MOSI pin number"
                            range 0 32767
                            default RT_SOFT_SPI5_MOSI_PIN_DEFAULT if RT_SOFT_SPI5_HAS_PIN_DEFAULT
                            default 18
                        config RT_SOFT_SPI5_BUS_NAME
                            string "Bus name"
                            default RT_SOFT_SPI5_BUS_NAME_DEFAULT if RT_SOFT_SPI5_HAS_BUS_NAME_DEFAULT
                            default "swspi5"
                        config RT_SOFT_SPI5_TIMING_DELAY
                            int "Timing delay (us)"
                            range 0 32767
                            default 1
                    endif
                config RT_SOFT_SPI6_HAS_PIN_DEFAULT
                    bool

                config RT_SOFT_SPI6_SCK_PIN_DEFAULT
                    int

                config RT_SOFT_SPI6_MISO_PIN_DEFAULT
                    int

                config RT_SOFT_SPI6_MOSI_PIN_DEFAULT
                    int

                config RT_SOFT_SPI6_HAS_BUS_NAME_DEFAULT
                    bool

                config RT_SOFT_SPI6_BUS_NAME_DEFAULT
                    string

                menuconfig RT_USING_SOFT_SPI6
                    bool "Enable software SPI6 Bus (swspi6)"
                    default n
                    if RT_USING_SOFT_SPI6
                        config RT_SOFT_SPI6_SCK_PIN
                            int "SCK pin number"
                            range 0 32767
                            default RT_SOFT_SPI6_SCK_PIN_DEFAULT if RT_SOFT_SPI6_HAS_PIN_DEFAULT
                            default 19
                        config RT_SOFT_SPI6_MISO_PIN
                            int "MISO pin number"
                            range 0 32767
                            default RT_SOFT_SPI6_MISO_PIN_DEFAULT if RT_SOFT_SPI6_HAS_PIN_DEFAULT
                            default 20
                        config RT_SOFT_SPI6_MOSI_PIN
                            int "MOSI pin number"
                            range 0 32767
                            default RT_SOFT_SPI6_MOSI_PIN_DEFAULT if RT_SOFT_SPI6_HAS_PIN_DEFAULT
                            default 21
                        config RT_SOFT_SPI6_BUS_NAME
                            string "Bus name"
                            default RT_SOFT_SPI6_BUS_NAME_DEFAULT if RT_SOFT_SPI6_HAS_BUS_NAME_DEFAULT
                            default "swspi6"
                        config RT_SOFT_SPI6_TIMING_DELAY
                            int "Timing delay (us)"
                            range 0 32767
                            default 1
                    endif
            endif

        config RT_SPI_BITOPS_DEBUG
            bool "Use simulate SPI debug message"
            depends on RT_USING_SOFT_SPI
            default n

        config RT_USING_QSPI
            bool "Enable QSPI mode"
            default n

        config RT_USING_SPI_MSD
            bool "Using SD/TF card driver with spi"
            select RT_USING_DFS
            default n

        config RT_USING_SFUD
            bool "Using Serial Flash Universal Driver"
            default n
            help
                An using JEDEC's SFDP standard serial (SPI) flash universal driver library

            if RT_USING_SFUD
                config RT_SFUD_USING_SFDP
                bool "Using auto probe flash JEDEC SFDP parameter"
                default y

                config RT_SFUD_USING_FLASH_INFO_TABLE
                bool "Using defined supported flash chip information table"
                default y

                config RT_SFUD_USING_QSPI
                bool "Using QSPI mode support"
                select RT_USING_QSPI
                default n

                config RT_SFUD_SPI_MAX_HZ
                int "Default spi maximum speed(HZ)"
                range 0 50000000
                default 50000000
                help
                    Read the JEDEC SFDP command must run at 50 MHz or less,and you also can use rt_spi_configure(); to config spi speed.

                config RT_DEBUG_SFUD
                bool "Show more SFUD debug information"
                default n
            endif

        config RT_USING_ENC28J60
            bool "Using ENC28J60 SPI Ethernet network interface"
            select RT_USING_LWIP
            default n

        config RT_USING_SPI_WIFI
            bool "Using RW009/007 SPI Wi-Fi wireless interface"
            select RT_USING_LWIP
            default n
    endif

if RT_USING_DM && RT_USING_SPI
    osource "$(SOC_DM_SPI_DIR)/Kconfig"
endif
```
