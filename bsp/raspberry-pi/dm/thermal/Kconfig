## bsp/renesas/ra8p1-titan-board/m33/board/Kconfig
```kconfig
menu "Hardware Drivers Config"

    menu "On-chip Peripheral Drivers"

        rsource "../../../libraries/HAL_Drivers/drivers/Kconfig"

        menuconfig BSP_USING_UART
            bool "Enable UART"
            default y
            select RT_USING_SERIAL
            select RT_USING_SERIAL_V2
            if BSP_USING_UART
                menuconfig BSP_USING_UART5
                    bool "Enable UART5"
                    default y
                    if BSP_USING_UART5
                        config BSP_UART5_RX_BUFSIZE
                            int "Set UART5 RX buffer size"
                            range 64 65535
                            depends on RT_USING_SERIAL_V2
                            default 256

                        config BSP_UART5_TX_BUFSIZE
                            int "Set UART5 TX buffer size"
                            range 0 65535
                            depends on RT_USING_SERIAL_V2
                            default 0
                    endif
            endif
    endmenu
endmenu
```

## bsp/renesas/ra8p1-titan-board/m85/Kconfig
```kconfig
mainmenu "RT-Thread Configuration"

BSP_DIR := .

RTT_DIR := ../../../..

# you can change the RTT_ROOT default "../.." to your rtthread_root,
# example : default "F:/git_repositories/rt-thread"

PKGS_DIR := packages

ENV_DIR := /

config SOC_R7KA8P1KF
    bool
    select SOC_SERIES_R7KA8P1
    select SOC_SERIES_R7KA8P1_CORE0
    select RT_USING_COMPONENTS_INIT
    select RT_USING_USER_MAIN
    select RT_USING_OFW if RT_USING_DM
    select RT_USING_BUILTIN_FDT if RT_USING_DM
    select RT_USING_PIC if RT_USING_DM
    select RT_PIC_ARM_NVIC if RT_USING_DM
    select RT_USING_PIN if RT_USING_DM
    default y

config RT_BUILTIN_FDT_PATH
    string
    default "board/dts/ra8p1-titan-m85.dtb" if RT_USING_DM

source "$(RTT_DIR)/Kconfig"

osource "$PKGS_DIR/Kconfig"
rsource "../../libraries/Kconfig"

if !RT_USING_NANO
rsource "$(BSP_DIR)/board/Kconfig"
endif
```

## bsp/renesas/rh850/libraries/Kconfig
```kconfig
config SOC_FAMILY_RENESAS_RH850
    bool

config SOC_SERIES_RH850_U2C
    bool
    select SOC_FAMILY_RENESAS_RH850
```

## bsp/renesas/rh850/qemu-rh850-u2c/Kconfig
```kconfig
mainmenu "RT-Thread Configuration"

BSP_DIR := .

RTT_DIR := ../../../..

PKGS_DIR := packages

config SOC_R7F702600
    bool
    select SOC_SERIES_RH850_U2C
    select RT_USING_COMPONENTS_INIT
    select RT_USING_USER_MAIN
    default y

source "$(RTT_DIR)/Kconfig"
osource "$PKGS_DIR/Kconfig"
rsource "../libraries/Kconfig"
source "$(RTT_DIR)/libcpu/rh850/common/Kconfig"
```

## bsp/rockchip/dm/audio/Kconfig
```kconfig
menuconfig RT_AUDIO_ROCKCHIP
    bool "Enable Rockchip Audio"
    depends on RT_USING_OFW
    depends on RT_USING_AUDIO
    default n
    help
      Rockchip I2S/TDM and SAI audio for analog and HDMI playback.
      RK3528 uses SAI2 with its internal DAC and SAI3 for HDMI.
      HDMI audio requires the corresponding display driver.

if RT_AUDIO_ROCKCHIP

config RT_AUDIO_ROCKCHIP_I2S_TDM
    bool "Rockchip I2S/TDM controller (CPU DAI)"
    default y
    help
      I2S/TDM block driver (e.g. i2s0_8ch, i2s1_8ch).
      Uses PL330 DMA when RT_USING_DMA is enabled, otherwise PIO.

config RT_AUDIO_ROCKCHIP_SAI
    bool "Rockchip RK3528 SAI controller (playback)"
    depends on RT_USING_DMA && RT_USING_CLK && RT_USING_RESET
    default y if RT_CLK_ROCKCHIP_RK3528
    help
      RK3528 SAI2/SAI3 playback for the internal DAC and HDMI.
      Supports stereo S16_LE at 44.1/48 kHz using DMA.
      Enable the board's DMA controller driver as well (PL330 on RK3528).

menuconfig RT_AUDIO_ROCKCHIP_CODEC
    bool "Rockchip codec support"
    depends on RT_AUDIO_ROCKCHIP_I2S_TDM || RT_AUDIO_ROCKCHIP_SAI
    default y
    help
      Codec drivers for analog audio (headphone / line-out).
      Not used for the HDMI audio card.

if RT_AUDIO_ROCKCHIP_CODEC

config RT_AUDIO_ROCKCHIP_CODEC_RK817
    bool "RK817/RK809 codec (I2C PMIC)"
    depends on RT_USING_I2C && RT_AUDIO_ROCKCHIP_I2S_TDM
    select RT_MFD_RK8XX_I2C
    default y
    help
      RK809/RK817 built-in codec on ROCK 3A, routed over I2S1.

config RT_AUDIO_ROCKCHIP_CODEC_RK3528
    bool "RK3528 internal DAC codec"
    depends on RT_AUDIO_ROCKCHIP_SAI && RT_USING_PIN
    default y if RT_CLK_ROCKCHIP_RK3528
    help
      Stereo line-out playback through the RK3528 internal DAC,
      including optional pa-ctl GPIO, volume and mute controls.

endif

config RT_AUDIO_ROCKCHIP_CARD
    bool "Rockchip simple-audio-card (machine driver)"
    depends on RT_AUDIO_ROCKCHIP_I2S_TDM || RT_AUDIO_ROCKCHIP_SAI
    default y
    help
      Parses simple-audio-card nodes (e.g. rk809-sound, hdmi_sound)
      and registers rt_audio_device instances.

endif
```

## bsp/rockchip/dm/ethernet/Kconfig
```kconfig
config RT_ETHERNET_DWMAC_ROCKCHIP
    bool "Rockchip DWMAC (RK3308/RK3528/RK3568/RK3576/RK3588)"
    depends on RT_ETHERNET_DWMAC
    depends on RT_USING_OFW
    default n
```

## bsp/rockchip/dm/graphic/framebuffer/Kconfig
```kconfig
config RT_GRAPHIC_FB_VOP2
    bool "Rockchip VOP2 framebuffer"
    depends on RT_USING_GRAPHIC
    depends on RT_USING_CLK
    default n
    help
        Rockchip VOP2 display driver with primary, overlay and cursor planes.
        Supported compatibles: rk3568, rk3588, rk3528, rk3562, rk3576 (rockchip,rk3576-vop).

        Requires connector output initialized by boot loader unless a full
        display pipeline is added later.

        Device tree optional properties on the vop node:
          rockchip,fb-width / rockchip,fb-height
          rockchip,active-vp

config RT_GRAPHIC_FB_VOPL
    bool "Rockchip VOPL framebuffer (rk3576-vop-lit)"
    depends on RT_USING_GRAPHIC
    depends on RT_USING_CLK
    depends on RT_GRAPHIC_DISPLAY_ROCKCHIP
    default n
    help
        Lite VOP on RK3576 (EBC block, single primary plane, DSI/RGB/eDP/HDMI).

config RT_GRAPHIC_FB_VOP1
    bool "Rockchip VOP1 framebuffer"
    depends on RT_USING_GRAPHIC
    depends on RT_USING_CLK
    default n
    help
        Rockchip legacy VOP display driver (Lite and Big variants).

        Lite: rk3308, rk3506, px30-vop-lit (primary + cursor).
        Big: rk3328, rk3288, rk3399, rk3368, rv1126/rv1126b, etc.
        (primary + overlay + cursor).

        Device tree optional properties:
          rockchip,fb-width / rockchip,fb-height

config RT_GRAPHIC_DISPLAY_ROCKCHIP
    bool "Rockchip display subsystem (route + pipeline)"
    depends on RT_USING_GRAPHIC
    depends on RT_USING_OFW
    default n
    help
        Parse display-subsystem routes and enable VOP + connector + panel.

        The rockchip.display= boot argument selects the active route:
          auto   - enable connected outputs, then fixed panels on unused VPs
          hdmi   - force the HDMI route
          dsi0   - force the DSI0 route
          dsi1   - force the DSI1 route
          extend - enable independent framebuffers on all usable routes
          mirror - deprecated alias for extend

config RT_GRAPHIC_CONNECTOR_DSI
    bool "Rockchip DW MIPI DSI connector (DSI1)"
    depends on RT_GRAPHIC_DISPLAY_ROCKCHIP
    default y

config RT_GRAPHIC_CONNECTOR_DSI2
    bool "Rockchip DW MIPI DSI2 connector (rk3576)"
    depends on RT_GRAPHIC_DISPLAY_ROCKCHIP
    depends on RT_PHYE_ROCKCHIP_MIPI_DCPHY
    default y

config RT_GRAPHIC_CONNECTOR_HDMI
    bool "Rockchip DW HDMI connector"
    depends on RT_GRAPHIC_DISPLAY_ROCKCHIP
    depends on RT_USING_CLK
    default y

config RT_GRAPHIC_BACKLIGHT_HINT
    bool "Enable backlight Kconfig hint"
    depends on RT_GRAPHIC_DISPLAY_ROCKCHIP
    default y
    help
        Panel backlight needs RT_GRAPHIC_BACKLIGHT + RT_GRAPHIC_BACKLIGHT_PWM
        and a pwm-backlight node in device tree.

config RT_GRAPHIC_PANEL_SIMPLE
    bool "Simple panel driver"
    depends on RT_GRAPHIC_DISPLAY_ROCKCHIP
    default y

config RT_GRAPHIC_INPUT_TOUCH_HINT
    bool "Enable touch hint in graphic Kconfig"
    depends on RT_GRAPHIC_DISPLAY_ROCKCHIP
    default y
    help
        MIPI DSI panels with touch need a separate I2C touch driver
        (e.g. RT_INPUT_TOUCHSCREEN_GOODIX for GT911). Enable it under
        RT-Thread Components -> Input device drivers -> Touchscreen.
```

## bsp/rockchip/dm/graphic/logo/Kconfig
```kconfig
config RT_GRAPHIC_LOGO_RADXA_CLUT224
    bool "Standard 224-color Radxa logo"

config RT_GRAPHIC_LOGO_ROCKCHIP_CLUT224
    bool "Standard 224-color Rockchip logo"
```

## bsp/rockchip/dm/graphic/logo/Kconfig.path
```kconfig
if RT_GRAPHIC_LOGO_RADXA_CLUT224
    config RT_GRAPHIC_LOGO_RADXA_CLUT224_PATH
        string
        default "../dm/graphic/logo/logo-radxa-clut224.ppm"
endif
if RT_GRAPHIC_LOGO_ROCKCHIP_CLUT224
    config RT_GRAPHIC_LOGO_ROCKCHIP_CLUT224_PATH
        string
        default "../dm/graphic/logo/logo-rockchip-clut224.ppm"
endif
```

## bsp/rockchip/dm/hwcrypto/Kconfig
```kconfig
config RT_HWCRYPTO_RNG_ROCKCHIP
    bool "Rockchip Random Number Generator support"
    depends on RT_HWCRYPTO_USING_RNG
    depends on RT_USING_RESET
    default n

config RT_HWCRYPTO_CRYPTO_ROCKCHIP_V2
    bool "Rockchip Crypto V2 (cipher/hash/pka)"
    depends on RT_USING_RESET
    depends on (RT_HWCRYPTO_USING_AES && \
                (RT_HWCRYPTO_USING_AES_ECB || RT_HWCRYPTO_USING_AES_CBC || \
                 RT_HWCRYPTO_USING_AES_CFB || RT_HWCRYPTO_USING_AES_CTR || \
                 RT_HWCRYPTO_USING_AES_OFB)) || \
               (RT_HWCRYPTO_USING_DES && \
                (RT_HWCRYPTO_USING_DES_ECB || RT_HWCRYPTO_USING_DES_CBC)) || \
               (RT_HWCRYPTO_USING_3DES && \
                (RT_HWCRYPTO_USING_3DES_ECB || RT_HWCRYPTO_USING_3DES_CBC)) || \
               (RT_HWCRYPTO_USING_GCM && RT_HWCRYPTO_USING_AES) || \
               RT_HWCRYPTO_USING_MD5 || RT_HWCRYPTO_USING_SHA1 || \
               (RT_HWCRYPTO_USING_SHA2 && \
                (RT_HWCRYPTO_USING_SHA2_224 || RT_HWCRYPTO_USING_SHA2_256 || \
                 RT_HWCRYPTO_USING_SHA2_384 || RT_HWCRYPTO_USING_SHA2_512)) || \
               (RT_HWCRYPTO_USING_BIGNUM && \
                RT_HWCRYPTO_USING_BIGNUM_EXPTMOD)
    default n
```

## bsp/rockchip/dm/pci/Kconfig
```kconfig
config RT_PCIE_ROCKCHIP
    bool "Rockchip PCIe controller"
    depends on RT_USING_OFW
    depends on RT_USING_CLK
    depends on RT_USING_PIN
    depends on RT_USING_PINCTRL
    depends on RT_USING_RESET
    depends on RT_USING_REGULATOR
    depends on RT_USING_PHYE
    default n

config RT_PCIE_ROCKCHIP_EP
    bool "Rockchip PCIe endpoint"
    depends on RT_PCI_ENDPOINT
    depends on RT_USING_OFW
    depends on RT_USING_CLK
    depends on RT_USING_PIN
    depends on RT_USING_PINCTRL
    depends on RT_USING_RESET
    depends on RT_USING_REGULATOR
    depends on RT_USING_PHYE
    default n

config RT_PCI_DW_ROCKCHIP
    bool "Rockchip DesignWare PCIe"
    depends on RT_PCI_DW
    depends on RT_USING_PIN
    depends on RT_USING_PINCTRL
    depends on RT_USING_PHYE
    depends on RT_USING_RESET
    depends on RT_USING_REGULATOR
    select RT_PCI_DW_HOST
    select RT_PCI_DW_EP
    default n
```

## bsp/rockchip/dm/phye/Kconfig
```kconfig
config RT_PHYE_ROCKCHIP_NANENG_COMBO
    bool "NANENG COMBO PHY Driver"
    depends on RT_MFD_SYSCON
    default n

config RT_PHYE_ROCKCHIP_SNPS_PCIE3
    bool "Snps PCIe3 PHY Driver"
    depends on RT_MFD_SYSCON
    default n

config RT_PHYE_ROCKCHIP_INNO_USB2
    bool "Rockchip Inno USB2 PHY Driver"
    depends on RT_MFD_SYSCON
    default n

config RT_PHYE_ROCKCHIP_MIPI_DCPHY
    bool "Rockchip Samsung MIPI DCPHY (rk3576/rk3588 DSI)"
    depends on RT_USING_PHYE
    depends on RT_USING_CLK
    default n

config RT_PHYE_ROCKCHIP_INNO_DSIDPHY
    bool "Rockchip Innosilicon MIPI DSI DPHY (rk3568)"
    depends on RT_USING_PHYE
    depends on RT_USING_CLK
    default n

config RT_PHYE_ROCKCHIP_HDPTX_HDMI
    bool "Rockchip Samsung HDPTX HDMI PHY (rk3588)"
    depends on RT_USING_PHYE
    depends on RT_USING_CLK
    depends on RT_MFD_SYSCON
    default n

config RT_PHYE_ROCKCHIP_INNO_HDMI
    bool "Rockchip Innosilicon HDMI PHY (rk3528)"
    depends on RT_USING_PHYE
    depends on RT_USING_CLK
    depends on RT_USING_PIN
    depends on RT_MFD_SYSCON
    default n
    help
        RK3528 HDMI PHY and clk_hdmiphy_pixel_io provider.
        Supports table-based 8-bit RGB TMDS clocks up to 297 MHz.
```

## bsp/rockchip/dm/sdio/Kconfig
```kconfig
config RT_SDIO_DW_MMC_ROCKCHIP
    bool "Rockchip DesignWare MMC"
    depends on RT_SDIO_DW_MMC
    depends on RT_USING_OFW
    default n

config RT_SDIO_SDHCI_DWCMSHC_ROCKCHIP
    bool "Rockchip DWC MSHC SDHCI"
    depends on RT_SDIO_SDHCI_DWCMSHC
    depends on RT_USING_OFW
    default n
```

## bsp/rockchip/dm/soc/Kconfig
```kconfig
config RT_SOC_ROCKCHIP_FIQ_DEBUGGER
    bool "FIQ Debugger"
    depends on RT_USING_OFW
    default y

config RT_SOC_ROCKCHIP_GRF
    bool "General Register Files support"
    depends on RT_MFD_SYSCON
    default y

config RT_SOC_ROCKCHIP_HW_DECOMPRESS
    bool "HardWare Decompress (LZ4, GZIP, ZLIB)"
    default n

config RT_ROCKCHIP_JPEG_DEC
    bool "JPEG decoder"
    default n

config RT_ROCKCHIP_RGA2
    bool "RGA2 graphics accelerator"
    depends on RT_USING_OFW
    default n

config RT_SOC_ROCKCHIP_IODOMAIN
    bool "IO domain support"
    depends on RT_MFD_SYSCON
    depends on RT_USING_REGULATOR
    default y
```

## bsp/rockchip/dm/ufs/Kconfig
```kconfig
config RT_UFS_ROCKCHIP
    bool "Rockchip UFS"
    depends on RT_USING_UFS
    default n
```

## bsp/spacemit/dm/audio/Kconfig
```kconfig
config RT_AUDIO_SPACEMIT
    bool "Spacemit K1 audio"
    depends on RT_USING_AUDIO
    depends on RT_USING_OFW
    depends on RT_USING_DMA
    depends on RT_USING_CLK
    depends on RT_USING_RESET
    depends on RT_USING_PIN
    depends on RT_USING_I2C
    depends on RT_USING_RPMSG
    depends on RT_VIRTIO_RPMSG
    depends on RT_SOC_SPACEMIT_K1X_RPROC
    select RT_AUDIO_SPACEMIT_CODEC_ES8326
    default n
    help
      Enable the K1 I2S and HDMI audio paths. Both cards operate at 48 kHz,
      stereo, 16-bit PCM. The HDMI card supports playback.

config RT_AUDIO_SPACEMIT_CODEC
    bool "Spacemit codec support"
    depends on RT_AUDIO_SPACEMIT
    default y

config RT_AUDIO_SPACEMIT_CODEC_ES8326
    bool "ES8326 codec"
    depends on RT_AUDIO_SPACEMIT_CODEC
    default y
    help
      ES8326 codec supports playback and capture
```

## bsp/spacemit/dm/dvfs/cpufreq/Kconfig
```kconfig
config RT_DVFS_SPACEMIT_CPUFREQ
    bool "Spacemit K1/M1 CPUfreq driver"
    depends on RT_USING_DVFS
    depends on RT_USING_OFW
    depends on SOC_SPACEMIT_K1
    depends on RT_CLK_SPACEMIT_K1X
    depends on RT_REGULATOR_SPACEMIT_PMIC
    default y
    help
      Enable CPU DVFS for the Spacemit K1/M1 shared CPU voltage domain.
      Both CPU clusters and their TCM/ACE clocks are switched together.
```

## bsp/spacemit/dm/ethernet/Kconfig
```kconfig
config RT_ETHERNET_K1X_EMAC
    bool "Spacemit K1X Ethernet MAC"
    depends on RT_USING_OFW
    depends on RT_USING_DMA
    depends on RT_USING_PIN
    depends on RT_USING_PHY_V2
    select RT_PHY_V2_REALTEK
    default n

config RT_ETHERNET_K1X_EMAC_PTP
    bool "PTP clock support"
    depends on RT_ETHERNET_K1X_EMAC
    depends on RT_USING_PTP
    default y
```
