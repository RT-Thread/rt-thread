## bsp/imxrt/imxrt1170-nxp-evk/m7/board/Kconfig
```kconfig
menu "Hardware Drivers Config"

config BSP_USING_QSPIFLASH
    bool
    default n

config SOC_MIMXRT1176DVMAA
    bool
    select SOC_MIMXRT1170_SERIES
    select BSP_USING_QSPIFLASH
    select RT_USING_COMPONENTS_INIT
    select RT_USING_USER_MAIN
    default y

menu "On-chip Peripheral Drivers"

    config BSP_USING_DMA
        bool "Enable DMA"
        default n

    config BSP_USING_GPIO
        bool "Enable GPIO"
        select RT_USING_PIN
        default y

    config BSP_USING_RTC
        bool "Enable RTC"
        select RT_USING_RTC
        default n

    config BSP_USING_USB
        bool "Enable USB"
        select RT_USING_USB_HOST
        default n

    if BSP_USING_USB
    config BSP_USB0_HOST
        bool "Enable USB0"
        default n

    config BSP_USB1_HOST
        bool "Enable USB1"
        default n
    endif

    config BSP_USING_SDIO
        bool "Enable SDIO"
        select RT_USING_SDIO
        select RT_USING_DFS
        default n

        if BSP_USING_SDIO
            config CODE_STORED_ON_SDCARD
                bool "Enable Code STORED On SDCARD"
                default n
                help
                    "SD CARD work as boot devive"
        endif

    menuconfig BSP_USING_LPUART
        bool "Enable UART"
        select RT_USING_SERIAL
        default y

        if BSP_USING_LPUART
            config BSP_USING_LPUART1
                bool "Enable LPUART1"
                default y

        config BSP_LPUART1_RX_USING_DMA
            bool "Enable LPUART1 RX DMA"
            depends on BSP_USING_LPUART1
            select BSP_USING_DMA
            select RT_SERIAL_USING_DMA
            default n

        config BSP_LPUART1_RX_DMA_CHANNEL
        depends on BSP_LPUART1_RX_USING_DMA
        int "Set LPUART1 RX DMA channel (0-32)"
        default 0

                config BSP_LPUART1_TX_USING_DMA
                    bool "Enable LPUART1 TX DMA"
                    depends on BSP_USING_LPUART1
                    select BSP_USING_DMA
                    select RT_SERIAL_USING_DMA
                    default n

                    config BSP_LPUART1_TX_DMA_CHANNEL
                        depends on BSP_LPUART1_TX_USING_DMA
                        int "Set LPUART1 TX DMA channel (0-32)"
                        default 1

            config BSP_USING_LPUART3
                bool "Enable LPUART3"
                default n

                config BSP_LPUART3_RX_USING_DMA
                    bool "Enable LPUART3 RX DMA"
                    depends on BSP_USING_LPUART3
                    select BSP_USING_DMA
                    select RT_SERIAL_USING_DMA
                    default n

                    config BSP_LPUART3_RX_DMA_CHANNEL
                        depends on BSP_LPUART3_RX_USING_DMA
                        int "Set LPUART3 RX DMA channel (0-32)"
                        default 0

                config BSP_LPUART3_TX_USING_DMA
                    bool "Enable LPUART3 TX DMA"
                    depends on BSP_USING_LPUART3
                    select BSP_USING_DMA
                    select RT_SERIAL_USING_DMA
                    default n

                    config BSP_LPUART3_TX_DMA_CHANNEL
                        depends on BSP_LPUART3_TX_USING_DMA
                        int "Set LPUART3 TX DMA channel (0-32)"
                        default 1
        endif

        menuconfig BSP_USING_CAN
            bool "Enable CAN"
            select RT_USING_CAN
            default n
            if BSP_USING_CAN
                config BSP_USING_CAN3
                    bool "Enable FLEXCAN3"
                    default n
            endif

        menuconfig BSP_USING_FLEXSPI
            bool "Enable FLEXSPI"
            default n
            if BSP_USING_FLEXSPI
                config BSP_USING_FLEXSPI1
                    bool "Enable FLEXSPI1"
                    default n
                config BSP_USING_FLEXSPI2
                    bool "Enable FLEXSPI2"
                    default n
            endif
endmenu

menu "Onboard Peripheral Drivers"

    config BSP_USING_SDRAM
        bool "Enable SDRAM"
        default n

    menuconfig BSP_USING_ETH
    bool "Enable Ethernet"
    select RT_USING_NETDEV
    select RT_USING_LWIP
    default n


    if BSP_USING_ETH
        config BSP_USING_PHY
            select RT_USING_PHY
            bool "Enable ethernet phy"
            default y

        if BSP_USING_PHY
            config PHY_USING_KSZ8081
                bool "i.MX RT1176EVK uses ksz8081 phy"
                default y

            if PHY_USING_KSZ8081
                config PHY_KSZ8081_ADDRESS
                int "Specify address of phy device"
                default 2

                config PHY_RESET_KSZ8081_PORT
                    int "indicate port of reset"
                    default 6

                config PHY_RESET_KSZ8081_PIN
                    int "indicate pin of reset"
                    default 12

                config FSL_FEATURE_PHYKSZ8081_USE_RMII50M_MODE
                    bool "Enable the PHY ksz8081 RMII50M mode"
                    depends on PHY_USING_KSZ8081
                    default y
            endif
        endif

        if BSP_USING_PHY
                config PHY_USING_RTL8211F
                    bool "i.MX RT1176EVK uses rtl8211f phy"
                    default y

                if PHY_USING_RTL8211F
                    config PHY_RTL8211F_ADDRESS
                    int "Specify address of phy device"
                    default 1

                    config PHY_RESET_RTL8211F_PORT
                        int "indicate port of reset"
                        default 5

                    config PHY_RESET_RTL8211F_PIN
                        int "indicate pin of reset"
                        default 14

                endif
        endif
    endif

    menuconfig BSP_USING_FS
        bool "Enable File System"
        select RT_USING_DFS_DEVFS
        select RT_USING_DFS
        default n

        if BSP_USING_FS
            config BSP_USING_SDCARD_FATFS
                bool "Enable SDCARD (FATFS)"
                select BSP_USING_SDIO
                select RT_USING_DFS_ELMFAT
                default n
        endif

endmenu

menu "Board extended module Drivers"

endmenu

endmenu
```

## bsp/imxrt/libraries/Kconfig
```kconfig
config SOC_IMXRT1015_SERIES
    bool
    select ARCH_ARM_CORTEX_M7
    select ARCH_ARM_CORTEX_FPU

config SOC_IMXRT1020_SERIES
    bool
    select ARCH_ARM_CORTEX_M7
    select ARCH_ARM_CORTEX_FPU

config SOC_IMXRT1050_SERIES
    bool
    select ARCH_ARM_CORTEX_M7
    select ARCH_ARM_CORTEX_FPU

config SOC_IMXRT1060_SERIES
    bool
    select ARCH_ARM_CORTEX_M7
    select ARCH_ARM_CORTEX_FPU

config SOC_IMXRT1064_SERIES
    bool
    select ARCH_ARM_CORTEX_M7
    select ARCH_ARM_CORTEX_FPU

config SOC_IMXRT1170_SERIES
    bool
    select ARCH_ARM_CORTEX_M7
    select ARCH_ARM_CORTEX_FPU
```

## bsp/imxrt/libraries/templates/imxrt1064xxx/Kconfig
```kconfig
mainmenu "RT-Thread Configuration"

config RTT_DIR
    string
    option env="RTT_ROOT"
    default "../../.."

config PKGS_DIR
    string
    option env="PKGS_ROOT"
    default "packages"

source "$RTT_DIR/Kconfig"
source "$PKGS_DIR/Kconfig"
source "../libraries/Kconfig"
source "board/Kconfig"
```

## bsp/imxrt/product/board/Kconfig
```kconfig
menu "Hardware Drivers Config"

config BSP_USING_QSPIFLASH
    bool
    default n

config SOC_MIMXRT1176DVMAA
    bool
    select SOC_MIMXRT1170_SERIES
    select BSP_USING_QSPIFLASH
    select RT_USING_COMPONENTS_INIT
    select RT_USING_USER_MAIN
    default y

menu "On-chip Peripheral Drivers"

    config BSP_USING_DMA
        bool "Enable DMA"
        default n

    config BSP_USING_GPIO
        bool "Enable GPIO"
        select RT_USING_PIN
        default y

    menuconfig BSP_USING_LPUART
        bool "Enable UART"
        select RT_USING_SERIAL
        default y

        if BSP_USING_LPUART
            config BSP_USING_LPUART1
                bool "Enable LPUART1"
                default y

                config BSP_LPUART1_RX_USING_DMA
                    bool "Enable LPUART1 RX DMA"
                    depends on BSP_USING_LPUART1
                    select BSP_USING_DMA
                    select RT_SERIAL_USING_DMA
                    default n

                    config BSP_LPUART1_RX_DMA_CHANNEL
                        depends on BSP_LPUART1_RX_USING_DMA
                        int "Set LPUART1 RX DMA channel (0-32)"
                        default 0

                config BSP_LPUART1_TX_USING_DMA
                    bool "Enable LPUART1 TX DMA"
                    depends on BSP_USING_LPUART1
                    select BSP_USING_DMA
                    select RT_SERIAL_USING_DMA
                    default n

                    config BSP_LPUART1_TX_DMA_CHANNEL
                        depends on BSP_LPUART1_TX_USING_DMA
                        int "Set LPUART1 TX DMA channel (0-32)"
                        default 1

            config BSP_USING_LPUART3
                bool "Enable LPUART3"
                default n

                config BSP_LPUART3_RX_USING_DMA
                    bool "Enable LPUART3 RX DMA"
                    depends on BSP_USING_LPUART3
                    select BSP_USING_DMA
                    select RT_SERIAL_USING_DMA
                    default n

                    config BSP_LPUART3_RX_DMA_CHANNEL
                        depends on BSP_LPUART3_RX_USING_DMA
                        int "Set LPUART3 RX DMA channel (0-32)"
                        default 0

                config BSP_LPUART3_TX_USING_DMA
                    bool "Enable LPUART3 TX DMA"
                    depends on BSP_USING_LPUART3
                    select BSP_USING_DMA
                    select RT_SERIAL_USING_DMA
                    default n

                    config BSP_LPUART3_TX_DMA_CHANNEL
                        depends on BSP_LPUART3_TX_USING_DMA
                        int "Set LPUART3 TX DMA channel (0-32)"
                        default 1
						
			config BSP_USING_LPUART10
                bool "Enable LPUART10"
                default n

                config BSP_LPUART10_RX_USING_DMA
                    bool "Enable LPUART10 RX DMA"
                    depends on BSP_USING_LPUART10                    
                    select RT_SERIAL_USING_DMA
                    default n

                    config BSP_LPUART10_RX_DMA_CHANNEL
                        depends on BSP_LPUART10_RX_USING_DMA
                        int "Set LPUART3 RX DMA channel (0-32)"
                        default 8

                config BSP_LPUART10_TX_USING_DMA
                    bool "Enable LPUART10 TX DMA"
                    depends on BSP_USING_LPUART10
                    select BSP_USING_DMA
                    select RT_SERIAL_USING_DMA
                    default n

                    config BSP_LPUART10_TX_DMA_CHANNEL
                        depends on BSP_LPUART10_TX_USING_DMA
                        int "Set LPUART10 TX DMA channel (0-32)"
                        default 9
        endif
	menuconfig BSP_USING_FLEXSPI
		bool "Enable FlexSPI"
		default y

		if BSP_USING_FLEXSPI
			config BSP_USING_FLEXSPI1
				bool "Enable FlexSPI1"
				default y
		endif
	menuconfig BSP_USING_SPI
		bool "Enable SPI"	
		default y

		if BSP_USING_SPI
			config BSP_USING_SPI1
				bool "Enable SPI1"
				default y

			config BSP_USING_SPI4
				bool "Enable SPI4"
				default n
			
			config BSP_USING_BLOCKING_SPI
				bool "Enable BLOCKING SPI"
				default y
		endif
	
endmenu

menu "Onboard Peripheral Drivers"

    config BSP_USING_SDRAM
        bool "Enable SDRAM"
        default n

    menuconfig BSP_USING_ETH
    bool "Enable Ethernet"
    select RT_USING_NETDEV
    select RT_USING_LWIP
    default n


    if BSP_USING_ETH
        config BSP_USING_PHY
            select RT_USING_PHY
            bool "Enable ethernet phy"
            default y

        if BSP_USING_PHY
			choice BSP_USING_PHY_TYPE
				prompt "Select PHY type"
				default PHY_USING_RTL8201F
				help
					Select the PHY type.
				config PHY_USING_RTL8201F
					bool "RTL8201F"
					help
						Select RTL8201F PHY.
				config PHY_USING_RTL8304
					bool "RTL8304"
					help
						Select RTL8304 PHY.
		    endchoice
			
			if PHY_USING_RTL8304
				config RTL8304_MDCS_PORT
					int "Set RTL8304 MDCS PORT"
					default 3
				config RTL8304_MDCS_PIN
					int "Set RTL8304 MDC PIN"
					default 31
				config RTL8304_MDIO_PORT
					int "Set RTL8304 MDIO PORT"
					default 4
				config RTL8304_MDIO_PIN
					int "Set RTL8304 MDIO PIN"
					default 0
					
				config PHY_ADDRESS
					int "Set PHY address"
					default 1

				config PHY_NAME
					string "Set PHY name"
					default "realtek"
					
				menuconfig BSP_USING_PHY_LED
					bool "Enable PHY LED"
					default n

					if BSP_USING_PHY_LED
						menuconfig BSP_USING_PHY_LED_PORT1
							bool "Enable PHY LED PORT1"
							default n

							if BSP_USING_PHY_LED_PORT1
								config BSP_USING_PHY_LED_PORT1_PORT
									int "Set PHY LED PORT1 PORT"
									default 6
								config BSP_USING_PHY_LED_PORT1_PIN
									int "Set PHY LED PORT1 PIN"
									default 8
							endif

						menuconfig BSP_USING_PHY_LED_PORT2
							bool "Enable PHY LED PORT2"
							default n

							if BSP_USING_PHY_LED_PORT2
								config BSP_USING_PHY_LED_PORT2_PORT
									int "Set PHY LED PORT2 PORT"
									default 6
								config BSP_USING_PHY_LED_PORT2_PIN
									int "Set PHY LED PORT2 PIN"
									default 9
							endif
					endif
						
				menuconfig BSP_USING_PHY_RST
					bool "Enable PHY RST"
					default n

					if BSP_USING_PHY_RST
						config BSP_USING_PHY_RST_PORT
							int "Set PHY RST PORT"
							default 3
						config BSP_USING_PHY_RST_PIN
							int "Set PHY RST PIN"
							default 12
					endif
			endif	
			
			menuconfig BSP_USING_ETH_INT
				bool "Enable ETH INT"
				default n

				if BSP_USING_ETH_INT
					config BSP_USING_ETH_INT_PORT
						int "Set ETH INT PORT"
						default 3
					config BSP_USING_ETH_INT_PIN
						int "Set ETH INT PIN"
						default 11
				endif

			config BSP_USING_ENET
				bool "Enable ENET"
				default n
            
        endif

        
    endif
	
	menuconfig BSP_USING_SPI_FLASH
        bool "Enable SPI FLASH Support"
        default y        
        if BSP_USING_SPI_FLASH
            config BSP_SPI_FLASH_SPI_BUS
                string "SPI Bus Used By SPI FLASH"
                default "spi1"
            config BSP_SPI_FLASH_BUS_NAME
                string "Set FLASH SPI Bus Name"
                default "spiflash"
            config BSP_SPI_FLASH_DEV_NAME
                string "Set SPI Flash Device Name"
                default "w25q16"            
        endif
	config BSP_USING_ESP32
        bool "Enable ESP32"
		default y
        select RT_USING_AT
        select AT_USING_CLIENT
        select AT_USING_SOCKET
        select PKG_USING_AT_DEVICE
        select AT_DEVICE_USING_ESP32
		select AT_DEVICE_ESP32_INIT_ASYN
       
endmenu

menu "Board extended module Drivers"

endmenu

endmenu
```
