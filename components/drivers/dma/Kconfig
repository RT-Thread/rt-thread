## components/drivers/dma/Kconfig
```kconfig
menuconfig RT_USING_DMA
    bool "Using Direct Memory Access (DMA)"
    depends on RT_USING_DM
    select RT_USING_ADT
    select RT_USING_ADT_BITMAP
    default n

config RT_DMA_PL330
    bool "ARM PL330"
    depends on RT_USING_DMA
    depends on RT_USING_CLK
    depends on RT_USING_RESET
    default n

config RT_DMA_DW_AXI_DMAC
    bool "Synopsys DesignWare AXI DMA"
    depends on RT_USING_DMA
    depends on RT_USING_CLK
    default n

if RT_USING_DMA
    osource "$(SOC_DM_DMA_DIR)/Kconfig"
endif
```

## components/drivers/ethernet/Kconfig
```kconfig
menuconfig RT_USING_ETHERNET
    bool "Using Ethernet device drivers"
    depends on RT_USING_DM
    depends on RT_USING_SAL
    depends on RT_USING_NETDEV
    depends on RT_USING_LWIP
    default n

if RT_USING_ETHERNET
    rsource "cadence/Kconfig"
    rsource "synopsys/Kconfig"
    osource "$(SOC_DM_ETHERNET_DIR)/Kconfig"
endif
```

## components/drivers/ethernet/cadence/Kconfig
```kconfig
config RT_ETHERNET_CADENCE
    bool "Cadence GEM/MACB Ethernet"
    depends on RT_USING_PHY_V2
    depends on RT_USING_DMA
    depends on RT_USING_PIN

config RT_ETHERNET_CADENCE_PCI
    bool "PCI supported"
    depends on RT_ETHERNET_CADENCE
    depends on RT_USING_PCI

config RT_ETHERNET_CADENCE_PTP
    bool "PTP supported"
    depends on RT_ETHERNET_CADENCE
    depends on RT_USING_PTP
```

## components/drivers/ethernet/realtek/Kconfig
```kconfig
config RT_ETHERNET_REALTEK
    bool "Realtek RTL8125 Ethernet"
    depends on RT_USING_PCI
    depends on !RT_LWIP_USING_HW_CHECKSUM
    default n
    help
        Enable the RT-Thread native PCI driver for Realtek RTL8125/RTL8162
        Ethernet controllers. The driver implements one TX/RX queue, interrupt
        driven receive, descriptor-ring DMA, link change reporting, and
        10/100/1000/2500M auto-negotiation.
        Requires lwIP software checksums; disable the global hardware checksum
        option before enabling this driver.

config RT_REALTEK_PTP
    bool "PTP supported"
    depends on RT_ETHERNET_REALTEK
    depends on RT_USING_PTP
    default n
    help
        Register the RTL8125 hardware PTP clock with the RT-Thread PTP
        framework. Supported operations include gettime, settime, adjtime,
        adjfreq, and PPS where the selected hardware PTP block supports it.
```

## components/drivers/ethernet/synopsys/Kconfig
```kconfig
config RT_ETHERNET_DWMAC
    bool "Synopsys DesignWare Ethernet MAC (GMAC4)"
    depends on RT_USING_PHY_V2
    depends on RT_USING_DMA
    depends on RT_USING_PIN
    default n

config RT_ETHERNET_DWMAC_PTP
    bool "PTP supported"
    depends on RT_ETHERNET_DWMAC
    depends on RT_USING_PTP
```

## components/drivers/graphic/framebuffer/Kconfig
```kconfig
menuconfig RT_GRAPHIC_FB
    bool "LCD and Frame buffer support"
    select RT_USING_LCD
    default y

config RT_GRAPHIC_FB_ILI9486
    bool "ILI9486 framebuffer support"
    depends on RT_GRAPHIC_FB
    depends on RT_USING_SPI
    default n

config RT_GRAPHIC_FB_ST77916
    bool "ST77916 QSPI framebuffer support"
    depends on RT_GRAPHIC_FB
    depends on RT_USING_OFW
    depends on RT_USING_QSPI
    depends on RT_USING_PIN
    depends on RT_USING_HEAP
    select RT_USING_SEMAPHORE
    default n
    help
      Enable the ST77916 framebuffer driver. The panel uses a single-line
      command phase and a four-line QSPI RGB666 pixel phase.

config RT_GRAPHIC_FB_SIMPLE
    bool "Simple framebuffer support"
    depends on RT_GRAPHIC_FB
    depends on RT_USING_OFW
    default y

if RT_GRAPHIC_FB
    osource "$(SOC_DM_GRAPHIC_FB_DIR)/Kconfig"
endif
```

## components/drivers/input/joystick/Kconfig
```kconfig
menuconfig RT_INPUT_JOYSTICK
    bool "Joystick"
    default n

config RT_INPUT_JOYSTICK_ADC
    bool "Simple joystick connected over ADC"
    depends on RT_INPUT_JOYSTICK
    depends on RT_USING_ADC
    depends on RT_USING_OFW
    default n

if RT_INPUT_JOYSTICK
    osource "$(SOC_DM_INPUT_JOYSTICK_DIR)/Kconfig"
endif
```

## components/drivers/input/keyboard/Kconfig
```kconfig
menuconfig RT_INPUT_KEYBOARD
    bool "Keyboards"
    default n

config RT_INPUT_KEYBOARD_ADC
    bool "ADC Ladder Buttons"
    depends on RT_INPUT_KEYBOARD
    depends on RT_USING_OFW
    depends on RT_USING_ADC
    default n

config RT_INPUT_KEYBOARD_GPIO
    bool "GPIO"
    depends on RT_INPUT_KEYBOARD
    depends on RT_USING_OFW
    default n

if RT_INPUT_KEYBOARD
    osource "$(SOC_DM_INPUT_KEYBOARD_DIR)/Kconfig"
endif
```

## components/drivers/input/touchscreen/Kconfig
```kconfig
menuconfig RT_INPUT_TOUCHSCREEN
    bool "Touchscreens"
    select RT_USING_TOUCH
    default n

config RT_INPUT_TOUCHSCREEN_ADS7846
    bool "TI ADS7843/45/46/73 XPT/TSC2046 touch screen support"
    depends on RT_INPUT_TOUCHSCREEN
    depends on RT_USING_SPI
    depends on RT_USING_OFW
    depends on RT_USING_PIN
    depends on RT_USING_REGULATOR
    default n

config RT_INPUT_TOUCHSCREEN_GOODIX
    bool "Goodix GT9xx capacitive touch screen support"
    depends on RT_INPUT_TOUCHSCREEN
    depends on RT_USING_I2C
    depends on RT_USING_OFW
    depends on RT_USING_PIN
    depends on RT_USING_REGULATOR
    default n

if RT_INPUT_TOUCHSCREEN
    osource "$(SOC_DM_INPUT_TOUCHSCREEN_DIR)/Kconfig"
endif
```

## components/drivers/ivshmem/Kconfig
```kconfig
menuconfig RT_USING_IVSHMEM
    bool "Using Inter-VM shared memory device drivers"
    depends on RT_USING_DM
    depends on RT_USING_PCI
    default n

config RT_IVSHMEM_QEMU
    bool "QEMU"
    depends on RT_USING_IVSHMEM
    default n

config RT_IVSHMEM_JAILHOUSE
    bool "JailHouse shared memory in PCI config space"
    depends on RT_USING_IVSHMEM
    default n
    help
        Take the shared memory address and size from the device's
        vendor-specific PCI config space (0x40..0x4f) when BAR2 is not
        available. These fields are controlled by the device and are not
        validated by the PCI core, so enable this only when running as a
        JailHouse guest whose hypervisor and PCI devices are trusted.
        Without this option, a device must provide the shared memory as BAR2.
```

## components/drivers/misc/Kconfig
```kconfig
config RT_USING_DAC
    bool "Using DAC device drivers"
    default n

config RT_USING_NULL
    bool "Using NULL device drivers"
    default n

config RT_USING_ZERO
    bool "Using ZERO device drivers"
    default n

config RT_USING_RANDOM
    bool "Using RANDOM device drivers"
    default n
    help
        Enable the /dev/random and /dev/urandom devices.

        These devices are a non-cryptographic software PRNG. Do not use
        them for cryptographic keys, nonces or other security-sensitive
        values.

menuconfig RT_USING_PWM
    bool "Using PWM device drivers"
    default n

if RT_USING_DM && RT_USING_PWM
    osource "$(SOC_DM_PWM_DIR)/Kconfig"
endif

config RT_USING_PULSE_ENCODER
    bool "Using PULSE ENCODER device drivers"
    default n

config RT_USING_INPUT_CAPTURE
    bool "Using INPUT CAPTURE device drivers"
    default n

if RT_USING_INPUT_CAPTURE
    config RT_INPUT_CAPTURE_RB_SIZE
        int "Set input capture ringbuffer size"
        default 100
endif
```

## components/drivers/misc/utest/Kconfig
```kconfig
menu "PWM Test"

config RT_UTEST_PWM
    bool "PWM Frequency and Duty-cycle Matrix Test"
    default n
    select RT_USING_PWM
    help
        Run configurable PWM groups. Channels in one group run concurrently,
        while groups run in order. Each channel can keep a fixed output, sweep
        once and hold its last point, or repeat its sweep for the group duration.

if RT_UTEST_PWM

config RT_PWM_TC_CONFIG_FILE
    string "PWM test configuration header"
    default "pwm_tc_config.h"
    help
        The header defines PWM_TC_GROUPS and PWM_TC_GROUP_COUNT. Keep the
        default for the built-in example, or provide a board-specific header
        from a compiler include path. Channel enable switches, device names,
        channel numbers, output modes, and waveform points are kept in that
        header because Kconfig cannot represent dynamic group/channel arrays.

config RT_PWM_TC_MAX_CHANNELS
    int "Maximum concurrent channels in one PWM test group"
    range 1 64
    default 8
    help
        This limits enabled channels, not the total number of configured and
        disabled channel entries in a group.

config RT_PWM_TC_TIMEOUT
    int "PWM test timeout in seconds"
    range 1 3600
    default 30

endif

endmenu
```

## components/drivers/phy/Kconfig
```kconfig
menuconfig RT_USING_PHY
    bool "Using ethernet phy device drivers"
    default n

menuconfig RT_USING_PHY_V2
    bool "Using phy device and mii bus v2"
    depends on !RT_USING_PHY
    default n

if RT_USING_DM && RT_USING_PHY_V2
    config RT_PHY_V2_REALTEK
        bool "Realtek"

    osource "$(SOC_DM_PHY_DIR)/Kconfig"
endif
```

## components/drivers/rtc/utest/Kconfig
```kconfig
menu "RTC Test"
    depends on RT_USING_RTC

config RT_UTEST_RTC
    bool "RTC Time Test"
    default n
    help
        Validate RTC timestamp set/get and time advancement. The test changes
        the RTC time and restores it after completion.

config RT_UTEST_RTC_ALARM
    bool "RTC Alarm Test"
    depends on RT_USING_ALARM
    depends on RT_USING_HEAP
    default n
    help
        Validate one-shot alarm delivery using the current RTC time. The test
        reapplies the current time to start the RTC counter and changes the
        alarm, so no application may use them while the test runs.

if RT_UTEST_RTC_ALARM

    config RT_RTC_TC_ALARM_DELAY_SEC
        int "Alarm Delay in Seconds"
        range 3 120
        default 15
        help
            Delay between reading the current RTC time and the one-shot alarm.

    config RT_RTC_TC_ALARM_TIMEOUT_SEC
        int "Alarm Timeout in Seconds"
        range 4 180
        default 25
        help
            Maximum time to wait for the alarm callback. Keep this greater
            than the configured alarm delay.

endif

endmenu
```

## components/drivers/sdio/utest/Kconfig
```kconfig
menu "SDIO Test"

config RT_UTEST_SDIO
    bool "SDIO Block Read and Write Test"
    default n
    depends on RT_USING_SDIO
    help
        Verify SDIO block-device read and write paths with a real SD card.
        The test writes directly to the configured sectors and does not use
        DFS or format the card.

if RT_UTEST_SDIO

config RT_SDIO_UTEST_DEVICE_NAME
    string "SDIO block device name"
    default "sd0"
    help
        Block device used by the test, for example sd0 or sd0p0.

config RT_SDIO_UTEST_START_SECTOR
    hex "SDIO test start sector"
    default 0x0
    help
        First sector used by the test. Existing data in the selected sectors
        will be overwritten.

config RT_SDIO_UTEST_SECTOR_COUNT
    int "SDIO test sector count"
    range 1 128
    default 8
    help
        Number of contiguous sectors used by each transfer.

config RT_SDIO_UTEST_LOOP_COUNT
    int "SDIO test loop count"
    range 1 100
    default 3
    help
        Number of write/read verification loops at each test location.

config RT_SDIO_UTEST_DEVICE_WAIT_MS
    int "SDIO device wait time"
    range 0 60000
    default 3000
    help
        Time to wait for the SDIO block device to appear before failing.

endif

endmenu
```

## components/drivers/touch/utest/Kconfig
```kconfig
menu "Touch Test"

config RT_UTEST_TOUCH
    bool "Touch framework Test"
    default n
    depends on RT_USING_TOUCH && !RT_TOUCH_PIN_IRQ
    help
        Run the touch framework test with a simulated device. No touch
        hardware is required.

endmenu
```

## components/drivers/usb/Kconfig
```kconfig
rsource "cherryusb/Kconfig"

if RT_USING_CHERRYUSB
    osource "$(SOC_DM_USB_DIR)/Kconfig"
endif
```

## components/drivers/watchdog/utest/Kconfig
```kconfig
menu "Watchdog Test"
    depends on RT_USING_WDT

config RT_UTEST_WDT
    bool "Watchdog Smoke Test"
    default n
    help
        Validate watchdog device find/open and timeout set/get. Optional
        start/keepalive/stop is off by default to avoid board reset when the
        hardware cannot stop the WDT.

if RT_UTEST_WDT

    config RT_UTEST_WDT_DEVICE_NAME
        string "Watchdog Device Name"
        default "wdt"
        help
            Device name registered by the BSP, usually "wdt".

    config RT_UTEST_WDT_TIMEOUT_SEC
        int "Timeout Used by Smoke Test (Seconds)"
        range 1 60
        default 5
        help
            Timeout value written by SET_TIMEOUT and checked by GET_TIMEOUT.
            The value read back may differ by up to
            RT_UTEST_WDT_TIMEOUT_TOL seconds because watchdog timeouts are
            derived from a divided low-speed clock (e.g. STM32 LSI 32kHz).

    config RT_UTEST_WDT_TIMEOUT_TOL
        int "Accepted Readback Tolerance (Seconds)"
        range 0 5
        default 1
        help
            Absolute tolerance between the programmed timeout and the value
            read back through GET_TIMEOUT. 0 requires an exact round-trip.

    config RT_UTEST_WDT_STOPPABLE
        bool "Watchdog Can Be Stopped (RT_DEVICE_CTRL_WDT_STOP)"
        default n
        help
            Some watchdog blocks (e.g. STM32 IWDG) cannot be stopped at all.
            rt_device_close() on a watchdog issues RT_DEVICE_CTRL_WDT_STOP and
            fails with -RT_ERROR when the driver has no STOP support, which
            would also leave the device reference count incremented and break
            a second run of this suite.

            With this option disabled (default) the test never closes the
            device: it is a hardware-global singleton, so the handle is only
            released by the test case and a re-run reuses the already opened
            device. Enable it on BSPs whose watchdog really supports STOP to
            exercise the close path.

    config RT_UTEST_WDT_START
        bool "Also Start/Keepalive/Stop Watchdog"
        default n
        help
            When enabled, the test starts the WDT with the configured timeout,
            feeds it once, then stops it. Keep this off unless the BSP WDT can
            be stopped safely; otherwise the board may reset if STOP fails.

endif

endmenu
```

## components/libc/Kconfig
```kconfig
menu "C/C++ and POSIX layer"

config RT_USING_LIBC
    bool "Enable libc"
    default y if RT_USING_SMART
    default n

config RT_USING_MUSLLIBC
    bool "Enable musl libc"
    depends on RT_USING_SMART
    depends on RT_USING_LIBC
    default y if RT_USING_SMART
    default n

config RT_USING_EXTERNAL_LIBC
    bool
    help
        This is for external libc(e.g. mlib),
        and NOT for newlib or picolibc which are inherent in the toolchains.
        Usually, the external libc should be a software package and select
        RT_USING_EXTERNAL_LIBC in software package's Kconfig
        This option is not available for users to select.

rsource "compilers/common/Kconfig"
rsource "posix/Kconfig"
rsource "cplusplus/Kconfig"

endmenu
```

## components/libc/compilers/common/utest/Kconfig
```kconfig
menu "C Library Test"

config RT_UTEST_LIBC_TIME
    bool "Time Conversion Test"
    default n
    depends on RT_USING_POSIX_CLOCK

endmenu
```
