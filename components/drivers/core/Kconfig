## components/drivers/core/Kconfig
```kconfig
config RT_USING_DM
    bool "Enable device driver model with device tree"
    default n
    help
        Enable device driver model with device tree (FDT). It will use more memory
        to parse and support device tree feature.

config RT_USING_DEV_BUS
    bool "Using Device Bus device drivers"
    default y if RT_USING_SMART
    default n
```

## components/drivers/cputime/Kconfig
```kconfig
config RT_USING_CPUTIME
    bool "Enable CPU time for high resolution clock counter"
    default n
    help
        When enable this option, the BSP should provide a rt_clock_cputime_ops
        for CPU time by:
        const static struct rt_clock_cputime_ops _ops = {...};
        clock_cpu_setops(&_ops);

        Then user can use high resolution clock counter with:

        ts1 = clock_cpu_gettime();
        ts2 = clock_cpu_gettime();

        /* and get the ms of delta tick with API: */
        ms_tick = clock_cpu_millisecond(t2 - t1);
        us_tick = clock_cpu_microsecond(t2 - t1);

if RT_USING_CPUTIME
    config RT_USING_CPUTIME_CORTEXM
        bool "Support Cortex-M CPU"
        default y
        depends on ARCH_ARM_CORTEX_M0 || ARCH_ARM_CORTEX_M3 || ARCH_ARM_CORTEX_M4 || ARCH_ARM_CORTEX_M7
        select PKG_USING_PERF_COUNTER
    config RT_USING_CPUTIME_RISCV
        bool "Use rdtime instructions for CPU time"
        default y
        depends on ARCH_RISCV64
        help
            Some RISCV64 MCU Use rdtime instructions read CPU time.
    config CPUTIME_TIMER_FREQ
        int "CPUTIME timer freq"
        default 0
endif
```

## components/drivers/dvfs/Kconfig
```kconfig
menuconfig RT_USING_DVFS
    bool "Using Dynamic Voltage and Frequency Scaling (DVFS)"
    depends on RT_USING_DM
    depends on RT_USING_CLK
    depends on RT_USING_REGULATOR
    select RT_USING_ADT
    select RT_USING_ADT_REF
    select RT_USING_ADT_BITMAP
    select RT_USING_DEVICE_IPC
    select RT_USING_SYSTEM_WORKQUEUE
    default n

config RT_USING_DVFS_EVENT
    bool "Event"
    depends on RT_USING_DVFS
    default y

config RT_USING_DVFS_OPP_RETRY_MAX
    int "OPP retry max time"
    depends on RT_USING_DVFS
    default 10

if RT_USING_DVFS && RT_USING_DVFS_EVENT
    comment "DVFS Event Drivers"
endif

if RT_USING_DVFS
    osource "$(SOC_DM_DVFS_EVENT_DIR)/Kconfig"
endif

if RT_USING_DVFS
    comment "DVFS CPUfreq Drivers"
endif

config RT_DVFS_SCMI_CPUFREQ
    bool "SCMI CPUfreq driver"
    depends on RT_USING_DVFS
    depends on RT_FIRMWARE_ARM_SCMI
    default n

if RT_USING_DVFS
    osource "$(SOC_DM_DVFS_CPUFREQ_DIR)/Kconfig"
endif

if RT_USING_DVFS
    comment "DVFS Devfreq Drivers"
endif

if RT_USING_DVFS
    osource "$(SOC_DM_DVFS_DEVFREQ_DIR)/Kconfig"
endif
```

## components/drivers/firmware/Kconfig
```kconfig
menuconfig RT_USING_FIRMWARE
    bool "Using Firmware"
    depends on RT_USING_DM
    default n

config RT_FIRMWARE_QEMU_FW_CFG
    bool "QEMU Firmware Configuration"
    depends on RT_USING_FIRMWARE
    default n

if RT_USING_FIRMWARE
    rsource "arm_scmi/Kconfig"
    osource "$(SOC_DM_FIRMWARE_DIR)/Kconfig"
endif
```

## components/drivers/firmware/arm_scmi/Kconfig
```kconfig
menuconfig RT_FIRMWARE_ARM_SCMI
    bool "ARM System Control and Management Interface Protocol (SCMI)"
    depends on RT_USING_FIRMWARE
    depends on ARCH_ARM_CORTEX_A || ARCH_ARMV8
    depends on RT_USING_OFW
    default n

config RT_FIRMWARE_ARM_SCMI_TRANSPORT_MAILBOX
    bool "SCMI transport based on mailbox"
    depends on RT_FIRMWARE_ARM_SCMI
    depends on RT_USING_MBOX
    default y

config RT_FIRMWARE_ARM_SCMI_TRANSPORT_SMC
    bool "SCMI transport based on SMC"
    depends on RT_FIRMWARE_ARM_SCMI
    default y

if RT_VIRTIO_SCMI
    config RT_FIRMWARE_ARM_SCMI_TRANSPORT_VIRTIO
        bool
        default y
endif
```

## components/drivers/graphic/Kconfig
```kconfig
config RT_USING_LCD
    bool "Using LCD graphic drivers" if !RT_USING_DM
    default n

menuconfig RT_USING_GRAPHIC
    bool "Using Graphics device drivers"
    depends on RT_USING_DM
    default n

if RT_USING_GRAPHIC
    rsource "backlight/Kconfig"
    rsource "framebuffer/Kconfig"
    rsource "logo/Kconfig"
endif
```

## components/drivers/graphic/backlight/Kconfig
```kconfig
menuconfig RT_GRAPHIC_BACKLIGHT
    bool "Backlight support"
    default n

config RT_GRAPHIC_BACKLIGHT_GPIO
    bool "Generic GPIO based backlight driver"
    depends on RT_GRAPHIC_BACKLIGHT
    depends on RT_USING_PIN
    default n

config RT_GRAPHIC_BACKLIGHT_PWM
    bool "Generic PWM based backlight driver"
    depends on RT_GRAPHIC_BACKLIGHT
    depends on RT_USING_OFW
    depends on RT_USING_PIN
    depends on RT_USING_PWM
    depends on RT_USING_REGULATOR
    default n

if RT_GRAPHIC_BACKLIGHT
    osource "$(SOC_DM_GRAPHIC_BACKLIGHT_DIR)/Kconfig"
endif
```

## components/drivers/graphic/logo/Kconfig
```kconfig
menuconfig RT_GRAPHIC_LOGO
    bool "Startup Logo"
    select RT_GRAPHIC_FB
    default y

choice
    prompt "Rendering image(ppm)"
    default RT_GRAPHIC_LOGO_RT_THREAD_CLUT224
    depends on RT_GRAPHIC_LOGO

    config RT_GRAPHIC_LOGO_NONE
        bool "None logo (Change in runtime)"

    config RT_GRAPHIC_LOGO_RT_THREAD_CLUT224
        bool "Standard 224-color RT-Thread logo"

    config RT_GRAPHIC_LOGO_RT_THREAD_WHITE_CLUT224
        bool "Standard 224-color RT-Thread white logo"

    osource "$(SOC_DM_GRAPHIC_LOGO_DIR)/Kconfig"
endchoice

# Provide the logos path for the BSP path:
#
# RT_GRAPHIC_LOGO_<XYZ> in Kconfig:
#
#   config RT_GRAPHIC_LOGO_<XYZ>
#       bool "<XYZ> logo"
#
# RT_GRAPHIC_LOGO_<XYZ>_PATH in Kconfig.path:
#
#   if RT_GRAPHIC_LOGO_<XYZ>
#       config RT_GRAPHIC_LOGO_<XYZ>_PATH
#           string
#           default "dm/graphic/logo/[filename].ppm"
#   endif
osource "$(SOC_DM_GRAPHIC_LOGO_DIR)/Kconfig.path"
```

## components/drivers/hwcache/Kconfig
```kconfig
menuconfig RT_USING_HWCACHE
    bool "Using Hardware Cache device drivers"
    depends on RT_USING_DM
    depends on RT_USING_CACHE
    default n

if RT_USING_HWCACHE
    osource "$(SOC_DM_HWCACHE_DIR)/Kconfig"
endif
```
