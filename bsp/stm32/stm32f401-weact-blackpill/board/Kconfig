## bsp/stm32/stm32f429-fire-challenger/board/Kconfig
```kconfig
menu "Hardware Drivers Config"

config SOC_STM32F429IG
    bool
    select SOC_SERIES_STM32F4
    default y

menu "Onboard Peripheral Drivers"

    config BSP_USING_USB_TO_USART
        bool "Enable USB TO USART (uart1)"
        select BSP_USING_UART1
        default y

    config BSP_USING_RS232
        bool "Enable RS232 (uart2 pin conflict with Ethernet)"
        select BSP_USING_UART2
        default n
        
    config BSP_USING_SDRAM
        bool "Enable SDRAM"
        default n
        
    config BSP_USING_SPI_FLASH
        bool "Enable SPI FLASH (W25Q128 spi5)"
        select BSP_USING_SPI5
        select RT_USING_SFUD
        select RT_SFUD_USING_SFDP
        default n
        
    config BSP_USING_MPU6050
        bool "Enable MPU6050 (i2c1)"
        select BSP_USING_I2C1
        select PKG_USING_MPU6XXX
        default n

    config BSP_USING_ETH
        bool "Enable Ethernet"
        default n
        select RT_USING_LWIP
        if BSP_USING_ETH
            config EXTERNAL_PHY_ADDRESS
                hex
                default 0x00
        endif

    config BSP_USING_RGB
        bool "Enable RGB LED (timer5 channel1 - 3)"
        select RT_USING_PWM
        select BSP_USING_PWM
        select BSP_USING_PWM5
        select BSP_USING_PWM5_CH1
        select BSP_USING_PWM5_CH2
        select BSP_USING_PWM5_CH3
        default n    

    config BSP_USING_POT
        bool "Enable potentiometer"
        select BSP_USING_ADC
        select BSP_USING_ADC1
        default n

    config BSP_USING_SDCARD
        bool "Enable SDCARD (sdio)"
        select BSP_USING_SDIO
        select RT_USING_DFS
        select RT_USING_DFS_ELMFAT
        select RT_USING_PIN
        default n

endmenu

menu "On-chip Peripheral Drivers"

    config BSP_USING_GPIO
        bool "Enable GPIO"
        select RT_USING_PIN
        default y

    config BSP_USING_UART1
        bool "Enable UART1"
        select RT_USING_SERIAL
        default y

    config BSP_USING_UART2
        bool "Enable UART2"
        select RT_USING_SERIAL
        default n

    config BSP_USING_UART3
        bool "Enable UART3"
        select RT_USING_SERIAL
        default n

    config BSP_USING_ON_CHIP_FLASH
        bool "Enable on-chip FLASH"
        default n
        
    config BSP_USING_SPI1
        bool "Enable SPI1 BUS"
        select RT_USING_SPI
        default n

    config BSP_USING_SPI2
        bool "Enable SPI2 BUS"
        select RT_USING_SPI
        default n

    config BSP_USING_SPI5
        bool "Enable SPI5 BUS"
        select RT_USING_SPI
        default n

    config BSP_SPI_USING_DMA
        bool "Enable SPI DMA support"
        default n

    menuconfig BSP_USING_TIM
        bool "Enable timer"
        default n
        select RT_USING_HWTIMER
        if BSP_USING_TIM
            config BSP_USING_TIM11
                bool "Enable TIM11"
                default n

            config BSP_USING_TIM13
                bool "Enable TIM13"
                default n

            config BSP_USING_TIM14
                bool "Enable TIM14"
                default n
        endif

    menuconfig BSP_USING_PWM
        bool "Enable pwm"
        default n
        select RT_USING_PWM
        if BSP_USING_PWM
        menuconfig BSP_USING_PWM5
            bool "Enable timer5 output pwm"
            default n
            if BSP_USING_PWM5
                config BSP_USING_PWM5_CH1
                    bool "Enable PWM5 channel1"
                    default n

                config BSP_USING_PWM5_CH2
                    bool "Enable PWM5 channel2"
                    default n

                config BSP_USING_PWM5_CH3
                    bool "Enable PWM5 channel3"
                    default n
            endif
        endif

    menuconfig BSP_USING_ADC
        bool "Enable ADC"
        default n
        select RT_USING_ADC
        if BSP_USING_ADC
            config BSP_USING_ADC1
                bool "Enable ADC1"
                default n

            config BSP_USING_ADC2
                bool "Enable ADC2"
                default n

            config BSP_USING_ADC3
                bool "Enable ADC3"
                default n
        endif

    menuconfig BSP_USING_I2C1
        bool "Enable I2C1 BUS (software simulation)"
        default n
        select RT_USING_I2C
        select RT_USING_I2C_BITOPS
        select RT_USING_PIN
        if BSP_USING_I2C1
            comment "Notice: PB6 --> 22; PB7 --> 23" 
            config BSP_I2C1_SCL_PIN
                int "I2C1 scl pin number"
                range 1 176
                default 22
            config BSP_I2C1_SDA_PIN
                int "I2C1 sda pin number"
                range 1 176
                default 23
        endif

    config BSP_USING_ONCHIP_RTC
        bool "Enable RTC"
        select RT_USING_RTC
        select RT_USING_LIBC
        default n

    config BSP_USING_WDT
        bool "Enable Watchdog Timer"
        select RT_USING_WDT
        default n

    config BSP_USING_SDIO
        bool "Enable SDIO"
        select RT_USING_SDIO
        select RT_USING_DFS
        default n

endmenu

menu "Board extended module Drivers"

endmenu

endmenu
```
