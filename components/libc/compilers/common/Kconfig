## components/net/netdev/Kconfig
```kconfig
menuconfig RT_USING_NETDEV
    bool "Enable network interface device"
    default n
    help
        RT_USING_NETDEV is used in the RT-Thread operating system to enable the Network Device Driver Framework.

        Features:
        Compiles the core code of the network device framework
        Provides a unified interface for operating network devices
        Supports multiple network device types
        Enables related network tools and commands

        Disabled by default; RT_USING_NETDEV is available once enabled.
if RT_USING_NETDEV

    config NETDEV_USING_IFCONFIG
        bool "Enable ifconfig features"
        default y
        help
            NETDEV_USING_IFCONFIG is used to enable or disable the ifconfig command functionality in the system.

            NETDEV_USING_IFCONFIG is enabled by default. When enabled, ifconfig can be used to perform the following functions: 
            View network interface information; 
            Configure network interface parameters.
    config NETDEV_USING_PING
        bool "Enable ping features"
        default y
        help
            NETDEV_USING_PING enables or disables the ping command functionality on the system.

            Function Description:
            Ping is a commonly used network diagnostic tool used to test connectivity between two network devices.

            It is disabled by default; once enabled, the ping function can be used.

    config NETDEV_USING_NETSTAT
        bool "Enable netstat features"
        default y
        help
            NETDEV_USING_NETSTAT enables or disables the netstat command functionality on your system.

            netstat is a command-line tool used to display network connectivity status, routing tables, and network interface statistics.

            It is enabled by default. Once enabled, you can use the netstat command in the shell (FinSH/MSH) to perform the following operations:
            View network connectivity status
            View network interface statistics
            View routing tables
    config NETDEV_USING_AUTO_DEFAULT
        bool "Enable default netdev automatic change features"
        default y
        help
            NETDEV_USING_AUTO_DEFAULT enables or disables automatic switching of the default network interface.

            Enabled by default. When enabled, the system automatically monitors the status of all network interfaces. 
            When a new network interface is enabled and successfully obtains an IP address, the system automatically sets this new interface as the default network interface.
            If the current default network interface becomes disconnected, the system will attempt to select one from other connected network interfaces as the new default interface.
    config NETDEV_USING_LINK_STATUS_CALLBACK
    	bool "Enable netdev callback on link status change"
    	default n
        help
            NETDEV_USING_LINK_STATUS_CALLBACK enables the network link state change callback mechanism.

            It is disabled by default. Once enabled, the netdev framework provides a set of link state change callback registration/deregistration interfaces, 
            allowing users to execute custom business logic when the link state of network devices changes.
                                
    config NETDEV_USING_IPV6
        bool "Enable IPV6 protocol support"
        default n
        help
            NETDEV_USING_IPv6 enables IPv6 protocol stack adaptation.

            Features:
            Adds IPv6 address management to network devices;
            Supports IPv6 link layer adaptation;
            Adapts to the RT-Thread kernel IPv6 protocol stack, providing IPv6 tools such as ping6 and ifconfig6;
            Unifies the operation interface for IPv4/IPv6 devices.

            Disabled by default. Once enabled, the netdev framework expands from "IPv4 only" to "dual-stack (IPv4+IPv6)/pure IPv6" mode.
    config NETDEV_IPV4
        int
        default 1

    config NETDEV_IPV6
        int
        default 1 if NETDEV_USING_IPV6
        default 0 if !NETDEV_USING_IPV6

    config NETDEV_IPV6_SCOPES
        bool
        help
            Defined to synchronize the ip6_addr structure state
        default n
endif
```

## components/net/sal/Kconfig
```kconfig
menuconfig RT_USING_SAL
    bool "SAL: socket abstraction layer"
    select RT_USING_NETDEV
    default n
    help
        SAL (Socket Abstraction Layer) provides unified BSD socket API for multiple network stacks.
        
        Features:
        - Standard BSD socket API (socket, bind, connect, send, recv, etc.)
        - Support multiple protocol stacks simultaneously
        - Network stack independence for applications
        - Automatic routing between different network interfaces
        
        Supported protocol stacks:
        - LwIP (full TCP/IP stack)
        - AT commands (for cellular/WiFi modules)
        - TLS/SSL (via MbedTLS)
        - Custom protocol stacks
        
        Benefits:
        - Write once, run on any supported network stack
        - Easy switching between WiFi, Ethernet, cellular
        - Multiple network connections concurrently
        - Standard POSIX socket compatibility
        
        Use cases:
        - Applications requiring network connectivity
        - Multi-interface systems (WiFi + Ethernet)
        - IoT devices with multiple network options
        - Network stack abstraction
        
        Enable for any application using network sockets.
        Overhead: ~4-6KB ROM, ~1KB RAM + socket buffers.

if RT_USING_SAL

    config SAL_INTERNET_CHECK
        bool "Enable the ability that check internet status"
        select RT_USING_SYSTEM_WORKQUEUE
        default y
        help
            The ability that check internet status is provided by RT-Thread.

    config SOCKET_TABLE_STEP_LEN
        int "Configure socket table step length"
        default 4
        help
            Growth step size for dynamic socket table expansion.
            
            Default: 4 sockets
            
            When socket table is full, it grows by this many entries:
            - Initial size: SAL_SOCKETS_NUM
            - Grows by: SOCKET_TABLE_STEP_LEN when full
            
            Smaller values:
            + Less wasted memory
            - More frequent reallocations
            
            Larger values:
            + Fewer reallocations
            - More unused memory
            
            Recommended: 4-8 for most applications.

    menu "Docking with protocol stacks"
        config SAL_USING_LWIP
            bool "Docking with lwIP stack"
            default n
            help
                Integrate LwIP (Lightweight IP) TCP/IP stack with SAL.
                
                LwIP provides full-featured TCP/IP protocol stack:
                - TCP, UDP, ICMP, IGMP protocols
                - IPv4 and IPv6 support
                - DHCP client and server
                - DNS resolution
                - Raw socket support
                
                When enabled, applications can use BSD sockets backed by LwIP.
                
                Required for:
                - Ethernet networking
                - WiFi with full TCP/IP
                - Complex network protocols
                
                Enable if using LwIP as network stack.

        config SAL_USING_AT
            bool "Docking with AT commands stack"
            default n
            help
                Integrate AT command-based network modules with SAL.
                
                AT commands provide network connectivity through:
                - Cellular modules (2G/3G/4G/5G/NB-IoT)
                - WiFi modules (ESP8266, ESP32, etc.)
                - Bluetooth modules
                
                Features:
                - BSD socket API over AT commands
                - Transparent to applications
                - Supports multiple AT devices
                - Hardware offload (module handles TCP/IP)
                
                Advantages:
                - Lower MCU resource usage
                - Faster time-to-market
                - Leverages module's TCP/IP stack
                
                Use cases:
                - IoT devices with cellular connectivity
                - Low-power WiFi applications
                - Systems with network co-processors
                
                Enable for AT command-based network modules.

        config SAL_USING_TLS
            bool "Docking with MbedTLS protocol"
            default n
            help
                Integrate MbedTLS for SSL/TLS secure communication.
                
                MbedTLS provides:
                - SSL/TLS encryption (TLS 1.0-1.3)
                - X.509 certificate handling
                - Secure sockets (HTTPS, MQTTS, etc.)
                - Cryptographic primitives
                
                Features:
                - Transparent SSL/TLS layer over SAL
                - Certificate verification
                - Multiple cipher suites
                - Session resumption
                
                Use cases:
                - HTTPS web clients/servers
                - Secure MQTT (MQTTS)
                - Encrypted data transmission
                - Cloud service connections (AWS, Azure, etc.)
                
                Requirements:
                - MbedTLS package
                - Network stack (LwIP or AT)
                - Sufficient RAM for TLS buffers (~20-40KB)
                
                Enable for secure network communications.
    endmenu

    config SAL_USING_POSIX
        bool
        depends on DFS_USING_POSIX
        default y
        help
            Enable BSD socket operations via file system API.
            
            When enabled, sockets can be used like files:
            - open/close for socket creation/destruction
            - read/write for send/receive
            - select/poll for I/O multiplexing
            - File descriptor sharing with regular files
            
            Benefits:
            - Unified I/O model (files + sockets)
            - Compatible with POSIX I/O functions
            - Works with select/poll
            - Easier application porting from Linux
            
            Automatically enabled when DFS with POSIX is available.
            Required for RT-Smart user-space socket access.

    config SAL_SOCKETS_NUM
        int "the maximum number of sockets"
        depends on !SAL_USING_POSIX
        default 16
        help
            Maximum number of sockets that can be created simultaneously.
            
            Default: 16 sockets
            
            Each socket uses:
            - ~100-200 bytes for socket structure
            - Send/receive buffers (protocol stack dependent)
            
            Increase for:
            - Server applications with many concurrent connections
            - Applications opening multiple sockets
            
            Decrease to save memory on constrained systems.
            
            Note: Not used when SAL_USING_POSIX enabled (uses DFS_FD_MAX instead).

endif
```
