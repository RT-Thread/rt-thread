## bsp/tm4c129x/KConfig
```kconfig
mainmenu "RT-Thread Configuration"

config $BSP_DIR
    string
    option env="BSP_ROOT"
    default "."

config $RTT_DIR
    string
    option env="RTT_ROOT"
    default "../.."

config $PKGS_DIR
    string
    option env="PKGS_ROOT"
    default "packages"

source "$RTT_DIR/KConfig"
source "$PKGS_DIR/KConfig"

menu "BSP_SPECIAL CONFIG"

config RT_USING_UART0
    bool "Using RT_USING_UART0"
    default y    
	
endmenu



    
    
```

## bsp/tm4c129x/Kconfig
```kconfig
mainmenu "RT-Thread Configuration"

BSP_DIR := .

RTT_DIR := ../..

PKGS_DIR := packages

source "$(RTT_DIR)/Kconfig"
osource "$PKGS_DIR/Kconfig"

config SOC_TM4C129
    bool
    select RT_USING_COMPONENTS_INIT
    select RT_USING_USER_MAIN
    default y

config RT_USING_UART0
    bool "Using RT_USING_UART0"
    default y
```

## bsp/tms320f28379d/board/Kconfig
```kconfig
menu "Hardware Drivers Config"

menu "Onboard Peripheral Drivers"
endmenu

menu "On-chip Peripheral Drivers"
    config BSP_USING_GPIO
        bool "Enable GPIO"
        select RT_USING_PIN
        default y

    menuconfig BSP_USING_UART
        bool "Enable UART"
        default y
        select RT_USING_SERIAL
        if BSP_USING_UART
            config BSP_USING_UART1
                bool "Enable UART1"
                default y
        endif

    menuconfig BSP_USING_PWM
        bool "Enable PWM"
        default n
        select RT_USING_PWM
        if BSP_USING_PWM
            menuconfig BSP_USING_PWM1
                bool "Enable ePWM1"
                default n
                if BSP_USING_PWM1
                    menuconfig BSP_PWM1_PHASE_ENABLE
                        bool "Enable phase"
                        default n
                    if BSP_PWM1_PHASE_ENABLE
                        choice
                            prompt "Select master or slave"
                            default BSP_PWM1_SLAVE
                            config BSP_PWM1_MASTER
                                bool "Master"
                            config BSP_PWM1_SLAVE
                                bool "Slave"
                                select BSP_PWM1_SYNC_IN
                        endchoice
                        if BSP_PWM1_MASTER
                            choice 
                                prompt "Sync time"
                                default BSP_PWM1_SYNC_ZERO
                                config BSP_PWM1_SYNC_IN
                                    bool "Receiving sync from outside"
                                config BSP_PWM1_SYNC_ZERO
                                    bool "Sync when counter reaches zero"
                                config BSP_PWM1_SYNC_COMPB
                                    bool "Sync when counter reaches compB"
                                config BSP_PWM1_SYNC_DISABLE
                                    bool "Disable sync"
                            endchoice
                            config BSP_PWM1_PHASE
                                int
                                default 0
                        endif
                        if BSP_PWM1_SLAVE
                            config BSP_PWM1_PHASE
                                int "Phase, 0~360"
                                range 0,360
                                default 0
                                help
                                    the phase for PWM1 module
                            choice
                                prompt "PWM counter direction when sync happens"
                                default 
                                config BSP_PWM1_PHSDIR_UP
                                    bool "Counter goes up when syncing"
                                config BSP_PWM1_PHSDIR_DOWN
                                    bool "Counter goes down when syncing"
                        endif
                        config BSP_PWM_SYNC_TIME
                            int
                            default 0 if BSP_PWM1_SYNC_IN
                            default 1 if BSP_PWM1_SYNC_ZERO
                            default 2 if BSP_PWM1_SYNC_COMPB
                            default 3 if BSP_PWM1_SYNC_DISABLE
                    endif
                    
                    menuconfig BSP_PWM1_IT_ENABLE
                        bool "Enable interrupt service"
                        default n
                        if BSP_PWM1_IT_ENABLE
                            choice BSP_PWM1_IT_TIME
                                prompt "Select interrupt time"
                                config BSP_ET_DCAEVT1SOC
                                    bool "DCAEVT1SOC"
                                config BSP_ET_CTR_ZERO
                                    bool "ctr == zero"
                                config BSP_ET_CTR_PRD
                                    bool "ctr == prd"
                                config BSP_ET_CTR_PRDZERO
                                    bool "ctr == prd or ctr == zero"
                                config BSP_ET_CTRU_CMPA
                                    bool "ctr == compa when counting up"
                                config BSP_ET_CTRD_CMPA
                                    bool "ctr == compa when counting down"
                                config BSP_ET_CTRU_CMPB
                                    bool "ctr == compb when counting up"
                                config BSP_ET_CTRD_CMPB
                                    bool "ctr == compb when counting down"
                            endchoice

                            config BSP_PWM1_IT_TIME_SEL
                                int
                                default 0 if BSP_ET_DCAEVT1SOC
                                default 1 if BSP_ET_CTR_ZERO
                                default 2 if BSP_ET_CTR_PRD
                                default 3 if BSP_ET_CTR_PRDZERO
                                default 4 if BSP_ET_CTRU_CMPA
                                default 5 if BSP_ET_CTRD_CMPA
                                default 6 if BSP_ET_CTRU_CMPB
                                default 7 if BSP_ET_CTRD_CMPB

                            config BSP_PWM1_IT_PRD
                                int "Interrupt period"
                                default 0
                                range 0 3
                                help
                                    ET_DISABLE		0x0
                                    ET_1ST			0x1
                                    ET_2ND			0x2
                                    ET_3RD			0x3
                        endif
                    config BSP_PWM1_INV
                        bool "PWM output inverted"
                        default n
                    config BSP_PWM1_HSPDIV
                        int "HSP Clock division"
                        range 0 2
                        default 0
                    config BSP_PWM1_DIV
                        int "Clock division"
                        range 0 2
                        default 0
                    choice
                        prompt "Select counter mode"
                        config BSP_PWM1_CTR_MODE_UPDOWN
                            bool "Up-down mode"
                        config BSP_PWM1_CTR_MODE_UP
                            bool "Up mode"
                        config BSP_PWM1_CTR_MODE_DOWN
                            bool "Down mode"
                    endchoice
                endif
            menuconfig BSP_USING_PWM2
                bool "Enable ePWM2"
                default n
                if BSP_USING_PWM2
                endif
            menuconfig BSP_USING_PWM3
                bool "Enable ePWM1"
                default n
                if BSP_USING_PWM3

                endif
            menuconfig BSP_USING_PWM4
                bool "Enable ePWM1"
                default n
                if BSP_USING_PWM4
                endif
        endif

    menuconfig BSP_USING_ADC
        bool "Enable ADC"
        default n
        select RT_USING_ADC
        if BSP_USING_ADC
            config BSP_USING_ADC1
                bool "Enable ADC1"
                default n
        endif

    menuconfig BSP_USING_ONCHIP_RTC
        bool "Enable RTC"
        select RT_USING_RTC
        default n
        if BSP_USING_ONCHIP_RTC
            choice
                prompt "Select clock source"
                default BSP_RTC_USING_LSE

                config BSP_RTC_USING_LSE
                    bool "RTC USING LSE"

                config BSP_RTC_USING_LSI
                    bool "RTC USING LSI"
            endchoice
        endif

    config BSP_USING_WDT
        bool "Enable Watchdog Timer"
        select RT_USING_WDT
        default n

    config BSP_USING_SDIO
        bool "Enable SDIO"
        select RT_USING_SDIO
        select RT_USING_DFS
        default n

    menuconfig BSP_USING_CAN
        bool "Enable CAN"
        default n
        select RT_USING_CAN
        if BSP_USING_CAN
            config BSP_USING_CAN1
                bool "using CAN1"
                default n
        endif

    config BSP_USING_USBD
        bool "Enable USB device"
        select RT_USING_USB_DEVICE
        default n
        if BSP_USING_USBD
            config BSP_USB_CONNECT_PIN
                int "USB connect pin"
                default 67

            config BSP_USB_PULL_UP_STATUS
                int "USB PULL UP STATUS"
                default 0
        endif
endmenu

menu "Board extended module Drivers"

endmenu

endmenu
```

## bsp/ultrarisc/ur_dp1000_evb/Kconfig
```kconfig
mainmenu "RT-Thread Project Configuration"

BSP_DIR := .

RTT_DIR := ../../..

PKGS_DIR := packages

source "$(RTT_DIR)/Kconfig"
osource "$PKGS_DIR/Kconfig"
rsource "board/Kconfig"

config BOARD_UR_DP1000
    bool
    select ARCH_RISCV64
    select ARCH_USING_RISCV_COMMON64
    select RT_USING_COMPONENTS_INIT
    select RT_USING_USER_MAIN
    select RT_USING_CACHE
    select ARCH_MM_MMU
    select ARCH_USING_ASID
    select ARCH_RISCV_FPU_D
    select ARCH_REMAP_KERNEL if RT_USING_SMART
    select RT_USING_DEVICE_OPS
    default y

config __STACKSIZE__
    int "stack size for interrupt"
    default 4096
```

## bsp/ultrarisc/ur_dp1000_evb/board/Kconfig
```kconfig
menu "Ultrarisc DP1000 Soc Drivers Configuration"

menuconfig BSP_USING_PLIC
    bool "Using PLIC"
    default y  
    if BSP_USING_PLIC
        config PLIC_BASE_ADDR
            hex "plic base mmio addr"
            default 0x9000000
        config PLIC_NDEV
            hex "plic supported irqs"
            default 160
    endif  

menuconfig BSP_USING_UART0
    bool "Using UART0"
    select RT_USING_SERIAL
    default y

    if BSP_USING_UART0
        config UART0_IRQ_BASE
            int "uart0 irq number"
            default 18

        config UART0_REFERENCE_CLOCK
            int "uart0 clock"
            default 62500000

        config UART0_DEFAULT_BAUDRATE
            int "uart0 baudrate"
            default 115200

        config UART0_BASE_ADDR
            hex "uart0 base mmio addr"
            default 0x20310000

        config UART0_REG_SHIFT
            int "uart0 reg shift"
            default 2

    endif

menuconfig BSP_USING_DW_SPI
    bool "Using Dw apb ssi SPI"
    select RT_USING_SPI
    default n
    if BSP_USING_DW_SPI
        config DW_SPI_IRQ_BASE
            int "spi irq number"
            default 19

        config DW_SPI_BASE_ADDR
            hex "dw spi base mmio addr"
            default 0x20320000
        
        config DW_SPI_MAX_FREQ
            int "dw max spi freq"
            default 62500000

    endif

menuconfig BSP_USING_MMC
    bool "Using MMC"
    select BSP_USING_SPI
    select RT_USING_SPI_MSD
    select RT_USING_DFS_ELMFAT
    default n

endmenu
```

## bsp/v2m-mps2/Kconfig
```kconfig
mainmenu "RT-Thread Configuration"

config $BSP_DIR
    string
    option env="BSP_ROOT"
    default "."

config $RTT_DIR
    string
    option env="RTT_ROOT"
    default "../.."

config $PKGS_DIR
    string
    option env="PKGS_ROOT"
    default "packages"

source "$RTT_DIR/Kconfig"
source "$PKGS_DIR/Kconfig"

config SOC_V2M_MPS2
    bool 
    select ARCH_ARM_CORTEX_M7
    default y

config RT_USING_UART
    bool "Using RT_USING_UART"
    default y

if RT_USING_UART
config RT_USING_UART0
    bool "Using RT_USING_UART0"
    default y      
endif
 
```

## bsp/w60x/Kconfig
```kconfig
mainmenu "RT-Thread Configuration"

BSP_DIR := .

RTT_DIR := ../..

# you can change the RTT_ROOT default "../.." to your rtthread_root,
# example : default "F:/git_repositories/rt-thread"

PKGS_DIR := packages

ENV_DIR := /

source "$(RTT_DIR)/Kconfig"
osource "$PKGS_DIR/Kconfig"
osource "$ENV_DIR/tools/scripts/cmds/Kconfig"
source "$(BSP_DIR)/drivers/Kconfig"

config SOC_W60X
    bool
    select RT_USING_COMPONENTS_INIT
    select RT_USING_USER_MAIN
    default y
```
