## bsp/gd32103c-eval/Kconfig
```kconfig
mainmenu "RT-Thread Configuration"

config BSP_DIR
    string
    option env="BSP_ROOT"
    default "."

config RTT_DIR
    string
    option env="RTT_ROOT"
    default "../.."
    
# you can change the RTT_ROOT default: "rt-thread"
# example : default "F:/git_repositories/rt-thread"

config PKGS_DIR
    string
    option env="PKGS_ROOT"
    default "packages"

source "$RTT_DIR/Kconfig"
source "$PKGS_DIR/Kconfig"

config SOC_SERIES_GD32F1
    bool
    default y

config SOC_GD32103C
    bool
    select RT_USING_COMPONENTS_INIT
    select RT_USING_USER_MAIN
    select SOC_SERIES_GD32F1
    default y

menu "On-chip Peripheral Drivers"
    menuconfig BSP_USING_UART
        bool "Enable UART"
        default y
        select RT_USING_SERIAL
        if BSP_USING_UART
            config BSP_USING_UART0
                bool "using uart0"
                default n
            config BSP_USING_UART1
                bool "using uart1"
                default n
            config BSP_USING_UART2
                bool "using uart2"
                default y
            config BSP_USING_UART3
                bool "using uart3"
                default n
            config BSP_USING_UART4
                bool "using uart4"
                default n
        endif
    menuconfig BSP_USING_ADC
        bool "Enable ADC"
        default n
        select RT_USING_ADC
        if BSP_USING_ADC
            config BSP_USING_ADC0
                bool "using adc0"
                default n
            config BSP_USING_ADC1
                bool "using adc1"
                default n
        endif
    menuconfig BSP_USING_HWTIMER
        bool "Enable hwtimer"
        default n
        select RT_USING_HWTIMER
        if BSP_USING_HWTIMER
            config BSP_USING_HWTIMER0
                bool "using hwtimer0"
                default n
            config BSP_USING_HWTIMER1
                bool "using hwtimer1"
                default n
            config BSP_USING_HWTIMER2
                bool "using hwtimer2"
                default n
            config BSP_USING_HWTIMER3
                bool "using hwtimer3"
                default n
            config BSP_USING_HWTIMER4
                bool "using hwtimer4"
                default n
            config BSP_USING_HWTIMER5
                bool "using hwtimer5"
                default n
            config BSP_USING_HWTIMER6
                bool "using hwtimer6"
                default n
            config BSP_USING_HWTIMER7
                bool "using hwtimer7"
                default n
        endif
    config BSP_USING_WDT
        bool "Enable Watchdog Timer"
        select RT_USING_WDT
        default n

    config BSP_USING_RTC
        bool "using internal rtc"
        default n
        select RT_USING_RTC

endmenu
```

## bsp/gd32105c-eval/drivers/Kconfig
```kconfig
menu "Hardware Drivers Config"

menu "Onboard Peripheral Drivers"

endmenu

menu "On-chip Peripheral Drivers"

    config SOC_SERIES_GD32F1
        bool
        default y
    config SOC_GD32105C
        bool
        select RT_USING_COMPONENTS_INIT
        select RT_USING_USER_MAIN
        select SOC_SERIES_GD32F1
        default y

    config RT_USING_USART0
        bool "Using USART0"
        select RT_USING_SERIAL
        default y

    config RT_USING_USART1
        bool "Using USART1"
        select RT_USING_SERIAL
        default n

    config RT_USING_USART2
        bool "Using USART2"
        select RT_USING_SERIAL
        default n

    config RT_USING_UART3
        bool "Using UART3"
        select RT_USING_SERIAL
        default n

    config RT_USING_SPI0
        bool "Using SPI0"
        select RT_USING_SPI
        default y

    config RT_USING_SPI1
        bool "Using SPI1"
        select RT_USING_SPI
        default n

    config RT_USING_SPI2
        bool "Using SPI2"
        select RT_USING_SPI
        default n

    config RT_USING_I2C0
        bool "Using I2C0"
        select RT_USING_I2C
        default n

    config RT_USING_I2C1
        bool "Using I2C1"
        select RT_USING_I2C
        default n
endmenu

menu "Board extended module Drivers"

endmenu

endmenu
```

## bsp/gd32350r-eval/Kconfig
```kconfig
mainmenu "RT-Thread Configuration"

config BSP_DIR
    string
    option env="BSP_ROOT"
    default "."

config RTT_DIR
    string
    option env="RTT_ROOT"
    default "../.."

# you can change the RTT_ROOT default: "rt-thread"
# example : default "F:/git_repositories/rt-thread"

config PKGS_DIR
    string
    option env="PKGS_ROOT"
    default "packages"

source "$RTT_DIR/Kconfig"
source "$PKGS_DIR/Kconfig"

config SOC_GD32350R
    bool
    select RT_USING_COMPONENTS_INIT
    select RT_USING_USER_MAIN
    default y

config BSP_USING_UART0
    bool "using uart0"
    select RT_USING_SERIAL
    default n
config BSP_USING_UART1
    bool "using uart1"
    select RT_USING_SERIAL
    default n
```

## bsp/gd32450z-eval/Kconfig
```kconfig
mainmenu "RT-Thread Configuration"

config BSP_DIR
    string
    option env="BSP_ROOT"
    default "."

config RTT_DIR
    string
    option env="RTT_ROOT"
    default "../.."

# you can change the RTT_ROOT default: "rt-thread"
# example : default "F:/git_repositories/rt-thread"

config PKGS_DIR
    string
    option env="PKGS_ROOT"
    default "packages"

source "$RTT_DIR/Kconfig"
source "$PKGS_DIR/Kconfig"

config SOC_GD32450Z
    bool
    select RT_USING_COMPONENTS_INIT
    select RT_USING_USER_MAIN
    default y

config BSP_USING_SDRAM
    bool "Using sdram"
    default y

config BSP_USING_UART0
    bool "using uart0"
    select RT_USING_SERIAL
    default n
config BSP_USING_UART1
    bool "using uart1"
    select RT_USING_SERIAL
    default n
config BSP_USING_UART2
    bool "using uart2"
    select RT_USING_SERIAL
    default y
config BSP_USING_UART3
    bool "using uart3"
    select RT_USING_SERIAL
    default n
config BSP_USING_UART4
    bool "using uart4"
    select RT_USING_SERIAL
    default n
config BSP_USING_UART5
    bool "using uart5"
    select RT_USING_SERIAL
    default n
config BSP_USING_LPUART1
    bool "using lpuart1"
    select RT_USING_SERIAL
    default n
```

## bsp/gd32e230k-start/Kconfig
```kconfig
mainmenu "RT-Thread Configuration"

config BSP_DIR
    string
    option env="BSP_ROOT"
    default "."

config RTT_DIR
    string
    option env="RTT_ROOT"
    default "../.."

config PKGS_DIR
    string
    option env="PKGS_ROOT"
    default "packages"

source "$RTT_DIR/Kconfig"
source "$PKGS_DIR/Kconfig"

config SOC_GD32E230K
    bool 
    select RT_USING_COMPONENTS_INIT
    select RT_USING_USER_MAIN
    default y

config RT_USING_USART0
    bool "Using USART0"
    select RT_USING_SERIAL
    default y
    
config RT_USING_USART1
    bool "Using USART1"
    select RT_USING_SERIAL
    default n

config RT_USING_USART2
    bool "Using USART2"
    select RT_USING_SERIAL
    default n

config RT_USING_UART3
    bool "Using UART3"
    select RT_USING_SERIAL
    default n
    
config RT_USING_UART4
    bool "Using UART4"
    select RT_USING_SERIAL
    default n

config RT_USING_SPI0
    bool "Using SPI0"
    select RT_USING_SPI
    default y 

config RT_USING_SPI1
    bool "Using SPI1"
    select RT_USING_SPI
    default n  

config RT_USING_I2C0
    bool "Using I2C0"
    select RT_USING_I2C
    default n 

config RT_USING_I2C1
    bool "Using I2C1"
    select RT_USING_I2C
    default n  
```

## bsp/gd32f103-demo/drivers/Kconfig
```kconfig
menu "BSP Config"

config SOC_SERIES_GD32F1
	bool "SOC_SERIES_GD32F1"
	select SOC_GD32F103RC
	select RT_USING_COMPONENTS_INIT
	select RT_USING_USER_MAIN
	default y

	menuconfig BSP_USING_USART
		bool "Enable USART"
		default y
		select RT_USING_SERIAL
		if BSP_USING_USART
				config BSP_USING_USART0
						bool "Enable USART0"
						default n

				config BSP_USING_USART1
						bool "Enable USART1"
						default y

				config BSP_USING_USART2
						bool "Enable USART2"
						default n

				config BSP_USING_USART3
						bool "Enable USART3"
						default n
		endif

	config BSP_USING_ONCHIP_FLASH
			bool "Enable onchip Flash."
			default y
endmenu
```

## bsp/gd32vf103v-eval/Kconfig
```kconfig
mainmenu "RT-Thread Configuration"

config BSP_DIR
    string
    option env="BSP_ROOT"
    default "."

config RTT_DIR
    string
    option env="RTT_ROOT"
    default "../.."

config PKGS_DIR
    string
    option env="PKGS_ROOT"
    default "packages"

source "$RTT_DIR/Kconfig"
source "$PKGS_DIR/Kconfig"
source "board/Kconfig"

config SOC_GD32VF103
    bool
    select RT_USING_COMPONENTS_INIT
    select RT_USING_USER_MAIN
    default y
```

## bsp/gd32vf103v-eval/board/Kconfig
```kconfig
menu "Hardware Drivers Config"

config SOC_GD32VF103V
    bool
    select SOC_SERIES_GD32VF103V
    default y

menu "Onboard Peripheral Drivers"

    config BSP_USING_USART
        bool "Enable USART (usart0)"
        select BSP_USING_UART
        select BSP_USING_UART0
        default y
endmenu

menu "On-chip Peripheral Drivers"

    config BSP_USING_GPIO
        bool "Enable GPIO"
        select RT_USING_PIN
        default y

    menuconfig BSP_USING_UART
        bool "Enable USART"
        default y
        select RT_USING_SERIAL
        if BSP_USING_UART
            config BSP_USING_UART0
                bool "Enable USART0"
                default y
        endif    

endmenu

menu "Board extended module Drivers"

endmenu

endmenu
```

## bsp/gkipc/Kconfig
```kconfig
mainmenu "RT-Thread Configuration"

config BSP_DIR
    string
    option env="BSP_ROOT"
    default "."

config RTT_DIR
    string
    option env="RTT_ROOT"
    default "../.."

config PKGS_DIR
    string
    option env="PKGS_ROOT"
    default "packages"

source "$RTT_DIR/Kconfig"
source "$PKGS_DIR/Kconfig"

config SOC_GK710
    bool 
    select RT_USING_COMPONENTS_INIT
    select RT_USING_USER_MAIN
    default y

choice
    prompt "Device type"
    default GK7102C
    config SOC_GK7101
        bool "GK7101"
    config SOC_GK7102
        bool "GK7102"
    config SOC_GK7101S
        bool "GK7101S"
    config SOC_GK7102S
        bool "GK7102S"
    config SOC_GK7102C
        bool "GK7102C"
endchoice

choice
    prompt "Board type"
    default GK7102C_EVB
    config BOARD_GK7101_EVB
        bool "GK7101_EVB"
        depends on SOC_GK7101
    config BOARD_GK7101_EVB
        bool "GK7101_EVB"
        depends on SOC_GK7102
    config BOARD_GK7101S_EVB
        bool "GK7101S_EVB"
        depends on SOC_GK7101S
    config BOARD_GK7101S_EVB
        bool "GK7101S_EVB"
        depends on SOC_GK7102S
    config BOARD_GK7102C_EVB
        bool "GK7102C_EVB"
        depends on SOC_GK7102C
endchoice

choice
    prompt "Sensor type"
    default SENSOR_TYPE_SC1135
    config SENSOR_TYPE_SC1135
        bool "SC1135"
    config SENSOR_TYPE_SC1145
        bool "SC1145"
    config SENSOR_TYPE_JXH65
        bool "JXH65"
    config SENSOR_TYPE_OV9750
        bool "OV9750"
    config SENSOR_TYPE_AR0130
        bool "AR0130"
    config SENSOR_TYPE_JXH42
        bool "JXH42"
endchoice

config TUNNING_TOOL_SUPPORT
    bool "Using Tuning Tool"
    default y
    
config RT_USING_DMA_MEM
    bool "Enable DMA Mem"
    default y  

config ARM1176_USE_VFP
    bool "Enable ARM1176 VFP"
    default y  
    
config RT_USING_VFP
    bool "Enable VFP"
    default y  

config RT_USING_CPU_FFS
    bool "Enable CPU FFS"
    default y
      
menu "Goke Peripheral Device Config"
    config RT_USING_ADC
        bool "Enable ADC"
        default y    
 
    config RT_USING_GMAC
        bool "Enable GMAC"
        default y     

    config RT_USING_PWM
        bool "Enable PWM"
        default y    
  
    config RT_USING_GK_DMA
        bool "Enable DMA"
        default y    
        
    config RT_USING_LIBZ
        bool "Enable Zlib for firmware uncompress"
        default y  
        
    config RT_USING_LOGCAPTURE
        bool "Enable DSP Logcaputure"
        default y
        
    config RT_ALIGN_UC_SIZE
        int "Align UC Size"
        default 8
    
    config RT_ALIGN_DSP_SIZE
        int "Align DSP Size"
        default 32
        
    config RT_DEBUG_UC_MEM
        int "Debug UC Memory"
        default 0
    
    config RT_DEBUG_DSP_MEM
        int "Debug DSP Memory"
        default 0
endmenu 
```
