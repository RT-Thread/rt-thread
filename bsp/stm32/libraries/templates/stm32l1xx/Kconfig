## bsp/stm32/stm32f103-100ask-mini/board/Kconfig
```kconfig
menu "Hardware Drivers Config"

menu "Onboard Peripheral Drivers"

    config BSP_USING_USB_TO_USART
        bool "Enable USB TO USART (uart1)"
        select BSP_USING_UART
        select BSP_USING_UART1
        default y

    config BSP_USING_USER_LED
        bool "Enable User LED (pa1)"
        select RT_USING_PIN
        default y

    config BSP_USING_USER_KEY
        bool "Enable User Key (pa0)"
        select RT_USING_PIN
        default y

endmenu

menu "On-chip Peripheral Drivers"

    config BSP_USING_GPIO
        bool "Enable GPIO"
        select RT_USING_PIN
        default y

    menuconfig BSP_USING_UART
        bool "Enable UART"
        default y
        select RT_USING_SERIAL
        if BSP_USING_UART
            config BSP_STM32_UART_V1_TX_TIMEOUT
                int "UART TX timeout"
                default 2000
                depends on RT_USING_SERIAL_V1
                
            menuconfig BSP_USING_UART1
                bool "Enable UART1"
                default y
                if BSP_USING_UART1
                    config BSP_UART1_RX_USING_DMA
                        bool "Enable UART1 RX DMA"
                        depends on BSP_USING_UART1 && RT_SERIAL_USING_DMA
                        default n

                    config BSP_UART1_TX_USING_DMA
                        bool "Enable UART1 TX DMA"
                        depends on BSP_USING_UART1 && RT_SERIAL_USING_DMA
                        default n

                    config BSP_UART1_RX_BUFSIZE
                        int "Set UART1 RX buffer size"
                        range 64 65535
                        depends on RT_USING_SERIAL_V2
                        default 256

                    config BSP_UART1_TX_BUFSIZE
                        int "Set UART1 TX buffer size"
                        range 0 65535
                        depends on RT_USING_SERIAL_V2
                        default 0

                    config BSP_UART1_DMA_PING_BUFSIZE
                        int "Set UART1 RX DMA ping-pong buffer size"
                        range 32 65535
                        depends on RT_USING_SERIAL_V2 && BSP_UART1_RX_USING_DMA
                        default 64    
                endif

            menuconfig BSP_USING_UART2
                bool "Enable UART2"
                default n
                if BSP_USING_UART2
                    config BSP_UART2_RX_USING_DMA
                        bool "Enable UART2 RX DMA"
                        depends on BSP_USING_UART2 && RT_SERIAL_USING_DMA
                        default n

                    config BSP_UART2_TX_USING_DMA
                        bool "Enable UART2 TX DMA"
                        depends on BSP_USING_UART2 && RT_SERIAL_USING_DMA
                        default n

                    config BSP_UART2_RX_BUFSIZE
                        int "Set UART2 RX buffer size"
                        range 64 65535
                        depends on RT_USING_SERIAL_V2
                        default 256

                    config BSP_UART2_TX_BUFSIZE
                        int "Set UART2 TX buffer size"
                        range 0 65535
                        depends on RT_USING_SERIAL_V2
                        default 0

                    config BSP_UART2_DMA_PING_BUFSIZE
                        int "Set UART2 RX DMA ping-pong buffer size"
                        range 32 65535
                        depends on RT_USING_SERIAL_V2 && BSP_UART2_RX_USING_DMA
                        default 64                        
                endif
        endif

    menuconfig BSP_USING_SPI
        bool "Enable SPI BUS"
        default n
        select RT_USING_SPI
        if BSP_USING_SPI
            config BSP_USING_SPI1
                bool "Enable SPI1 BUS"
                default n

            config BSP_SPI1_TX_USING_DMA
                bool "Enable SPI1 TX DMA"
                depends on BSP_USING_SPI1
                default n

            config BSP_SPI1_RX_USING_DMA
                bool "Enable SPI1 RX DMA"
                depends on BSP_USING_SPI1
                select BSP_SPI1_TX_USING_DMA
                default n
        endif

    source "$(BSP_DIR)/../libraries/HAL_Drivers/drivers/Kconfig"

endmenu

menu "Board extended module Drivers"

endmenu

endmenu
```

## bsp/stm32/stm32f103-100ask-pro/board/Kconfig
```kconfig
menu "Hardware Drivers Config"

menu "Onboard Peripheral Drivers"

    config BSP_USING_USB_TO_USART
        bool "Enable USB TO USART (uart1)"
        select BSP_USING_UART
        select BSP_USING_UART1
        default y

    config BSP_USING_RGB
        bool "Enable RGB LED (timer3 channel2 - 4)"
        select RT_USING_PWM
        select BSP_USING_PWM
        select BSP_USING_PWM3
        select BSP_USING_PWM3_CH2
        select BSP_USING_PWM3_CH3
        select BSP_USING_PWM3_CH4
        default n

    config BSP_USING_POT
        bool "Enable potentiometer"
        select BSP_USING_ADC
        select BSP_USING_ADC1
        default n

    config BSP_USING_SPI_FLASH
        bool "Enable SPI FLASH (W25Q64 spi1)"
        select BSP_USING_SPI
        select BSP_USING_SPI1
        select RT_USING_SFUD
        select RT_SFUD_USING_SFDP
        default n

    config BSP_USING_EEPROM
        bool "Enable I2C EEPROM (i2c1)"
        select BSP_USING_I2C1
        default n

    config BSP_USING_EXT_SRAM
        bool "Enable external sram"
        default n
        help
            Chip name is IS62WV51216BLL, 1Mbytes static RAMs organized as 512K words by 16bits.

endmenu

menu "On-chip Peripheral Drivers"

    config BSP_USING_GPIO
        bool "Enable GPIO"
        select RT_USING_PIN
        default y

    menuconfig BSP_USING_UART
        bool "Enable UART"
        default y
        select RT_USING_SERIAL
        if BSP_USING_UART
            config BSP_USING_UART1
                bool "Enable UART1"
                default y

            config BSP_UART1_RX_USING_DMA
                bool "Enable UART1 RX DMA"
                depends on BSP_USING_UART1 && RT_SERIAL_USING_DMA
                default n

            config BSP_USING_UART2
                bool "Enable UART2"
                default n

            config BSP_UART2_RX_USING_DMA
                bool "Enable UART2 RX DMA"
                depends on BSP_USING_UART2 && RT_SERIAL_USING_DMA
                default n

            config BSP_USING_UART3
                bool "Enable UART3"
                default n

            config BSP_UART3_RX_USING_DMA
                bool "Enable UART3 RX DMA"
                depends on BSP_USING_UART3 && RT_SERIAL_USING_DMA
                default n
        endif

    menuconfig BSP_USING_SPI
        bool "Enable SPI BUS"
        default n
        select RT_USING_SPI
        if BSP_USING_SPI
            config BSP_USING_SPI1
                bool "Enable SPI1 BUS"
                default n

            config BSP_SPI1_TX_USING_DMA
                bool "Enable SPI1 TX DMA"
                depends on BSP_USING_SPI1
                default n

            config BSP_SPI1_RX_USING_DMA
                bool "Enable SPI1 RX DMA"
                depends on BSP_USING_SPI1
                select BSP_SPI1_TX_USING_DMA
                default n

            config BSP_USING_SPI2
                bool "Enable SPI2 BUS"
                default n

            config BSP_SPI2_TX_USING_DMA
                bool "Enable SPI2 TX DMA"
                depends on BSP_USING_SPI2
                default n

            config BSP_SPI2_RX_USING_DMA
                bool "Enable SPI2 RX DMA"
                depends on BSP_USING_SPI2
                select BSP_SPI2_TX_USING_DMA
                default n
        endif

    menuconfig BSP_USING_ADC
        bool "Enable ADC"
        default n
        select RT_USING_ADC
        if BSP_USING_ADC
            config BSP_USING_ADC1
                bool "Enable ADC1"
                default n

            config BSP_USING_ADC2
                bool "Enable ADC2"
                default n

            config BSP_USING_ADC3
                bool "Enable ADC3"
                default n

        endif

    menuconfig BSP_USING_I2C1
        bool "Enable I2C1 BUS (software simulation)"
        default n
        select RT_USING_I2C
        select RT_USING_I2C_BITOPS
        select RT_USING_PIN
        if BSP_USING_I2C1
            config BSP_I2C1_SCL_PIN
                int "i2c1 scl pin number"
                range 0 175
                default 22
            config BSP_I2C1_SDA_PIN
                int "I2C1 sda pin number"
                range 0 175
                default 23
        endif

    menuconfig BSP_USING_TIM
        bool "Enable timer"
        default n
        select RT_USING_HWTIMER
        if BSP_USING_TIM
            config BSP_USING_TIM2
                bool "Enable TIM2"
                default n

            config BSP_USING_TIM3
                bool "Enable TIM3"
                default n

            config BSP_USING_TIM4
                bool "Enable TIM4"
                default n

            config BSP_USING_TIM5
                bool "Enable TIM5"
                default n
        endif

    menuconfig BSP_USING_PWM
        bool "Enable PWM"
        default n
        select RT_USING_PWM
        if BSP_USING_PWM
        menuconfig BSP_USING_PWM3
            bool "Enable timer3 output PWM"
            default n
            if BSP_USING_PWM3
                config BSP_USING_PWM3_CH2
                    bool "Enable PWM3 channel2"
                    default n

                config BSP_USING_PWM3_CH3
                    bool "Enable PWM3 channel3"
                    default n

                config BSP_USING_PWM3_CH4
                    bool "Enable PWM3 channel4"
                    default n
            endif
        endif

    config BSP_USING_CAN
        bool "Enable CAN"
        select RT_USING_CAN
        default n

    source "$(BSP_DIR)/../libraries/HAL_Drivers/drivers/Kconfig"

endmenu

menu "Board extended module Drivers"

endmenu

endmenu
```

## bsp/stm32/stm32f103-atk-nano/board/Kconfig
```kconfig
menu "Hardware Drivers Config"

config SOC_STM32F103RB
    bool
    select SOC_SERIES_STM32F1
    default y

menu "Onboard Peripheral Drivers"

    config BSP_USING_USB_TO_USART
        bool "Enable USB TO USART (uart1)"
        select BSP_USING_UART1
        default y

    config BSP_USING_EEPROM
        bool "Enable I2C EEPROM (i2c1)"
        select BSP_USING_I2C1
        default n

    config BSP_USING_SPI_FLASH
        bool "Enable SPI FLASH (w25q16 spi2)"
        select BSP_USING_SPI2
        select RT_USING_SFUD
        select RT_SFUD_USING_SFDP
        default n

    config BSP_USING_POT
        bool "Enable potentiometer"
        select BSP_USING_ADC
        select BSP_USING_ADC1
        default n 

endmenu

menu "On-chip Peripheral Drivers"

    config BSP_USING_GPIO
        bool "Enable GPIO"
        select RT_USING_PIN
        default y

    config BSP_USING_UART1
        bool "Enable UART1"
        select RT_USING_SERIAL
        default y

    config BSP_USING_UART2
        bool "Enable UART2"
        select RT_USING_SERIAL
        default n

    config BSP_USING_UART3
        bool "Enable UART3"
        select RT_USING_SERIAL
        default n

    menuconfig BSP_USING_TIM
        bool "Enable timer"
        default n
        select RT_USING_HWTIMER
        if BSP_USING_TIM
            config BSP_USING_TIM2
                bool "Enable TIM2"
                default n

            config BSP_USING_TIM3
                bool "Enable TIM3"
                default n

            config BSP_USING_TIM4
                bool "Enable TIM4"
                default n
        endif

    menuconfig BSP_USING_PWM
        bool "Enable pwm"
        default n
        select RT_USING_PWM
        if BSP_USING_PWM
        menuconfig BSP_USING_PWM3
            bool "Enable timer3 output pwm"
            default n
            if BSP_USING_PWM3
                config BSP_USING_PWM3_CH1
                    bool "Enable PWM3 channel1"
                    default n

                config BSP_USING_PWM3_CH2
                    bool "Enable PWM3 channel2"
                    default n
            endif
        endif

    config BSP_USING_SPI1
        bool "Enable SPI1 BUS"
        select RT_USING_SPI
        default n

    config BSP_USING_SPI2
        bool "Enable SPI2 BUS"
        select RT_USING_SPI
        default n

    config BSP_SPI_USING_DMA
        bool "Enable SPI DMA support"
        default n

    menuconfig BSP_USING_I2C1
        bool "Enable I2C1 BUS (software simulation)"
        default n
        select RT_USING_I2C
        select RT_USING_I2C_BITOPS
        select RT_USING_PIN
        if BSP_USING_I2C1
            config BSP_I2C1_SCL_PIN
                int "i2c1 scl pin number"
                range 0 63
                default 22
            config BSP_I2C1_SDA_PIN
                int "I2C1 sda pin number"
                range 0 63
                default 23
        endif

    menuconfig BSP_USING_ADC
        bool "Enable ADC"
        default n
        select RT_USING_ADC
        if BSP_USING_ADC
            config BSP_USING_ADC1
                bool "Enable ADC1"
                default n

            config BSP_USING_ADC2
                bool "Enable ADC2"
                default n
        endif

    config BSP_USING_ON_CHIP_FLASH
        bool "Enable on-chip FLASH"
        default n 

    config BSP_USING_ONCHIP_RTC
        bool "Enable RTC"
        select RT_USING_RTC
        select RT_USING_LIBC
        default n

    config BSP_USING_WDT
        bool "Enable Watchdog Timer"
        select RT_USING_WDT
        default n

endmenu

menu "Board extended module Drivers"

endmenu

endmenu
```
