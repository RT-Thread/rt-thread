## bsp/nuvoton/libraries/m480/rtt_port/Kconfig
```kconfig
config SOC_SERIES_M480
    bool
    select ARCH_ARM_CORTEX_M4
    select SOC_FAMILY_NUMICRO
    select RT_USING_COMPONENTS_INIT
    select RT_USING_USER_MAIN
    default y

    config BSP_USING_PDMA
        bool "Enable PDMA"
        default y

        if BSP_USING_PDMA
            config  NU_PDMA_MEMFUN_ACTOR_MAX
            int "Specify maximum mem actor for memfun"
            range 1 4
            default 4
        endif

    config BSP_USING_FMC
        bool "Enable FMC"
        select PKG_USING_FAL
		default n

    config BSP_USING_GPIO
        bool "Enable GPIO"
        select RT_USING_PIN
		default y

    config BSP_USING_CLK
        bool "Enable CLK"
        select RT_USING_PM
		default y
        help
	        Choose this option if you need CLK/PM function.
	        Notice: Enable the option will hold timer3 resource

        if BSP_USING_CLK
            config NU_CLK_INVOKE_WKTMR 
                bool "Enable SPD1 and DPD mode wakeup timer. (About 6.6 Secs)"
                default y       
        endif

    config BSP_USING_EMAC
        bool "Enable EMAC"
        select RT_USING_LWIP
        select RT_USING_NETDEV

        config NU_EMAC_PDMA_MEMCOPY
            bool "Use PDMA for data tranferring"
            select BSP_USING_PDMA
            depends on BSP_USING_EMAC
            default y

            config NU_EMAC_PDMA_MEMCOPY_THRESHOLD
                int "Min threshold to do PDMA memcpy"
                range 32 1500
                default 128
                depends on NU_EMAC_PDMA_MEMCOPY

    config BSP_USING_RTC
        bool "Enable RTC"
        select RT_USING_RTC
        
        config NU_RTC_SUPPORT_IO_RW
            bool "Support device RW entry"
            depends on BSP_USING_RTC && RT_USING_RTC
                
        config NU_RTC_SUPPORT_MSH_CMD
            bool "Support module shell command"
            depends on BSP_USING_RTC && RT_USING_RTC

    menuconfig BSP_USING_EADC
        bool "Enable EADC"

            config BSP_USING_EADC0
                bool "Enable EADC0"
                depends on BSP_USING_EADC && RT_USING_ADC

            config BSP_USING_EADC1
                bool "Enable EADC1"
                depends on BSP_USING_EADC && RT_USING_ADC

    menuconfig BSP_USING_TIMER
        bool "Enable TIMER"

            config BSP_USING_TMR0
				bool "Enable TIMER0"
                depends on BSP_USING_TIMER

     	    if BSP_USING_TMR0
                choice
					prompt "Select TIMER0 function mode"
					
					config BSP_USING_TIMER0
						select RT_USING_HWTIMER
						bool "TIMER0(TIMER)"
					help
						Choose this option if you need TIMER function mode.

					config BSP_USING_TPWM0
						select RT_USING_PWM
						bool "TIMER0(PWM)"
					help
						Choose this option if you need PWM function mode.

                endchoice
             endif

            config BSP_USING_TMR1
				bool "Enable TIMER1"
                depends on BSP_USING_TIMER
            
            if BSP_USING_TMR1
                choice
					prompt "Select TIMER1 function mode"
					
					config BSP_USING_TIMER1
						select RT_USING_HWTIMER
						bool "TIMER1(TIMER)"
					help
						Choose this option if you need TIMER function mode.

					config BSP_USING_TPWM1
						select RT_USING_PWM
						bool "TIMER1(PWM)"
					help
						Choose this option if you need PWM function mode.

                endchoice
             endif

            config BSP_USING_TMR2
				bool "Enable TIMER2"
                depends on BSP_USING_TIMER

     	    if BSP_USING_TMR2
                choice
					prompt "Select TIMER2 function mode"
					
					config BSP_USING_TIMER2
						select RT_USING_HWTIMER
						bool "TIMER2(TIMER)"
					help
						Choose this option if you need TIMER function mode.

					config BSP_USING_TPWM2
						select RT_USING_PWM
						bool "TIMER2(PWM)"
					help
						Choose this option if you need PWM function mode.

                endchoice
            endif
			
            config BSP_USING_TMR3
				bool "Enable TIMER3"
                depends on BSP_USING_TIMER && !RT_USING_PM

			if BSP_USING_TMR3
				choice
					prompt "Select TIMER3 function mode"
							
					config BSP_USING_TIMER3
						select RT_USING_HWTIMER
						bool "TIMER3(TIMER)"
						help
							Choose this option if you need TIMER function mode.

					config BSP_USING_TPWM3
						select RT_USING_PWM
						bool "TIMER3(PWM)"
						help
							Choose this option if you need PWM function mode.

				endchoice
			endif

    menuconfig BSP_USING_UART
        bool "Enable UART"
        select RT_USING_SERIAL

		if BSP_USING_UART
            config BSP_USING_UART0
                bool "Enable UART0"

            config BSP_USING_UART0_TX_DMA
                bool "Enable UART0 TX DMA"
                depends on BSP_USING_UART0 && RT_SERIAL_USING_DMA

            config BSP_USING_UART0_RX_DMA
                bool "Enable UART0 RX DMA"
                depends on BSP_USING_UART0 && RT_SERIAL_USING_DMA

            config BSP_USING_UART1
                bool "Enable UART1"

            config BSP_USING_UART1_TX_DMA
                bool "Enable UART1 TX DMA"
                depends on BSP_USING_UART1 && RT_SERIAL_USING_DMA

            config BSP_USING_UART1_RX_DMA
                bool "Enable UART1 RX DMA"
                depends on BSP_USING_UART1 && RT_SERIAL_USING_DMA

            config BSP_USING_UART2
                bool "Enable UART2"

            config BSP_USING_UART2_TX_DMA
                bool "Enable UART2 TX DMA"
                depends on BSP_USING_UART2 && RT_SERIAL_USING_DMA

            config BSP_USING_UART2_RX_DMA
                bool "Enable UART2 RX DMA"
                depends on BSP_USING_UART2 && RT_SERIAL_USING_DMA

            config BSP_USING_UART3
                bool "Enable UART3"

            config BSP_USING_UART3_TX_DMA
                bool "Enable UART3 TX DMA"
                depends on BSP_USING_UART3 && RT_SERIAL_USING_DMA

            config BSP_USING_UART3_RX_DMA
                bool "Enable UART3 RX DMA"
                depends on BSP_USING_UART3 && RT_SERIAL_USING_DMA

            config BSP_USING_UART4
                bool "Enable UART4"

            config BSP_USING_UART4_TX_DMA
                bool "Enable UART4 TX DMA"
                depends on BSP_USING_UART4 && RT_SERIAL_USING_DMA

            config BSP_USING_UART4_RX_DMA
                bool "Enable UART4 RX DMA"
                depends on BSP_USING_UART4 && RT_SERIAL_USING_DMA

            config BSP_USING_UART5
                bool "Enable UART5"

            config BSP_USING_UART5_TX_DMA
                bool "Enable UART5 TX DMA"
                depends on BSP_USING_UART5 && RT_SERIAL_USING_DMA

            config BSP_USING_UART5_RX_DMA
                bool "Enable UART5 RX DMA"
                depends on BSP_USING_UART5 && RT_SERIAL_USING_DMA

            config BSP_USING_UART6
                bool "Enable UART6"

            config BSP_USING_UART6_TX_DMA
                bool "Enable UART6 TX DMA"
                depends on BSP_USING_UART6 && RT_SERIAL_USING_DMA

            config BSP_USING_UART6_RX_DMA
                bool "Enable UART6 RX DMA"
                depends on BSP_USING_UART6 && RT_SERIAL_USING_DMA

            config BSP_USING_UART7
                bool "Enable UART7"

            config BSP_USING_UART7_TX_DMA
                bool "Enable UART7 TX DMA"
                depends on BSP_USING_UART7 && RT_SERIAL_USING_DMA

            config BSP_USING_UART7_RX_DMA
                bool "Enable UART7 RX DMA"
                depends on BSP_USING_UART7 && RT_SERIAL_USING_DMA
       endif
        
    menuconfig BSP_USING_I2C
        bool "Enable I2C"
        select RT_USING_I2C
        
   		if BSP_USING_I2C
           config BSP_USING_I2C0
               bool "Enable I2C0"
            
           config BSP_USING_I2C1
               bool "Enable I2C1"

           config BSP_USING_I2C2
               bool "Enable I2C2"
		endif

    menuconfig BSP_USING_USCI
        bool "Enable USCI"

    if BSP_USING_USCI

        config BSP_USING_UUART
           bool
                   
        config BSP_USING_USPI
           bool

        config BSP_USING_USPI_PDMA
           bool
           default n

        config BSP_USING_UI2C
           bool

        config BSP_USING_USCI0
           bool "Enable USCI0"

        if BSP_USING_USCI0
			   choice
			   prompt "Select USCI0 function mode"
						
			   config BSP_USING_UUART0
				  select RT_USING_SERIAL
				  select BSP_USING_UUART
				  bool "UUART0"
				  help
					  Choose this option if you need UART function mode.

			   config BSP_USING_UI2C0
				  select RT_USING_I2C
				  bool "UI2C0"
				  help
					  Choose this option if you need I2C function mode.
						
			   config BSP_USING_USPI0
				  select RT_USING_SPI
				  bool "USPI0"
				  help
					  Choose this option if you need SPI function mode.
			   endchoice

               config BSP_USING_UUART0_TX_DMA
                    bool "Enable UUART0 TX DMA"
                    depends on BSP_USING_UUART0 && RT_SERIAL_USING_DMA

               config BSP_USING_UUART0_RX_DMA
                    bool "Enable UUART0 RX DMA"
                    depends on BSP_USING_UUART0 && RT_SERIAL_USING_DMA

               config BSP_USING_USPI0_PDMA
                    bool "Use PDMA for data tranferring"
                    select BSP_USING_USPI_PDMA
                    depends on BSP_USING_USPI0   
     	endif

        config BSP_USING_USCI1
            bool "Enable USCI1"

     	if BSP_USING_USCI1
            choice
		    prompt "Select USCI1 function mode"

			config BSP_USING_UUART1
			    select RT_USING_SERIAL
 				select BSP_USING_UUART
				bool "UUART1"
			    help
			      Choose this option if you need UART function mode.

			config BSP_USING_UI2C1
			    select RT_USING_I2C
   				select BSP_USING_UI2C
				bool "UI2C1"
				help
				  Choose this option if you need I2C function mode.

 			config BSP_USING_USPI1
			    select RT_USING_SPI
   				select BSP_USING_USPI
				bool "USPI1"
				help
				  Choose this option if you need SPI function mode.
            endchoice

            config BSP_USING_UUART1_TX_DMA
                bool "Enable UUART1 TX DMA"
                depends on BSP_USING_UUART1 && RT_SERIAL_USING_DMA

            config BSP_USING_UUART1_RX_DMA
                bool "Enable UUART1 RX DMA"
                depends on BSP_USING_UUART1 && RT_SERIAL_USING_DMA

            config BSP_USING_USPI1_PDMA
                bool "Use PDMA for data tranferring"
                select BSP_USING_USPI_PDMA
                depends on BSP_USING_USPI1
        endif
             
    endif

    menuconfig BSP_USING_SDH
        bool "Enable SDH"
        select RT_USING_DFS
        
        if BSP_USING_SDH
           config BSP_USING_SDH0
               bool "Enable SDH0"

           config BSP_USING_SDH1
               bool "Enable SDH1"
           
           config NU_SDH_USING_PDMA
               bool "Using PDMA"
               select BSP_USING_PDMA

           config NU_SDH_HOTPLUG
               bool "Using HOTPLUG"
               default y
        endif

    menuconfig BSP_USING_CAN
        bool "Enable CAN"
        select RT_USING_CAN

		if BSP_USING_CAN
           config BSP_USING_CAN0
               bool "Enable CAN0"
            
           config BSP_USING_CAN1
               bool "Enable CAN1"
        endif
         
    menuconfig BSP_USING_BPWM
		bool "Enable BPWM"
		select RT_USING_PWM

		if BSP_USING_BPWM
           config BSP_USING_BPWM0
               bool "Enable BPWM0"
            
           config BSP_USING_BPWM1
               bool "Enable BPWM1"
		endif

    menuconfig BSP_USING_EPWM
		bool "Enable EPWM"
		select RT_USING_PWM

 		if BSP_USING_EPWM
          config BSP_USING_EPWM0
               bool "Enable EPWM0"
            
           config BSP_USING_EPWM1
               bool "Enable EPWM1"
		endif
		
	menuconfig BSP_USING_SPI
            bool "Enable SPI"
            select RT_USING_SPI

            if BSP_USING_SPI
 
                config BSP_USING_SPI_PDMA
                   bool
                   default n

                config BSP_USING_SPI0
                   bool "Enable SPI0"

               config BSP_USING_SPI0_PDMA
                   bool "Enable PDMA for SPI0"
                   select BSP_USING_SPI_PDMA
                   depends on BSP_USING_SPI0

               config BSP_USING_SPI1
                   bool "Enable SPI1"
            
               config BSP_USING_SPI1_PDMA
                   bool "Enable PDMA for SPI1"
                   select BSP_USING_SPI_PDMA
                   depends on BSP_USING_SPI1

                config BSP_USING_SPI2
                    bool "Enable SPI2"
            
               config BSP_USING_SPI2_PDMA
                   bool "Enable PDMA for SPI2"
                   select BSP_USING_SPI_PDMA
                   depends on BSP_USING_SPI2

               config BSP_USING_SPI3
                   bool "Enable SPI3"

               config BSP_USING_SPI3_PDMA
                   bool "Enable PDMA for SPI3"
                   select BSP_USING_SPI_PDMA
                   depends on BSP_USING_SPI3
            endif

	menuconfig BSP_USING_QSPI
		bool "Enable QSPI"
		select RT_USING_SPI
		select RT_USING_QSPI

   		if BSP_USING_QSPI
           config BSP_USING_QSPI0
               bool "Enable QSPI0"

			   config BSP_USING_QSPI0_PDMA
					bool "Enable PDMA for QSPI0"
					depends on BSP_USING_QSPI0

           config BSP_USING_QSPI1
               bool "Enable QSPI1"

			   config BSP_USING_QSPI1_PDMA
					bool "Enable PDMA for QSPI1"
					depends on BSP_USING_QSPI1
		endif

    menuconfig BSP_USING_SCUART
        bool "Enable SCUART"
        
   		if BSP_USING_SCUART
           config BSP_USING_SCUART0
               bool "Enable SCUART0"

           config BSP_USING_SCUART1
               bool "Enable SCUART1"

           config BSP_USING_SCUART2
               bool "Enable SCUART2"
		endif

    config BSP_USING_I2S
        bool "Enable I2S"
        select RT_USING_AUDIO

	config BSP_USING_CRYPTO
        bool "Enable CRPT"
        select RT_USING_HWCRYPTO
        select RT_HWCRYPTO_USING_AES
        select RT_HWCRYPTO_USING_AES_ECB
        select RT_HWCRYPTO_USING_AES_CBC
        select RT_HWCRYPTO_USING_AES_CFB
        select RT_HWCRYPTO_USING_AES_CTR
        select RT_HWCRYPTO_USING_AES_CFB
        select RT_HWCRYPTO_USING_AES_OFB
        select RT_HWCRYPTO_USING_DES
        select RT_HWCRYPTO_USING_DES_ECB
        select RT_HWCRYPTO_USING_DES_CBC
        select RT_HWCRYPTO_USING_3DES
        select RT_HWCRYPTO_USING_3DES_ECB
        select RT_HWCRYPTO_USING_3DES_CBC
        select RT_HWCRYPTO_USING_SHA1
        select RT_HWCRYPTO_USING_SHA2
        select RT_HWCRYPTO_USING_SHA2_224
        select RT_HWCRYPTO_USING_SHA2_256
        select RT_HWCRYPTO_USING_SHA2_384
        select RT_HWCRYPTO_USING_SHA2_512
        select RT_HWCRYPTO_USING_RNG

        config NU_PRNG_USE_SEED
            bool "Use specified seed value."
            depends on BSP_USING_CRYPTO
            help
               Specify the seed value to PRNG.

        if NU_PRNG_USE_SEED
            config NU_PRNG_SEED_VALUE
                hex "Enter seed value"
                range 0 0xFFFFFFFF
                default 0
        endif

	config BSP_USING_TRNG
		bool "Enable TRNG"
        select BSP_USING_CRYPTO
		select RT_USING_HWCRYPTO
		select RT_HWCRYPTO_USING_RNG

	config BSP_USING_CRC
		bool "Enable CRC"
        select BSP_USING_CRYPTO
        select RT_USING_HWCRYPTO
		select RT_HWCRYPTO_USING_CRC
		select RT_HWCRYPTO_USING_CRC_07
		select RT_HWCRYPTO_USING_CRC_8005
		select RT_HWCRYPTO_USING_CRC_1021
		select RT_HWCRYPTO_USING_CRC_04C11DB7

    config NU_CRC_USE_PDMA
        bool "Use PDMA for data tranferring."
        select BSP_USING_PDMA
        default y
        depends on BSP_USING_CRC

	config BSP_USING_WDT
		bool "Enable WDT"
		select RT_USING_WDT
        default y

	config BSP_USING_EBI
		bool "Enable EBI"
        default n

	config BSP_USING_USBD
		bool "Enable USBD"
		select RT_USING_USB_DEVICE

	config BSP_USING_OTG
		bool "Enable OTG"
		select RT_USING_USB_HOST
		select RT_USING_USB_DEVICE

	config BSP_USING_HSUSBD
		bool "Enable HSUSBD"
		select RT_USING_USB_DEVICE

	config BSP_USING_HSOTG
		bool "Enable HSOTG"
		select RT_USING_USB_HOST
		select RT_USING_USB_DEVICE
```
