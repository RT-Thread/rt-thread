## bsp/phytium/libraries/standalone/arch/armv8/Kconfig
```kconfig
menu "Arm architecture configuration"


choice
    prompt "Execution state"
    default ARCH_ARMV8_AARCH64

config ARCH_ARMV8_AARCH64
    bool "Armv8 aarch64 execution state"
    help
        AArch64 is a 64-bit Execution state. It supports the A64 instruction set. The standard
        register width is 64 bits.

config ARCH_ARMV8_AARCH32
    bool "Armv8 aarch32 execution state"
    help
        AArch32 is a 32-bit Execution state. Operation in this state is backward compatible with
        previous architectures. It supports the T32 and A32 instruction sets. The standard register
        width is 32 bits.

endchoice

menu "Compiler configuration"

choice 
	prompt "Toolchain selection"
	default ARM_GCC_SELECT 

config ARM_GCC_SELECT
	bool "Gcc"

config ARM_CLANG_SELECT
	bool "Clang"

endchoice

config TOOLCHAIN_NAME
	string
	default "gcc" if ARM_GCC_SELECT
	default "clang" if ARM_CLANG_SELECT
	




    config TARGET_ARMV8_AARCH32
        bool
        default y if ARCH_ARMV8_AARCH32
    
    config TARGET_ARMV8_AARCH64
        bool
        default y if ARCH_ARMV8_AARCH64




config ARCH_EXECUTION_STATE
	string
	default "aarch32" if ARCH_ARMV8_AARCH32
	default "aarch64" if ARCH_ARMV8_AARCH64


# FPU config
menu "Fpu configuration"

if ARCH_ARMV8_AARCH32

choice
	prompt "Fpu vfpu instruction"
	default ARCH_FPU_VFP_V4
	help
		Floating-point arithmetic instruction set architecture

config ARCH_FPU_VFP_V3
	bool "Vfpv3"
	help
		VFPv3U is a variant of VFPv3 that supports the trapping of floating-point exceptions to support code.

config ARCH_FPU_VFP_V4
	bool "Vfpv4"
	help
		VFPv4U is a variant of VFPv4 that supports the trapping of floating-point exceptions to support code.VFPv4 and VFPv4U add both the Half-precision Extension and the fused multiply-add instructions to the features of VFPv3.

endchoice

config ARM_DPFPU32
	bool "Fpu with 32 double-precision register"
	default y
	depends on ARCH_FPU

config ARM_FPU_ABI_SOFT
	bool "Soft float abi"
	default n
	depends on ARCH_FPU
	help
		Pass float value via integer register (-mfloat-abi=softfp)

config ARM_FPU_SYMBOL
	string
	depends on ARCH_FPU
    default "crypto-neon-fp-armv8" if ARCH_ARMV8_AARCH32 && ARM_NEON # according to gcc message, this is the auto option for arm-none-eabi armv8-a
	default "vfpv3"	if ARCH_ARMV8_AARCH32 && ARCH_FPU_VFP_V3 && ARM_DPFPU32 
	default "vfpv3-d16"	if ARCH_ARMV8_AARCH32 && ARCH_FPU_VFP_V3 && ARM_DPFPU32
	default "vfpv4" if ARCH_ARMV8_AARCH32 && ARCH_FPU_VFP_V4 && ARM_DPFPU32
	default	"vfpv4-d16" if ARCH_ARMV8_AARCH32 && ARCH_FPU_VFP_V4
	default "neon" if ARCH_ARMV8_AARCH64 && ARM_NEON

config ARM_NEON
	bool "Advanced SIMD (NEON) Extension"
	depends on ARCH_FPU
    default y

config ARCH_FPU
	bool "Fpu support"
	default y
	help
		Build in support for the Floating Point Unit (FPU).
		Check your chip specifications first; not all chips support the FPU.

endif
endmenu

if ARCH_ARMV8_AARCH64


config ARM_NEON
	bool "Advanced SIMD (NEON) Extension"
	default y

config ARM_CRC
    bool "Cyclic Redundancy Check (CRC) Extension"
    default y

config ARM_CRYPTO
    bool "Cryptographic (CRPTO) Extension"
    default y

config ARM_FLOAT_POINT
    bool "Float Point (FP)"
    default y

choice
	prompt "Code Model"
	default GCC_CODE_MODEL_SMALL
	help
		Select code model type for generation

config GCC_CODE_MODEL_TINY
	bool "Tiny"
	help
        Generate code for the tiny code model, symobls must be within 1MB of 
        each other

config GCC_CODE_MODEL_SMALL
	bool "Small"
	help
        Generate code for the small code model, symobls must be within 4GB of 
        each other

config GCC_CODE_MODEL_LARGE
    bool "Large"
    help
        Generate code for the large code model, no assumptions about addresses 
        and sizes of sections. Programs can be statically linked only

endchoice

endif

endmenu



config USE_CACHE
    bool
    prompt "Use cache"
    default n
    help
        Activate the MMU and TLB functions
    
    if USE_CACHE
        config USE_L3CACHE
            bool
            prompt "Use external l3 cache"
            depends on TARGET_FT2004 || TARGET_D2000
            default n
            help
                Include L3 Cache and enable 

        config USE_MMU
            bool
            prompt "Use mmu"
            default n
            help
                Include platform mmu setting
    endif

if TARGET_ARMV8_AARCH32

config USE_AARCH64_L1_TO_AARCH32
    bool
    prompt "Use aarch64 l1 to aarch32 code"
    default y
    help
        Use the Aarch64 to Aarch32 mode function
endif


if TARGET_ARMV8_AARCH64

config BOOT_WITH_FLUSH_CACHE
    bool
    prompt "Flush cache when bootup"
    default y
    depends on USE_AARCH64_L1_TO_AARCH32 || TARGET_ARMV8_AARCH64
    help
        Enable Cache flush when bootup, basically used when bootloader load elf/bin without cache flush

endif

config MMU_DEBUG_PRINTS
    bool
    prompt "MMU debug"
    default n
    depends on TARGET_ARMV8_AARCH64
    help
        Enable MMU debug printing 



endmenu
```

## bsp/phytium/libraries/standalone/board/Kconfig
```kconfig
menu "Board Configuration"

    choice BUILD_TARGET_CHIP_TYPE
        prompt "Chip"
        default TARGET_E2000Q
        help
            Select chip type for build

        config TARGET_F2000_4
            bool "FT2000-4"
            select USE_SERIAL
            select ENABLE_Pl011_UART

        config TARGET_D2000
            bool "D2000"
            select USE_SERIAL
            select ENABLE_Pl011_UART
            
        config TARGET_E2000Q
            bool "E2000Q"
            select TARGET_E2000
            select USE_SERIAL
            select ENABLE_Pl011_UART
        
        config TARGET_E2000D
            bool "E2000D"
            select TARGET_E2000
            select USE_SERIAL
            select ENABLE_Pl011_UART
        
        config TARGET_E2000S
            bool "E2000S"
            select TARGET_E2000
            select USE_SERIAL
            select ENABLE_Pl011_UART

#       config TARGET_TARDIGRADE
#           bool "TARDIGRADE"
                   
    endchoice # BUILD_TARGET_CHIP_TYPE

    # an invisible config to define common code of E2000 Q/D/S
    config TARGET_E2000
        bool
        default y if TARGET_E2000Q || TARGET_E2000D || TARGET_E2000S

    choice DEBUG_PRINT_UART
    prompt "Select Debug uart instance"
    default DEFAULT_DEBUG_PRINT_UART1
    help
        Select arch for build
    config DEFAULT_DEBUG_PRINT_UART1
        bool "Use uart1"
    config DEFAULT_DEBUG_PRINT_UART0
        bool "Use uart0"
    config DEFAULT_DEBUG_PRINT_UART2
        bool "Use uart2"
    endchoice # DEBUG_PRINT_UART
    

endmenu
```

## bsp/phytium/libraries/standalone/common/Kconfig
```kconfig
menu "Sdk common configuration"
choice DEBUG_LOG_LEVEL
    prompt "Debug log level"
    default LOG_ERROR
    help
        VERBOS: Print bigger chunks of debugging information
        DEBUG: Print extra information for debugging
        INFO: Print necessary information messages
        WARN: Print error conditions from which recovery measures have been taken
        ERROR: Print critical errors, software module can not recover on its own

    config LOG_VERBOS
        bool "Verbos"
    config LOG_DEBUG
        bool "Debug"
    config LOG_INFO
        bool "Info"
    config LOG_WARN
        bool "Warn"
    config LOG_ERROR
        bool "Error"
    config LOG_NONE
        bool "None"

endchoice # DEBUG_LOG_LEVEL

config LOG_EXTRA_INFO
    bool "Debug log with extra info"
    default n
    help
        Print debug information with source file name and source code line num.

config LOG_DISPALY_CORE_NUM
    bool "Debug display with core"
    default n
    help
        To display CPU core information during debugging

config BOOTUP_DEBUG_PRINTS
    bool
    prompt "Bootup debug"
    default n
    help
        Enable Bootup debug printing



config USE_DEFAULT_INTERRUPT_CONFIG
    bool
    prompt "Use default interrupt configuration"
    default y
    help 
        "If this option is not selected, core0 is used as the main core by default and all interrupt driver modules are initialized. Non-0 core initializes only the necessary interrupt driver modules.  If this option is selected, the developer needs to initiate each module independently  "
    if USE_DEFAULT_INTERRUPT_CONFIG
        choice INTERRUPT_ROLE_SELECT
        prompt "Interrupt role select"
        default INTERRUPT_ROLE_MASTER
        help
            "Select Interrupt role"

        config INTERRUPT_ROLE_MASTER
            bool "Use master role"    
        
        config INTERRUPT_ROLE_SLAVE
            bool "Use slave role"

        endchoice # INTERRUPT_ROLE_SELECT
    endif

endmenu
```

## bsp/phytium/libraries/standalone/drivers/Kconfig
```kconfig
menu "Components Configuration"
config USE_SPI
    bool
    prompt "Use Spi"
    default n
    help
        Include SPI modules and enable SPI

    if USE_SPI
        source "$STANDALONE_DIR/drivers/spi/Kconfig"
    endif

config USE_QSPI
    bool
    prompt "Use QSpi"
    default n
    help
        Include QSPI modules and enable QSPI

    if USE_QSPI
        source "$STANDALONE_DIR/drivers/qspi/Kconfig"
    endif

config USE_GIC
    bool
    prompt "Use Gic"
    default y
    help
        Include Generic Interrupt Controllor
    
    if USE_GIC
        source "$STANDALONE_DIR/drivers/gic/Kconfig"
    endif

config USE_SERIAL
    bool
    prompt "Use SERIAL"
    default n
    help
        Include serial modules and enable serial
    
    if USE_SERIAL
        source "$STANDALONE_DIR/drivers/serial/Kconfig"
    endif


config USE_GPIO
    bool
    prompt "Use Gpio"
    default n
    help
        Include GPIO modules and enable GPIO

    if USE_GPIO
        source "$STANDALONE_DIR/drivers/pin/fgpio/Kconfig"
    endif

config USE_ETH
    bool
    prompt "Use Eth"
    default n
    help
        Include eth

    if USE_ETH
        source "$STANDALONE_DIR/drivers/eth/Kconfig"
    endif

config USE_CAN
    bool
    prompt "Use Can"
    default n
    help
        Include can

    if USE_CAN
        source "$STANDALONE_DIR/drivers/can/Kconfig"
    endif

config USE_I2C
    bool
    prompt "Use I2C"
    default n
    help
        Include I2C modules and enable I2C

    if USE_I2C
        source "$STANDALONE_DIR/drivers/i2c/Kconfig"
    endif


config USE_TIMER
    bool
    prompt "Use Timer"
    default n
    help
        Include Timer modules and enable Timer

    if USE_TIMER
        source "$STANDALONE_DIR/drivers/timer/Kconfig"
    endif

config USE_MIO
    bool
    prompt "Use Mio"
    default n
    help
        Include Mio modules and enable Mio

    if USE_MIO
        source "$STANDALONE_DIR/drivers/mio/Kconfig"
    endif

config USE_SDMMC
    bool
    prompt "Use SD/MMC"
    default n
    help
        Include SD/MMC modules and enable Timer

    if USE_SDMMC
        source "$STANDALONE_DIR/drivers/mmc/Kconfig"
    endif

config USE_PCIE
    bool
    prompt "Use PCIE"
    default n
    help
        Include PCIE

    if USE_PCIE
        source "$STANDALONE_DIR/drivers/pcie/Kconfig"
    endif

config USE_WDT
    bool
    prompt "Use WDT"
    default n
    help
        Include watchdog timer modules and enable watchdog timer

    if USE_WDT
        source "$STANDALONE_DIR/drivers/watchdog/Kconfig"
    endif


config USE_DMA
    bool
    prompt "Use DMA"
    default n
    help
        Include DMA 

    if USE_DMA
        source "$STANDALONE_DIR/drivers/dma/Kconfig"
    endif
    
config USE_NAND
    bool
    prompt "Use NAND"
    help
        Include NAND
    
    if USE_NAND
        source "$STANDALONE_DIR/drivers/nand/Kconfig"
    endif

config USE_RTC
    bool
    prompt "Use RTC"
    default n
    help
        Include system rtc service

    if USE_RTC
        source "$STANDALONE_DIR/drivers/rtc/Kconfig"
    endif

config USE_SATA
    bool
    prompt "Use SATA"
    default n
    help
        Include system sata service

    if USE_SATA
        source "$STANDALONE_DIR/drivers/sata/Kconfig"
    endif
       
config USE_USB
    bool
    prompt "Use USB"
    default n
    help
        Include USB Subsystem

    if USE_USB
        source "$STANDALONE_DIR/drivers/usb/Kconfig"
    endif   
    
config USE_ADC
    bool
    prompt "Use ADC"
    default n
    help
        Include adc modules and enable adc

    if USE_ADC
        source "$STANDALONE_DIR/drivers/adc/Kconfig"
    endif
    
config USE_PWM
    bool
    prompt "Use PWM"
    default n
    help
        Include system pwm

    if USE_PWM
        source "$STANDALONE_DIR/drivers/pwm/Kconfig"
    endif

config USE_IPC
    bool
    prompt "Use IPC"
    default n
    help
        Include IPC Service

    if USE_IPC
        source "$STANDALONE_DIR/drivers/ipc/Kconfig"
    endif


config USE_MEDIA
    bool
    prompt "USE MEDIA"
    default n
    help
        Include media drivers
    
    if USE_MEDIA
        source "$STANDALONE_DIR/drivers/media/Kconfig"
    endif

config USE_SCMI_MHU
    bool
    prompt "USE SCMI_MHU"
    default n
    help
        Include scmi_mhu drivers
    
    if USE_SCMI_MHU
        source "$STANDALONE_DIR/drivers/scmi/Kconfig"
    endif

endmenu
```

## bsp/phytium/libraries/standalone/drivers/adc/Kconfig
```kconfig
menu "ADC Configuration"
    config USE_FADC
        bool
        prompt "Use FADC"
        default n
        
endmenu
```

## bsp/phytium/libraries/standalone/drivers/can/Kconfig
```kconfig
menu "CAN Configuration"
    config USE_FCAN
        bool
        prompt "Use FCAN"
        default n
    if  USE_FCAN
        config FCAN_USE_CANFD
        depends on TARGET_E2000
        bool
        prompt "Use CanFD"
        default n
        help
            use canfd protocol
    endif

endmenu
```

## bsp/phytium/libraries/standalone/drivers/dma/Kconfig
```kconfig
config ENABLE_FGDMA
    bool
    prompt "Use FGDMA"
    default n

config ENABLE_FDDMA
    bool
    prompt "Use FDDMA"
    default n
```

## bsp/phytium/libraries/standalone/drivers/eth/Kconfig
```kconfig
menu "Eth Configuration"
    config ENABLE_FXMAC
        bool
        prompt "Use FXMAC"
        default n
    
    config ENABLE_FGMAC
        bool
        prompt "Use FGMAC"
        default n   

    if  ENABLE_FGMAC
        source "$STANDALONE_DIR/drivers/eth/fgmac/Kconfig"
    endif

    if  ENABLE_FXMAC
        source "$STANDALONE_DIR/drivers/eth/fxmac/Kconfig"
    endif
    
endmenu
```

## bsp/phytium/libraries/standalone/drivers/eth/fgmac/Kconfig
```kconfig
choice FGMAC_PHY_TYPE
    prompt "PHY Type"
    default FGMAC_PHY_COMMON
    help
        Select PHY for FGMAC

    config FGMAC_PHY_COMMON
        bool "Common"
    config FGMAC_PHY_AR803X
        bool "AR803X"

endchoice # FGMAC_PHY_TYPE
```

## bsp/phytium/libraries/standalone/drivers/eth/fxmac/Kconfig
```kconfig
choice FXMAC_PHY_TYPE
    prompt "PHY Type"
    default FXMAC_PHY_COMMON
    help
        Select PHY for FGMAC

    config FXMAC_PHY_COMMON
        bool "Common"
    config FXMAC_PHY_YT
        bool "YT"

endchoice # FXMAC_PHY_TYPE
```

## bsp/phytium/libraries/standalone/drivers/gic/Kconfig
```kconfig
    config ENABLE_GICV3
        bool
        prompt "Use Generic Interrupt Controller v3"
        default y
```

## bsp/phytium/libraries/standalone/drivers/i2c/Kconfig
```kconfig
config USE_FI2C
    bool
    prompt "Use FI2C"
    default n
    help
        Include FI2C driver component
```
