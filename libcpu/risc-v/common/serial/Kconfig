## tests/utest/testcases/posix/dirent_h/Kconfig
```kconfig
menuconfig RTT_POSIX_TESTCASE_DIRENT_H
    bool "<dirent.h>"
    default n

if RTT_POSIX_TESTCASE_DIRENT_H

    config DIRENT_H_OPENDIR_READDIR_CLOSEDIR
    bool "<dirent.h> -> opendir, readdir, closedir"
    default n

endif
```

## tests/utest/testcases/posix/fenv_h/Kconfig
```kconfig
menuconfig RTT_POSIX_TESTCASE_FENV_H
    bool "<fenv.h>"
    default n

if RTT_POSIX_TESTCASE_FENV_H

# function, TODO

endif
```

## tests/utest/testcases/posix/libgen_h/Kconfig
```kconfig
menuconfig RTT_POSIX_TESTCASE_LIBGEN_H
    bool "<libgen.h>"
    default n

if RTT_POSIX_TESTCASE_LIBGEN_H

    config LIBGEN_H_BASENAME
        bool "<libgen.h> -> basename"
        default n

    config LIBGEN_H_DIRNAME
        bool "<libgen.h> -> dirname"
        default n

endif
```

## tests/utest/testcases/posix/locale_h/Kconfig
```kconfig
menuconfig RTT_POSIX_TESTCASE_LOCALE_H
    bool "<locale.h>"
    default n

if RTT_POSIX_TESTCASE_LOCALE_H

    config LOCALE_H_SETLOCALE
        bool "<locale.h -> setlocale>"
        default n

    config LIBGEN_H_LOCALECONV
        bool "<locale.h -> localconv>"
        default n

endif
```

## tests/utest/testcases/posix/netdb_h/Kconfig
```kconfig
menuconfig RTT_POSIX_TESTCASE_NETDB_H
    bool "<netdb.h>"
    default n

if RTT_POSIX_TESTCASE_NETDB_H

    config NETDB_H_ADDRINFO
        bool "<netdb.h> -> getaddrinfo, gai_strerror, getnameinfo, freeaddrinfo"
        default n

endif
```

## tests/utest/testcases/posix/semaphore_h/Kconfig
```kconfig
menuconfig RTT_POSIX_TESTCASE_SEMAPHORE_H
    bool "<semaphore.h>"
    default n

if RTT_POSIX_TESTCASE_SEMAPHORE_H

    # functions, TODO

endif
```

## tests/utest/testcases/posix/stropts_h/Kconfig
```kconfig
menuconfig RTT_POSIX_TESTCASE_STROPTS_H
    bool "<stropts.h>"
    default n

if RTT_POSIX_TESTCASE_STROPTS_H

    # functions, TODO

endif
```

## tests/utest/testcases/posix/sys/Kconfig
```kconfig
source "$RTT_DIR/tests/utest/testcases/posix/sys/mman_h/Kconfig"
source "$RTT_DIR/tests/utest/testcases/posix/sys/shm_h/Kconfig"
source "$RTT_DIR/tests/utest/testcases/posix/sys/utsname_h/Kconfig"
```

## tests/utest/testcases/posix/sys/uio_h/Kconfig
```kconfig
menuconfig RTT_POSIX_TESTCASE_SYS_UIO_H
    bool "<sys/shm.h>"
    default n

if RTT_POSIX_TESTCASE_SYS_UIO_H

    config UIO_H_READV
        bool "<sys/statvfs.h> -> readv"
        default n

    config UIO_H_WRITEV
        bool "<sys/statvfs.h> -> writev"
        default n

endif
```

## tests/utest/testcases/utest/Kconfig
```kconfig
menu "Utest Self Testcase"

config UTEST_SELF_PASS_TC
    bool "Pass test"
    default y

endmenu
```
