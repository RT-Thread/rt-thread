## bsp/ti/c28x/tms320f28379d/Kconfig
```kconfig
mainmenu "RT-Thread Configuration"

BSP_DIR := .

RTT_DIR := ../../../..

# you can change the RTT_ROOT default "../.." to your rtthread_root,
# example : default "F:/git_repositories/rt-thread"

PKGS_DIR := packages

config SOC_TMS320F28X
    bool
    select ARCH_TIDSP_C28X
    select RT_USING_COMPONENTS_INIT
    select RT_USING_USER_MAIN
    default y

source "$(RTT_DIR)/Kconfig"
osource "$PKGS_DIR/Kconfig"
rsource "board/Kconfig"
```

## bsp/ti/libraries/Kconfig
```kconfig
choice
    prompt "TI SOC"
    default SOC_AM335X
    help
        Select the TI SOC

    config SOC_AM335X
        bool "TI AM335x"
        select RT_USING_COMPONENTS_INIT
        select RT_USING_USER_MAIN
endchoice

menu "On-chip Peripheral Drivers"

config RT_USING_UART0
    bool "Using RT_USING_UART0"
    default n

config RT_USING_UART1
    bool "Using RT_USING_UART1"
    default n

endmenu
```

## bsp/ti/libraries/am335x/Kconfig
```kconfig
config RT_USING_CPSW0_PORT1
    bool "Using CPSW0 port1
    default n

    if RT_USING_CPSW0_PORT1
        choice
            prompt "cpsw0_port1 phy-mode"
            default CPSW0_PORT1_PHY_MODE_RGMII
            help
                Select the cpsw0_port1 phy-mode

            config CPSW0_PORT1_PHY_MODE_RGMII
                bool "rgmii"

            config CPSW0_PORT1_PHY_MODE_RGMII_ID
                bool "rgmii-id"
        endchoice

        config CPSW0_PORT_1_PHY_ADDR
            int "cpsw0 port1 phy_addr"
            default 0

        config CPSW0_PORT_1_PHY_GIGABIT
            int
            default 1 if CPSW0_PORT1_PHY_MODE_RGMII || CPSW0_PORT1_PHY_MODE_RGMII_ID
            default 0
    endif

config RT_USING_CPSW0_PORT2
    bool "Using CPSW0 port2"
    default n

    if RT_USING_CPSW0_PORT2
        choice
            prompt "cpsw0_port2 phy-mode"
            default CPSW_PORT2_PHY_MODE_RGMII
            help
                Select the cpsw0_port2 phy-mode

            config CPSW0_PORT2_PHY_MODE_RGMII
                bool "rgmii"

            config CPSW0_PORT2_PHY_MODE_RGMII_ID
                bool "rgmii-id"
        endchoice

        config CPSW0_PORT_2_PHY_ADDR
            int "cpsw0 port2 phy_addr"
            default 1

        config CPSW0_PORT_2_PHY_GIGABIT
            int
            default 1 if CPSW0_PORT2_PHY_MODE_RGMII || CPSW0_PORT2_PHY_MODE_RGMII_ID
            default 0
    endif

config CPSW_DUAL_MAC_MODE
    bool "Using CPSW0 ports in Dual MAC mode"
    select RT_USING_CPSW0_PORT1
    select RT_USING_CPSW0_PORT2
    default n

if RT_USING_CPSW0_PORT1 || RT_USING_CPSW0_PORT2
    config LWIP_CACHE_ENABLED
        bool "Using lwIP with cache"
        default n

    if LWIP_CACHE_ENABLED
        config SOC_CACHELINE_SIZE_BYTES
            int "Number of bytes in a cache line"
            default 64
    endif
endif
```

## bsp/tkm32F499/drivers/Kconfig
```kconfig
menu "Hardware Drivers Config"

config SOC_SERIES_TKM32F4
    bool
    default y

config SOC_TKM32F499
    bool
    select RT_USING_COMPONENTS_INIT
    select RT_USING_USER_MAIN
    select SOC_SERIES_TKM32F4
    default y

menu "Onboard Peripheral Drivers"

    config BSP_USING_USB_TO_USART
        bool "Enable USB TO USART (uart1)"
        select BSP_USING_UART
        select BSP_USING_UART1
        default y

    config BSP_USING_SDCARD
        bool "Enable SDCARD (sdio)"
        select BSP_USING_SDIO
        select RT_USING_DFS
        select RT_USING_DFS_ELMFAT
        default n

endmenu

menu "On-chip Peripheral Drivers"

    config BSP_USING_GPIO
        bool "Enable GPIO"
        select RT_USING_PIN
        default y

    menuconfig BSP_USING_UART
        bool "Enable UART"
        default y
        select RT_USING_SERIAL
        if BSP_USING_UART
            config BSP_USING_UART1
                bool "Enable UART1 PA9/10(T/R)"
                default y

            config BSP_USING_UART2
                bool "Enable UART2 PA2/3(T/R)"
                default n
        endif

    config BSP_USING_ON_CHIP_FLASH
        bool "Enable on-chip FLASH"
        default n

    menuconfig BSP_USING_SPI
        bool "Enable SPI BUS"
        default n
        select RT_USING_SPI
        if BSP_USING_SPI
            config BSP_USING_SPI1
                bool "Enable SPI1 BUS"
                default n

            config BSP_USING_SPI2
                bool "Enable SPI2 BUS"
                default n
        endif

    menuconfig BSP_USING_I2C1
        bool "Enable I2C1 BUS (software simulation)"
        default n
        select RT_USING_I2C
        select RT_USING_I2C_BITOPS
        select RT_USING_PIN
        if BSP_USING_I2C1
            config BSP_I2C1_SCL_PIN
                int "i2c1 scl pin number"
                range 0 175
                default 22
            config BSP_I2C1_SDA_PIN
                int "I2C1 sda pin number"
                range 0 175
                default 23
        endif

    menuconfig BSP_USING_TIM
        bool "Enable timer"
        default n
        select RT_USING_HWTIMER
        if BSP_USING_TIM
            config BSP_USING_TIM2
                bool "Enable TIM2"
                default n

            config BSP_USING_TIM3
                bool "Enable TIM3"
                default n
        endif

    menuconfig BSP_USING_ADC
        bool "Enable ADC"
        default n
        select RT_USING_ADC
        if BSP_USING_ADC
            config BSP_USING_ADC1
                bool "Enable ADC1"
                default n
        endif

    menuconfig BSP_USING_ONCHIP_RTC
        bool "Enable RTC"
        select RT_USING_RTC
        default n
        if BSP_USING_ONCHIP_RTC
            choice
                prompt "Select clock source"
                default BSP_RTC_USING_LSE

                config BSP_RTC_USING_LSE
                    bool "RTC USING LSE"

                config BSP_RTC_USING_LSI
                    bool "RTC USING LSI"
            endchoice
        endif

    config BSP_USING_WDT
        bool "Enable Watchdog Timer"
        select RT_USING_WDT
        default n

    config BSP_USING_SDIO
        bool "Enable SDIO"
        select RT_USING_SDIO
        select RT_USING_DFS
        default n

    config BSP_USING_LCD
        bool "Enable LCD"
        select BSP_USING_GPIO
        select BSP_USING_PWM
        select BSP_USING_PWM2
        select BSP_USING_PWM2_CH1
        default n


endmenu

menu "Board extended module Drivers"

endmenu

endmenu
```

## bsp/tm4c123bsp/board/Kconfig
```kconfig
menu "Hardware Drivers Config"

config  tm4c123
    bool
    select RT_USING_COMPONENTS_INIT
    select RT_USING_USER_MAIN
    default y


menu "Onboard Peripheral Drivers"

    config BSP_USING_USB_TO_USART
        bool "Enable USB TO USART (uart1)"
        select BSP_USING_UART
        select BSP_USING_UART1
        default y

    config BSP_USING_RS485_OR_RS232
        bool "Enable RS485/RS232 (uart2 be shared)"
        select BSP_USING_UART2
        default n

    config BSP_USING_SPI_FLASH
        bool "Enable SPI FLASH (W25Q64 spi1)"
        select BSP_USING_SPI
        select BSP_USING_SPI1
        select RT_USING_SFUD
        select RT_SFUD_USING_SFDP
        default n

    config BSP_USING_RGB
        bool "Enable RGB LED (timer3 channel2 - 4)"
        select RT_USING_PWM
        select BSP_USING_PWM
        select BSP_USING_PWM3
        select BSP_USING_PWM3_CH2
        select BSP_USING_PWM3_CH3
        select BSP_USING_PWM3_CH4
        default n

    config BSP_USING_POT
        bool "Enable potentiometer"
        select BSP_USING_ADC
        select BSP_USING_ADC1
        default n

    config BSP_USING_EEPROM
        bool "Enable I2C EEPROM (i2c1)"
        select BSP_USING_I2C1
        default n

    config BSP_USING_ETH
        bool "Enable Ethernet Driver (spi2)"
        default n
        select PKG_USING_WIZNET
        select WIZNET_DEVICE_EXTERN_CONFIG
        select BSP_USING_SPI2
        if BSP_USING_ETH
            if WIZNET_DEVICE_EXTERN_CONFIG
                config WIZ_SPI_DEVICE
                    string
                    default "spi20"

                config WIZ_RST_PIN
                    int
                    default 111

                config WIZ_IRQ_PIN
                    int
                    default 104
            endif

            config EXTERNAL_PHY_ADDRESS
                hex
                default 0x00

        endif

    config BSP_USING_SDCARD
        bool "Enable SDCARD (sdio)"
        select BSP_USING_SDIO
        select RT_USING_DFS
        select RT_USING_DFS_ELMFAT
        default n

endmenu

menu "On-chip Peripheral Drivers"

    config BSP_USING_GPIO
        bool "Enable GPIO"
        select RT_USING_PIN
        default y

    menuconfig BSP_USING_UART
        bool "Enable UART"
        default y
        select RT_USING_SERIAL
        if BSP_USING_UART
            config BSP_USING_UART0
                bool "Enable UART0"
                default y

            config BSP_USING_UART1
                bool "Enable UART1"
                default n

            config BSP_UART1_RX_USING_DMA
                bool "Enable UART1 RX DMA"
                depends on BSP_USING_UART1 && RT_SERIAL_USING_DMA
                default n

            config BSP_USING_UART2
                bool "Enable UART2"
                default n

            config BSP_UART2_RX_USING_DMA
                bool "Enable UART2 RX DMA"
                depends on BSP_USING_UART2 && RT_SERIAL_USING_DMA
                default n

            config BSP_USING_UART3
                bool "Enable UART3"
                default n

            config BSP_UART3_RX_USING_DMA
                bool "Enable UART3 RX DMA"
                depends on BSP_USING_UART3 && RT_SERIAL_USING_DMA
                default n
        endif

    config BSP_USING_ON_CHIP_FLASH
        bool "Enable on-chip FLASH"
        default n

    menuconfig BSP_USING_SPI
        bool "Enable SPI BUS"
        default n
        select RT_USING_SPI
        if BSP_USING_SPI
            config BSP_USING_SPI0
                bool "Enable SPI0 BUS"
                default n

            config BSP_USING_SPI1
                bool "Enable SPI1 BUS"
                default n

            config BSP_SPI1_TX_USING_DMA
                bool "Enable SPI1 TX DMA"
                depends on BSP_USING_SPI1
                default n

            config BSP_SPI1_RX_USING_DMA
                bool "Enable SPI1 RX DMA"
                depends on BSP_USING_SPI1
                select BSP_SPI1_TX_USING_DMA
                default n

            config BSP_USING_SPI2
                bool "Enable SPI2 BUS"
                default n

            config BSP_SPI2_TX_USING_DMA
                bool "Enable SPI2 TX DMA"
                depends on BSP_USING_SPI2
                default n

            config BSP_SPI2_RX_USING_DMA
                bool "Enable SPI2 RX DMA"
                depends on BSP_USING_SPI2
                select BSP_SPI2_TX_USING_DMA
                default n

            config BSP_USING_SPI3
                bool "Enable SPI3 BUS"
                default n

            config BSP_SPI3_TX_USING_DMA
                bool "Enable SPI3 TX DMA"
                depends on BSP_USING_SPI3
                default n

            config BSP_SPI3_RX_USING_DMA
                bool "Enable SPI3 RX DMA"
                depends on BSP_USING_SPI3
                select BSP_SPI3_TX_USING_DMA
                default n
        endif

    menuconfig BSP_USING_I2C1
        bool "Enable I2C1 BUS (software simulation)"
        default n
        select RT_USING_I2C
        select RT_USING_I2C_BITOPS
        select RT_USING_PIN
        if BSP_USING_I2C1
            config BSP_I2C1_SCL_PIN
                int "i2c1 scl pin number"
                range 0 175
                default 22
            config BSP_I2C1_SDA_PIN
                int "I2C1 sda pin number"
                range 0 175
                default 23
        endif

    menuconfig BSP_USING_TIM
        bool "Enable timer"
        default n
        select RT_USING_HWTIMER
        if BSP_USING_TIM
            config BSP_USING_TIM2
                bool "Enable TIM2"
                default n

            config BSP_USING_TIM3
                bool "Enable TIM3"
                default n

            config BSP_USING_TIM4
                bool "Enable TIM4"
                default n

            config BSP_USING_TIM5
                bool "Enable TIM5"
                default n
        endif

    menuconfig BSP_USING_PWM
        bool "Enable PWM"
        default n
        select RT_USING_PWM
        if BSP_USING_PWM
        menuconfig BSP_USING_PWM0
            bool "Enable pwm0"
            default n
            if BSP_USING_PWM0
                config BSP_USING_PWM0_CH1
                    bool "Enable PWM0 channel1"
                    default y

                config BSP_USING_PWM0_CH2
                    bool "Enable PWM0 channel2"
                    default n
            endif
        config BSP_USING_PWM1
            bool "Enable pwm1"
            default n
        config BSP_USING_PWM2
            bool "Enable pwm2"
            default n
        config BSP_USING_PWM3
            bool "Enable pwm3"
            default n
        config BSP_USING_PWM4
            bool "Enable pwm4"
            default n
        config BSP_USING_PWM5
            bool "Enable pwm5"
            default n
        config BSP_USING_PWM6
            bool "Enable pwm6"
            default n
        config BSP_USING_PWM7
            bool "Enable pwm7"
            default n
        endif

    menuconfig BSP_USING_ADC
        bool "Enable ADC"
        default n
        select RT_USING_ADC
        if BSP_USING_ADC
            config BSP_USING_ADC0
                bool "Enable ADC0"
                default n
            config BSP_USING_ADC1
                bool "Enable ADC1"
                default n
        endif

    menuconfig BSP_USING_ONCHIP_RTC
        bool "Enable RTC"
        select RT_USING_RTC
        default n
        if BSP_USING_ONCHIP_RTC
            choice
                prompt "Select clock source"
                default BSP_RTC_USING_LSE

                config BSP_RTC_USING_LSE
                    bool "RTC USING LSE"

                config BSP_RTC_USING_LSI
                    bool "RTC USING LSI"
            endchoice
        endif

    config BSP_USING_WDT
        bool "Enable Watchdog Timer"
        select RT_USING_WDT
        default n

    config BSP_USING_SDIO
        bool "Enable SDIO"
        select RT_USING_SDIO
        select RT_USING_DFS
        default n

    menuconfig BSP_USING_CAN
        bool "Enable CAN"
        default n
        select RT_USING_CAN
        if BSP_USING_CAN
            config BSP_USING_CAN1
                bool "using CAN1"
                default n
        endif

    config BSP_USING_USBD
        bool "Enable USB device"
        select RT_USING_USB_DEVICE
        default n
        if BSP_USING_USBD
            config BSP_USB_CONNECT_PIN
                int "USB connect pin"
                default 67

            config BSP_USB_PULL_UP_STATUS
                int "USB PULL UP STATUS"
                default 0
        endif
    config BSP_USING_CRC
        bool "Enable CRC (CRC-32 0x04C11DB7 Polynomial)"
        select RT_USING_HWCRYPTO
        select RT_HWCRYPTO_USING_CRC
        # "Crypto device frame dose not support above 8-bits granularity"
        # "Reserve progress, running well, about 32-bits granularity, such as stm32f1, stm32f4"
        default n

endmenu

menu "Board extended module Drivers"

endmenu

endmenu
```
