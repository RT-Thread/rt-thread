## bsp/es32f0334/drivers/Kconfig
```kconfig
menu "Hardware Drivers Config"

    menu "On-chip Peripheral Drivers"
        config BSP_USING_GPIO
            bool "Enable GPIO"
            select RT_USING_PIN
            default y

        menu "UART Drivers"
            config BSP_USING_UART0
                bool "Enable UART0 PB10/PB11(T/R)"
                select RT_USING_SERIAL
                default n

            config BSP_USING_UART1
                bool "Enable UART1 PC10/PC11(T/R)"
                select RT_USING_SERIAL
                default y

        endmenu

    endmenu

    menu "Onboard Peripheral Drivers"

    endmenu

    menu "Offboard Peripheral Drivers"

    endmenu

endmenu
```

## bsp/es32f0654/drivers/Kconfig
```kconfig
menu "Hardware Drivers Config"

    menu "On-chip Peripheral Drivers"
        config BSP_USING_GPIO
            bool "Enable GPIO"
            select RT_USING_PIN
            default y

        menu "UART Drivers"
            config BSP_USING_UART0
                bool "Enable UART0 PB10/PB11(T/R)"
                select RT_USING_SERIAL
                default n

            config BSP_USING_UART1
                bool "Enable UART1 PC10/PC11(T/R)"
                select RT_USING_SERIAL
                default n
        
            config BSP_USING_UART2
                bool "Enable UART2 PC12/PD02(T/R)"
                select RT_USING_SERIAL
                default y

            config BSP_USING_UART3
                bool "Enable UART3 PC04/PC05(T/R)"
                select RT_USING_SERIAL
                default n
        endmenu

        menu "SPI Drivers"
            config BSP_USING_SPI0
                bool "Enable SPI0 BUS PB03/PB04/PB05(CLK/MISO/MOSI)"
                select RT_USING_SPI
                select RT_USING_PIN
                default n

            config BSP_USING_SPI1
                bool "Enable SPI1 BUS PB13/PB14/PB15(CLK/MISO/MOSI)"
                select RT_USING_SPI
                select RT_USING_PIN
                default n
        endmenu

        menu "I2C Drivers"
            config BSP_USING_I2C0
                bool "Enable I2C0 BUS PB08/PB09(SCL/SDA)"
                select RT_USING_I2C
                default n
            config BSP_USING_I2C1
                bool "Enable I2C1 BUS PB10/PB11(SCL/SDA)"
                select RT_USING_I2C
                default n
        endmenu

    endmenu

    menu "Onboard Peripheral Drivers"

        config BSP_USING_SPI_FLASH
        bool "Enable SPI FLASH (W25Q64 spi0)"
        select BSP_USING_SPI
        select BSP_USING_SPI0
        select RT_USING_SFUD
        select RT_SFUD_USING_SFDP
        default n

    endmenu

    menu "Offboard Peripheral Drivers"

    endmenu

endmenu
```

## bsp/essemi/es32f0271/drivers/Kconfig
```kconfig
menu "Hardware Drivers Config"

    menu "On-chip Peripheral Drivers"
        menu "PIN Drivers"
        config BSP_USING_GPIO
            bool "Enable GPIO"
            select RT_USING_PIN
            default y
        endmenu

        menu "UART Drivers"
            config BSP_USING_UART1
                bool "Enable UART1 PB06/PB07(T/R)"
                select RT_USING_SERIAL
                default y

            config BSP_USING_UART2
                bool "Enable UART2 PA02/PA03(T/R)"
                select RT_USING_SERIAL
                default n

            config BSP_USING_UART3
                bool "Enable UART3 PC06/PC07(T/R)"
                select RT_USING_SERIAL
                default n
        endmenu

        menu "SPI Drivers"
            config BSP_USING_SPI1
                bool "Enable SPI1 BUS PB03/PB04/PB05(CLK/MISO/MOSI)"
                select RT_USING_SPI
                select RT_USING_PIN
                default n

            config BSP_USING_SPI2
                bool "Enable SPI2 BUS PB13/PB14/PB15(CLK/MISO/MOSI)"
                select RT_USING_SPI
                select RT_USING_PIN
                default n
                depends on !BSP_USING_PWM_GP16C2T4
        endmenu

        menu "I2C Drivers"
            config BSP_USING_I2C1
                bool "Enable I2C1 BUS PC12/PD02(SCL/SDA)"
                select RT_USING_I2C
                default n

            config BSP_USING_I2C2
                bool "Enable I2C2 BUS PB10/PB11(SCL/SDA)"
                select RT_USING_I2C
                default n
        endmenu

        menu "HWtimer Drivers"

            config BSP_USING_HWTIMER1
                bool "Using timer1"
                select RT_USING_HWTIMER
                default n
        endmenu

        menu "PWM Drivers"

            config BSP_USING_PWM_GP16C2T1
                bool "Using PWM_1(GP16C2T1) PB01/PB02"
                select RT_USING_PWM
                default n

            config BSP_USING_PWM_GP16C2T4
                bool "Using PWM2(GP16C2T4) PB12/PB14"
                select RT_USING_PWM
                default n
                depends on !BSP_USING_SPI2

        endmenu

        menu "RTC Drivers"
            config BSP_USING_RTC
                bool "Using RTC"
                select RT_USING_RTC
                default n
        endmenu

        menu "ADC Drivers"
            config BSP_USING_ADC
                bool "Using ADC"
                select RT_USING_ADC
                default n
        endmenu

    endmenu

    menu "Onboard Peripheral Drivers"

    endmenu

    menu "Offboard Peripheral Drivers"

    endmenu

endmenu
```

## bsp/essemi/es32f0654/Kconfig
```kconfig
mainmenu "RT-Thread Configuration"

BSP_DIR := .

RTT_DIR := ../../..

PKGS_DIR := packages

source "$(RTT_DIR)/Kconfig"
osource "$PKGS_DIR/Kconfig"

config SOC_ES32F0654LT
    bool
    select RT_USING_COMPONENTS_INIT
    select RT_USING_USER_MAIN
    select ARCH_ARM_CORTEX_M0
    default y

rsource "drivers/Kconfig"
```

## bsp/essemi/es32f0654/drivers/ES/Kconfig
```kconfig
menu "UART Drivers"

    config BSP_USING_UART0
        bool "Register UART0"
        select RT_USING_SERIAL
        default n

    config BSP_USING_UART1
        bool "Register UART1"
        select RT_USING_SERIAL
        default n

    config BSP_USING_UART2
        bool "Register UART2"
        select RT_USING_SERIAL
        default y

    config BSP_USING_UART3
        bool "Register UART3"
        select RT_USING_SERIAL
        default n

    config BSP_USING_USART0
        bool "Register USART0"
        select RT_USING_SERIAL
        default n

    config BSP_USING_USART1
        bool "Register USART1"
        select RT_USING_SERIAL
        default n
endmenu

menu "SPI Drivers"

    config BSP_USING_SPI0
        bool "Register SPI0"
        select RT_USING_SPI
        select RT_USING_PIN
        default n

    config BSP_USING_SPI1
        bool "Register SPI1"
        select RT_USING_SPI
        select RT_USING_PIN
        default n
endmenu

menu "I2C Drivers"
    config BSP_USING_I2C0
        bool "Register I2C0"
        select RT_USING_I2C
        default n

    config BSP_USING_I2C1
        bool "Register I2C1"
        select RT_USING_I2C
        default n
endmenu

menu "CAN Drivers"
    config BSP_USING_CAN0
        bool "Register CAN0"
        select RT_USING_CAN
        select RT_CAN_USING_HDR
        default n
endmenu

menu "PWM Drivers"
    config BSP_USING_AD16C4T0_PWM
        bool "Register pwm0"
        select RT_USING_PWM
        default n

    config BSP_USING_GP16C4T0_PWM
        bool "Register pwm1"
        select RT_USING_PWM
        default n

    config BSP_USING_GP16C2T0_PWM
        bool "Register pwm2"
        select RT_USING_PWM
        default n

    config BSP_USING_GP16C2T1_PWM
        bool "Register pwm3"
        select RT_USING_PWM
        default n
endmenu

menu "HWtimer Drivers"
    config BSP_USING_AD16C4T0_HWTIMER
        bool "Register timer0"
        select RT_USING_HWTIMER
        default n
        depends on !BSP_USING_AD16C4T0_PWM

    config BSP_USING_GP16C4T0_HWTIMER
        bool "Register timer1"
        select RT_USING_HWTIMER
        default n
        depends on !BSP_USING_GP16C4T0_PWM

    config BSP_USING_GP16C2T0_HWTIMER
        bool "Register timer2"
        select RT_USING_HWTIMER
        default n
        depends on !BSP_USING_GP16C2T0_PWM

    config BSP_USING_GP16C2T1_HWTIMER
        bool "Register timer3"
        select RT_USING_HWTIMER
        default n
        depends on !BSP_USING_GP16C2T1_PWM

    config BSP_USING_BS16T0_HWTIMER
        bool "Register timer4"
        select RT_USING_HWTIMER
        default n

    config BSP_USING_BS16T1_HWTIMER
        bool "Register timer5"
        select RT_USING_HWTIMER
        default n
        depends on !BSP_USING_UART2

    config BSP_USING_BS16T2_HWTIMER
        bool "Register timer6"
        select RT_USING_HWTIMER
        default n
        depends on !BSP_USING_UART3

    config BSP_USING_BS16T3_HWTIMER
        bool "Register timer7"
        select RT_USING_HWTIMER
        default n
endmenu

menu "RTC Drivers"
    config BSP_USING_RTC
        bool "Register RTC"
        select RT_USING_RTC
        default n
endmenu

menu "PM Drivers"
    config BSP_USING_PM
        bool "Using PM"
        select RT_USING_PM
        default n
endmenu

menu "ADC Drivers"
    config BSP_USING_ADC0
        bool "Using ADC"
        select RT_USING_ADC
        select BSP_USING_ADC
        default n
endmenu
```

## bsp/essemi/es32f0654/drivers/Kconfig
```kconfig
menu "Hardware Drivers Config"

    menu "On-chip Peripheral Drivers"
        config BSP_USING_GPIO
            bool "Enable GPIO"
            select RT_USING_PIN
            default y

        menu "UART Drivers"
            config BSP_USING_UART0
                bool "Enable UART0 PB10/PB11(T/R)"
                select RT_USING_SERIAL
                default n

            config BSP_USING_UART1
                bool "Enable UART1 PC10/PC11(T/R)"
                select RT_USING_SERIAL
                default n

            config BSP_USING_UART2
                bool "Enable UART2 PC12/PD02(T/R)"
                select RT_USING_SERIAL
                default y
                depends on !BSP_USING_HWTIMER1

            config BSP_USING_UART3
                bool "Enable UART3 PC04/PC05(T/R)"
                select RT_USING_SERIAL
                default n
                depends on !BSP_USING_HWTIMER2
        endmenu

        menu "SPI Drivers"
            config BSP_USING_SPI0
                bool "Enable SPI0 BUS PB03/PB04/PB05(CLK/MISO/MOSI)"
                select RT_USING_SPI
                select RT_USING_PIN
                default n

            config BSP_USING_SPI1
                bool "Enable SPI1 BUS PB13/PB14/PB15(CLK/MISO/MOSI)"
                select RT_USING_SPI
                select RT_USING_PIN
                default n
        endmenu

        menu "I2C Drivers"
            config BSP_USING_I2C0
                bool "Enable I2C0 BUS PB08/PB09(SCL/SDA)"
                select RT_USING_I2C
                default n

            config BSP_USING_I2C1
                bool "Enable I2C1 BUS PB10/PB11(SCL/SDA)"
                select RT_USING_I2C
                default n
        endmenu

        menu "CAN Drivers"
            config BSP_USING_CAN
                bool "Enable CAN BUS PA11/PA12(RX/TX)"
                select RT_USING_CAN
                default n
        endmenu

        menu "PWM Drivers"
            config BSP_USING_PWM0
                bool "Using PWM0 PA08/PA09/PA10/PA11"
                select RT_USING_PWM
                default n 

            config BSP_USING_PWM1
                bool "Using PWM1 PB06/PB07/PB08/PB09"
                select RT_USING_PWM
                default n

            config BSP_USING_PWM2
                bool "Using PWM2 PA00/PA01"
                select RT_USING_PWM
                default n

            config BSP_USING_PWM3
                bool "Using PWM3 PC06/PC07"
                select RT_USING_PWM
                default n
        endmenu

        menu "HWtimer Drivers"
            config BSP_USING_HWTIMER0
                bool "Using timer0"
                select RT_USING_HWTIMER
                default n

            config BSP_USING_HWTIMER1
                bool "Using timer1"
                select RT_USING_HWTIMER
                default n
                depends on !BSP_USING_UART2

            config BSP_USING_HWTIMER2
                bool "Using timer2"
                select RT_USING_HWTIMER
                default n
                depends on !BSP_USING_UART3

            config BSP_USING_HWTIMER3
                bool "Using timer3"
                select RT_USING_HWTIMER
                default n
        endmenu

        menu "RTC Drivers"
            config BSP_USING_RTC
                bool "Using RTC"
                select RT_USING_RTC
                default n
        endmenu

        menu "PM Drivers"
            config BSP_USING_PM
                bool "Using PM"
                select RT_USING_PM
                default n
        endmenu

        menu "ADC Drivers"
            config BSP_USING_ADC
                bool "Using ADC"
                select RT_USING_ADC
                default n
        endmenu

    endmenu

    menu "Onboard Peripheral Drivers"

        config BSP_USING_SPI_FLASH
            bool "Enable SPI FLASH (W25Q64 spi0)"
            select BSP_USING_SPI
            select BSP_USING_SPI0
            select RT_USING_SFUD
            select RT_SFUD_USING_SFDP
            default n

    endmenu

    menu "Offboard Peripheral Drivers"

    endmenu


    menu "Peripheral Drivers test example"

        config BSP_USING_EXAMPLE_ADC_VOL
            bool "BSP_USING_EXAMPLE_ADC_VOL"
            default n
        
        config BSP_USING_EXAMPLE_HWTIMER
            bool "BSP_USING_EXAMPLE_HWTIMER"
            default n

        config BSP_USING_EXAMPLE_I2C
            bool "BSP_USING_EXAMPLE_I2C"
            default n

        config BSP_USING_EXAMPLE_LED_BLINK
            bool "BSP_USING_EXAMPLE_LED_BLINK"
            default y

        config BSP_USING_EXAMPLE_PIN_BEEP
            bool "BSP_USING_EXAMPLE_PIN_BEEP"
            default y

        config BSP_USING_EXAMPLE_PWM_LED
            bool "BSP_USING_EXAMPLE_PWM_LED"
            default n

        config BSP_USING_EXAMPLE_RTC
            bool "BSP_USING_EXAMPLE_RTC"
            default n

        config BSP_USING_EXAMPLE_SPI
            bool "BSP_USING_EXAMPLE_SPI"
            default n

        config BSP_USING_EXAMPLE_UART
            bool "BSP_USING_EXAMPLE_UART"
            default y

        config BSP_USING_EXAMPLE_CAN
            bool "BSP_USING_EXAMPLE_CAN"
            default n

        config BSP_USING_EXAMPLE_PM
            bool "BSP_USING_EXAMPLE_PM"
            default n

    endmenu

endmenu
```

## bsp/essemi/es32f365x/Kconfig
```kconfig
mainmenu "RT-Thread Configuration"

BSP_DIR := .

RTT_DIR := ../../..

PKGS_DIR := packages

source "$(RTT_DIR)/Kconfig"
osource "$PKGS_DIR/Kconfig"

config SOC_ES32F3696LT
    bool
    select RT_USING_COMPONENTS_INIT
    select RT_USING_USER_MAIN
    select ARCH_ARM_CORTEX_M3
    default y

rsource "drivers/Kconfig"
```
