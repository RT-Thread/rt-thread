## bsp/renesas/ra2a1-ek/board/Kconfig
```kconfig
menu "Hardware Drivers Config"

    menu "Onboard Peripheral Drivers"

    endmenu

    menu "On-chip Peripheral Drivers"

        rsource "../../libraries/HAL_Drivers/drivers/Kconfig"

        menuconfig BSP_USING_UART
            bool "Enable UART"
            default y
            select RT_USING_SERIAL
            select RT_USING_SERIAL_V2
            if BSP_USING_UART

                menuconfig BSP_USING_UART0
                    bool "Enable UART0"
                    default n
                    if BSP_USING_UART0
                        config BSP_UART0_RX_USING_DMA
                            bool "Enable UART0 RX DMA"
                            depends on BSP_USING_UART0 && RT_SERIAL_USING_DMA
                            default n

                        config BSP_UART0_TX_USING_DMA
                            bool "Enable UART0 TX DMA"
                            depends on BSP_USING_UART0 && RT_SERIAL_USING_DMA
                            default n

                        config BSP_UART0_RX_BUFSIZE
                            int "Set UART0 RX buffer size"
                            range 64 65535
                            depends on RT_USING_SERIAL_V2
                            default 256

                        config BSP_UART0_TX_BUFSIZE
                            int "Set UART0 TX buffer size"
                            range 0 65535
                            depends on RT_USING_SERIAL_V2
                            default 0
                    endif
                
                menuconfig BSP_USING_UART1
                    bool "Enable UART1"
                    default n
                    if BSP_USING_UART1
                        config BSP_UART1_RX_USING_DMA
                            bool "Enable UART1 RX DMA"
                            depends on BSP_USING_UART1 && RT_SERIAL_USING_DMA
                            default n

                        config BSP_UART1_TX_USING_DMA
                            bool "Enable UART1 TX DMA"
                            depends on BSP_USING_UART1 && RT_SERIAL_USING_DMA
                            default n

                        config BSP_UART1_RX_BUFSIZE
                            int "Set UART1 RX buffer size"
                            range 64 65535
                            depends on RT_USING_SERIAL_V2
                            default 256

                        config BSP_UART1_TX_BUFSIZE
                            int "Set UART1 TX buffer size"
                            range 0 65535
                            depends on RT_USING_SERIAL_V2
                            default 0
                    endif
                
                menuconfig BSP_USING_UART9
                    bool "Enable UART9"
                    default n
                    if BSP_USING_UART9
                        config BSP_UART9_RX_USING_DMA
                            bool "Enable UART9 RX DMA"
                            depends on BSP_USING_UART9 && RT_SERIAL_USING_DMA
                            default n

                        config BSP_UART9_TX_USING_DMA
                            bool "Enable UART9 TX DMA"
                            depends on BSP_USING_UART9 && RT_SERIAL_USING_DMA
                            default n

                        config BSP_UART9_RX_BUFSIZE
                            int "Set UART9 RX buffer size"
                            range 64 65535
                            depends on RT_USING_SERIAL_V2
                            default 256

                        config BSP_UART9_TX_BUFSIZE
                            int "Set UART9 TX buffer size"
                            range 0 65535
                            depends on RT_USING_SERIAL_V2
                            default 0
                    endif
            endif
        
        menuconfig BSP_USING_SCI
            bool "Enable SCI Controller"
            default n
            config BSP_USING_SCIn_SPI
                bool
                depends on BSP_USING_SCI
                select RT_USING_SPI
                default n

            config BSP_USING_SCIn_I2C
                bool
                depends on BSP_USING_SCI
                select RT_USING_I2C
                default n

            config BSP_USING_SCIn_UART
                bool
                depends on BSP_USING_SCI
                select RT_USING_SERIAL
                select RT_USING_SERIAL_V2
                default n

            if BSP_USING_SCI
                config BSP_USING_SCI0
                    bool "Enable SCI0"
                    default n
                    if BSP_USING_SCI0
                        choice
                        prompt "choice sci mode"
                        default BSP_USING_SCI0_SPI
                        config BSP_USING_SCI0_SPI
                            select BSP_USING_SCIn_SPI
                            bool "SPI mode"
                        config BSP_USING_SCI0_I2C
                            select BSP_USING_SCIn_I2C
                            bool "I2C mode"
                        config BSP_USING_SCI0_UART
                            select BSP_USING_SCIn_UART
                            bool "UART mode"
                        endchoice
                        if BSP_USING_SCI0_UART
                            config BSP_SCI0_UART_RX_BUFSIZE
                                int "Set UART0 RX buffer size"
                                range 64 65535
                                depends on RT_USING_SERIAL_V2
                                default 256

                            config BSP_SCI0_UART_TX_BUFSIZE
                                int "Set UART0 TX buffer size"
                                range 0 65535
                                depends on RT_USING_SERIAL_V2
                                default 0
                        endif
                    endif
                config BSP_USING_SCI1
                    bool "Enable SCI1"
                    default n
                    if BSP_USING_SCI1
                        choice
                        prompt "choice sci mode"
                        default BSP_USING_SCI1_SPI
                        config BSP_USING_SCI1_SPI
                            select BSP_USING_SCIn_SPI
                            bool "SPI mode"
                        config BSP_USING_SCI1_I2C
                            select BSP_USING_SCIn_I2C
                            bool "I2C mode"
                        config BSP_USING_SCI1_UART
                            select BSP_USING_SCIn_UART
                            bool "UART mode"
                        endchoice
                        if BSP_USING_SCI1_UART
                            config BSP_SCI1_UART_RX_BUFSIZE
                                int "Set UART1 RX buffer size"
                                range 64 65535
                                depends on RT_USING_SERIAL_V2
                                default 256

                            config BSP_SCI1_UART_TX_BUFSIZE
                                int "Set UART1 TX buffer size"
                                range 0 65535
                                depends on RT_USING_SERIAL_V2
                                default 0
                        endif
                    endif
               
                config BSP_USING_SCI9
                    bool "Enable SCI9"
                    default n
                    if BSP_USING_SCI9
                        choice
                        prompt "choice sci mode"
                        default BSP_USING_SCI9_SPI
                        config BSP_USING_SCI9_SPI
                            select BSP_USING_SCIn_SPI
                            bool "SPI mode"
                        config BSP_USING_SCI9_I2C
                            select BSP_USING_SCIn_I2C
                            bool "I2C mode"
                        config BSP_USING_SCI9_UART
                            select BSP_USING_SCIn_UART
                            bool "UART mode"
                        endchoice
                        if BSP_USING_SCI9_UART
                            config BSP_SCI9_UART_RX_BUFSIZE
                                int "Set UART9 RX buffer size"
                                range 64 65535
                                depends on RT_USING_SERIAL_V2
                                default 256

                            config BSP_SCI9_UART_TX_BUFSIZE
                                int "Set UART9 TX buffer size"
                                range 0 65535
                                depends on RT_USING_SERIAL_V2
                                default 0
                        endif
                    endif
            endif
    
        menuconfig BSP_USING_HW_I2C
            bool "Enable hardware I2C BUS"
            default n
            select RT_USING_I2C
            if BSP_USING_HW_I2C
                config BSP_USING_HW_I2C0
                    bool "Enable Hardware I2C0 BUS"
                    default n
                config BSP_USING_HW_I2C1
                    bool "Enable Hardware I2C1 BUS"
                    default n
            endif

        menuconfig BSP_USING_PWM
            bool "Enable PWM"
            default n
            select RT_USING_PWM
            if BSP_USING_PWM
                config BSP_USING_PWM0
                    bool "Enable GPT0 (32-Bits) output PWM"
                    default n

                config BSP_USING_PWM1
                    bool "Enable GPT1 (32-Bits) output PWM"
                    default n

                config BSP_USING_PWM2
                    bool "Enable GPT2 (32-Bits) output PWM"
                    default n

                config BSP_USING_PWM3
                    bool "Enable GPT3 (32-Bits) output PWM"
                    default n

                config BSP_USING_PWM4
                    bool "Enable GPT4 (32-Bits) output PWM"
                    default n

                config BSP_USING_PWM5
                    bool "Enable GPT5 (32-Bits) output PWM"
                    default n

                config BSP_USING_PWM6
                    bool "Enable GPT6 (32-Bits) output PWM"
                    default n
            endif

        menuconfig BSP_USING_SPI
            bool "Enable SPI BUS"
            default n
            select RT_USING_SPI
            if BSP_USING_SPI
                config BSP_USING_SPI0
                    bool "Enable SPI0 BUS"
                    default n
                config BSP_USING_SPI1
                    bool "Enable SPI1 BUS"
                    default n
            endif

        menuconfig BSP_USING_ADC
            bool "Enable ADC"
            default n
            select RT_USING_ADC
            if BSP_USING_ADC
                config BSP_USING_ADC0
                    bool "Enable ADC0"
                    default n
            endif
            
        menuconfig BSP_USING_DAC
            bool "Enable DAC"
            default n
            select RT_USING_DAC
            if BSP_USING_DAC
                config BSP_USING_DAC0
                    bool "Enable DAC0"
                    default n
            endif

    endmenu

    menu "Board extended module Drivers"

    endmenu
endmenu
```

## bsp/renesas/ra2e2-ek/board/Kconfig
```kconfig
menu "Hardware Drivers Config"

    menu "Onboard Peripheral Drivers"

    endmenu

    menu "On-chip Peripheral Drivers"

        rsource "../../libraries/HAL_Drivers/drivers/Kconfig"

        menuconfig BSP_USING_UART
            bool "Enable UART"
            default y
            select RT_USING_SERIAL
            select RT_USING_SERIAL_V2
            if BSP_USING_UART

                menuconfig BSP_USING_UART9
                    bool "Enable UART9"
                    default n
                    if BSP_USING_UART9
                        config BSP_UART9_RX_USING_DMA
                            bool "Enable UART9 RX DMA"
                            depends on BSP_USING_UART9 && RT_SERIAL_USING_DMA
                            default n

                        config BSP_UART9_TX_USING_DMA
                            bool "Enable UART9 TX DMA"
                            depends on BSP_USING_UART9 && RT_SERIAL_USING_DMA
                            default n

                        config BSP_UART9_RX_BUFSIZE
                            int "Set UART9 RX buffer size"
                            range 64 65535
                            depends on RT_USING_SERIAL_V2
                            default 256

                        config BSP_UART9_TX_BUFSIZE
                            int "Set UART9 TX buffer size"
                            range 0 65535
                            depends on RT_USING_SERIAL_V2
                            default 0
                    endif
            endif

        menuconfig BSP_USING_HW_I2C
            bool "Enable hardware I2C BUS"
            default n
            select RT_USING_I2C
            if BSP_USING_HW_I2C
                config BSP_USING_HW_I2C0
                    bool "Enable Hardware I2C0 BUS"
                    default n
            endif

        menuconfig BSP_USING_SPI
            bool "Enable hardware SPI BUS"
            default n
            select RT_USING_SPI
            if BSP_USING_SPI
                config BSP_USING_SPI0
                    bool "Enable Hardware SPI0 BUS"
                    default n
            endif

        menuconfig BSP_USING_PWM
            bool "Enable PWM"
            default n
            select RT_USING_PWM
            if BSP_USING_PWM
                config BSP_USING_PWM4
                    bool "Enable GPT4 (16-Bits) output PWM"
                    default n

                config BSP_USING_PWM5
                    bool "Enable GPT5 (16-Bits) output PWM"
                    default n

                config BSP_USING_PWM6
                    bool "Enable GPT6 (16-Bits) output PWM"
                    default n

                config BSP_USING_PWM7
                    bool "Enable GPT7 (16-Bits) output PWM"
                    default n

                config BSP_USING_PWM8
                    bool "Enable GPT8 (16-Bits) output PWM"
                    default n

                config BSP_USING_PWM9
                    bool "Enable GPT9 (16-Bits) output PWM"
                    default n

            endif
        
        menuconfig BSP_USING_ADC
            bool "Enable ADC"
            default n
            select RT_USING_ADC
            if BSP_USING_ADC
                config BSP_USING_ADC0
                    bool "Enable ADC0"
                    default n
            endif

    endmenu

    menu "Board extended module Drivers"

    endmenu
endmenu
```
