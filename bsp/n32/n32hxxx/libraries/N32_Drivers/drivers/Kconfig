## bsp/n32g452xx/n32g452xx-mini-system/board/Kconfig
```kconfig
menu "Hardware Drivers Config"

config SOC_N32G452XX
    bool
    select SOC_SERIES_N32G452XX
    select RT_USING_COMPONENTS_INIT
    select RT_USING_USER_MAIN
    default y

menu "Onboard Peripheral Drivers"

    config BSP_USING_UART
        bool "Enable USART (uart1)"
        select RT_USING_SERIAL
        select BSP_USING_UART1
        default y

endmenu

menu "On-chip Peripheral Drivers"

            choice
                prompt "Package of N32G45NXX chip:"
                default N32G45X_PIN_NUMBERS_64
                config N32G45X_PIN_NUMBERS_48
                    bool "LQFP48/TQFP48(QFN48 is not supported.)"
                config N32G45X_PIN_NUMBERS_64
                    bool "LQFP64"
                config N32G45X_PIN_NUMBERS_100
                    bool "LQFP100"
                config N32G45X_PIN_NUMBERS_128
                    bool "LQFP128"
            endchoice

            config N32G45X_PIN_NUMBERS
                int
                range 0 128
                default 48 if N32G45X_PIN_NUMBERS_48
                default 64 if N32G45X_PIN_NUMBERS_64
                default 100 if N32G45X_PIN_NUMBERS_100
                default 128 if N32G45X_PIN_NUMBERS_128


    config BSP_USING_GPIO
        bool "Enable GPIO"
        select RT_USING_PIN
        default y
        if BSP_USING_GPIO

            menu "Remap JTAG Port"
                choice
                    prompt "Remap JTAG Port"
                        default BSP_RMP_SW_JTAG_SW_ENABLE
                        config BSP_RMP_SW_JTAG_FULL_ENABLE
                            bool "Full SWJ Enabled (JTAG-DP+SW-DP). No GPIO available."
                        config BSP_RMP_SW_JTAG_NO_NJTRST
                            bool "Full SWJ Enabled (JTAG-DP+SW-DP) without JTRST. PB4 available."
                        config BSP_RMP_SW_JTAG_SW_ENABLE
                            bool "JTAG-DP Disabled and SW-DP Enabled. PA15,PB3,PB4 available."
                        config BSP_RMP_SW_JTAG_DISABLE
                            bool "Full SWJ Disabled (JTAG-DP+SW-DP). PA13,PA14,PA15,PB3,PB4 available."
                endchoice
            endmenu
        endif

    config BSP_USING_ON_CHIP_FLASH
        bool "Enable on-chip FLASH"
        default n

    config BSP_USING_WDT
        bool "Enable Watchdog Timer"
        select RT_USING_WDT
        default n

    menuconfig BSP_USING_UART
        bool "Enable UART"
        default y
        select RT_USING_SERIAL
        if BSP_USING_UART
            config BSP_USING_UART1
                bool "Enable USART1"
                default y
                if BSP_USING_UART1
                    choice
                        prompt "Select TX/RX Pin of USART1"
                        default BSP_USING_UART1_NO_RMP
                        config BSP_USING_UART1_PIN_RMP
                            bool "USART1(Remap):(TX:PB6,RX:PB7)"
                        config BSP_USING_UART1_NO_RMP
                            bool "USART1(Default):(TX:PA9,RX:PA10)"
                    endchoice
                endif

            config BSP_USING_UART2
                bool "Enable USART2"
                default n
                if BSP_USING_UART2
                    choice
                        prompt "Select TX/RX Pin of USART2"
                        default BSP_USING_UART2_NO_RMP
                        config BSP_USING_UART2_NO_RMP
                            bool "USART2(Default):(TX:PA2, RX:PA3)"
                        config BSP_USING_UART2_PIN_RMP1
                            bool "USART2:(TX:PD5, RX:PD6)"
                        config BSP_USING_UART2_PIN_RMP2
                            bool "USART2:(TX:PC8, RX:PC9)"
                        config BSP_USING_UART2_PIN_RMP3
                            bool "USART2:(TX:PB4, RX:PB5)"

                            endchoice
                endif

            config BSP_USING_UART3
                bool "Enable USART3"
                default n
                if BSP_USING_UART3
                    choice
                        prompt "Select TX/RX Pin of USART3"
                        default BSP_USING_UART3_PIN_NO_RMP
                        config BSP_USING_UART3_PIN_NO_RMP
                            bool "USART3:Default (TX:PB10, RX:PB11)"
                        config BSP_USING_UART3_PIN_PART_RMP
                            bool "USART3:Partial remap (TX:PC10, RX:PC11)"
                        config BSP_USING_UART3_PIN_ALL_RMP
                            bool "USART3:Full remap (TX:PD8, RX:PD9)"
                    endchoice
                endif

            config BSP_USING_UART4
                bool "Enable UART4"
                default n
                if BSP_USING_UART4
                    choice
                        prompt "Select TX/RX Pin of UART4"
                        default BSP_USING_UART4_PIN_NORMP
                        config BSP_USING_UART4_PIN_NORMP
                            bool "UART4(Default):TX:PC10, RX:PC11"
                        config BSP_USING_UART4_PIN_RMP1
                            bool "UART4:TX:PB2, RX:PE7"
                        config BSP_USING_UART4_PIN_RMP2
                            bool "UART4:TX:PA13, RX:PA14"
                        config BSP_USING_UART4_PIN_RMP3
                            bool "UART4:TX:PD0, RX:PD1"
                    endchoice
                endif

            config BSP_USING_UART5
                bool "Enable UART5"
                default n
                if BSP_USING_UART5
                    choice
                        prompt "Select TX/RX Pin of UART5"
                        default BSP_USING_UART5_PIN_NORMP
                        config BSP_USING_UART5_PIN_NORMP
                            bool "UART5(Default):TX:PC12, RX:PD2"
                        config BSP_USING_UART5_PIN_RMP1
                            bool "UART5:TX:PB13, RX:PB14"
                        config BSP_USING_UART5_PIN_RMP2
                            bool "UART5:TX:PE8, RX:PE9"
                        config BSP_USING_UART5_PIN_RMP3
                            bool "UART5:TX:PB8, RX:PB9"
                    endchoice
                endif

            config BSP_USING_UART6
                bool "Enable UART6"
                default n
                if BSP_USING_UART6
                    choice
                        prompt "Select TX/RX Pin of UART6"
                        default BSP_USING_UART6_PIN_NORMP
                        config BSP_USING_UART6_PIN_NORMP
                            bool "UART6(Default):TX:PE2, RX:PE3"
                        config BSP_USING_UART6_PIN_RMP2
                            bool "UART6:TX:PC0, RX:PC1"
                        config BSP_USING_UART6_PIN_RMP3
                            bool "UART6:TX:PB0, RX:PB1"
                    endchoice
                endif

            config BSP_USING_UART7
                bool "Enable UART7"
                default n
                if BSP_USING_UART7
                    choice
                        prompt "Select TX/RX Pin of UART7"
                        default BSP_USING_UART7_PIN_NORMP
                        config BSP_USING_UART7_PIN_NORMP
                            bool "UART7(Default):TX:PC4, RX:PC5"
                        config BSP_USING_UART7_PIN_RMP1
                            bool "UART7:TX:PC2, RX:PC3"
                        config BSP_USING_UART7_PIN_RMP3
                            bool "UART7:TX:PG0, RX:PG1"
                    endchoice
                endif
        endif

    menuconfig BSP_USING_PWM
        bool "Enable PWM"
        default n
        select RT_USING_PWM
        if BSP_USING_PWM
        menuconfig BSP_USING_TIM1PWM
            bool "Enable timer1 output PWM"
            default n
            if BSP_USING_TIM1PWM
                config BSP_USING_TIM1_CH1
                    bool "Enable TIM1 channel1 PWM"
                    default n
                config BSP_USING_TIM1_CH2
                    bool "Enable TIM1 channel2 PWM"
                    default n
                config BSP_USING_TIM1_CH3
                    bool "Enable TIM1 channel3 PWM"
                    default n
                config BSP_USING_TIM1_CH4
                    bool "Enable TIM1 channel4 PWM"
                    default n
            endif
        menuconfig BSP_USING_TIM2PWM
            bool "Enable timer2 output PWM"
            default n
            if BSP_USING_TIM2PWM
                config BSP_USING_TIM2_CH1
                    bool "Enable TIM2 channel1 PWM"
                    default n
                config BSP_USING_TIM2_CH2
                    bool "Enable TIM2 channel2 PWM"
                    default n
                config BSP_USING_TIM2_CH3
                    bool "Enable TIM2 channel3 PWM"
                    default n
                config BSP_USING_TIM2_CH4
                    bool "Enable TIM2 channel4 PWM"
                    default n
            endif
        menuconfig BSP_USING_TIM3PWM
            bool "Enable timer3 output PWM"
            default n
            if BSP_USING_TIM3PWM
                config BSP_USING_TIM3_CH1
                    bool "Enable TIM3 channel1 PWM"
                    default n
                config BSP_USING_TIM3_CH2
                    bool "Enable TIM3 channel2 PWM"
                    default n
                config BSP_USING_TIM3_CH3
                    bool "Enable TIM3 channel3 PWM"
                    default n
                config BSP_USING_TIM3_CH4
                    bool "Enable TIM3 channel4 PWM"
                    default n
            endif
        menuconfig BSP_USING_TIM4PWM
            bool "Enable timer4 output PWM"
            default n
            if BSP_USING_TIM4PWM
                config BSP_USING_TIM4_CH1
                    bool "Enable TIM4 channel1 PWM"
                    default n
                config BSP_USING_TIM4_CH2
                    bool "Enable TIM4 channel2 PWM"
                    default n
                config BSP_USING_TIM4_CH3
                    bool "Enable TIM4 channel3 PWM"
                    default n
                config BSP_USING_TIM4_CH4
                    bool "Enable TIM4 channel4 PWM"
                    default n
            endif
        menuconfig BSP_USING_TIM5PWM
            bool "Enable timer5 output PWM"
            default n
            if BSP_USING_TIM5PWM
                config BSP_USING_TIM5_CH1
                    bool "Enable TIM5 channel1 PWM"
                    default n
                config BSP_USING_TIM5_CH2
                    bool "Enable TIM5 channel2 PWM"
                    default n
                config BSP_USING_TIM5_CH3
                    bool "Enable TIM5 channel3 PWM"
                    default n
                config BSP_USING_TIM5_CH4
                    bool "Enable TIM5 channel4 PWM"
                    default n
            endif
        menuconfig BSP_USING_TIM8PWM
            bool "Enable timer8 output PWM"
            default n
            if BSP_USING_TIM8PWM
                config BSP_USING_TIM8_CH1
                    bool "Enable TIM8 channel1 PWM"
                    default n
                config BSP_USING_TIM8_CH2
                    bool "Enable TIM8 channel2 PWM"
                    default n
                config BSP_USING_TIM8_CH3
                    bool "Enable TIM8 channel3 PWM"
                    default n
                config BSP_USING_TIM8_CH4
                    bool "Enable TIM8 channel4 PWM"
                    default n
            endif
        endif

    menuconfig BSP_USING_HWTIMER
        bool "Enable HWTIMER"
        default n
        select RT_USING_HWTIMER
        if BSP_USING_HWTIMER
        config BSP_USING_HWTIM3
            bool "Enable hardware timer3"
            default n
        config BSP_USING_HWTIM4
            bool "Enable hardware timer4"
            default n
        config BSP_USING_HWTIM5
            bool "Enable hardware timer5"
            default n
        config BSP_USING_HWTIM6
            bool "Enable hardware timer6"
            default n
        config BSP_USING_HWTIM7
            bool "Enable hardware timer7"
            default n
        endif

    menuconfig BSP_USING_SPI
        bool "Enable SPI BUS"
        default n
        select RT_USING_SPI
        if BSP_USING_SPI
            config BSP_USING_SPI1
                bool "Enable SPI1 BUS"
                default n

            config BSP_USING_SPI2
                bool "Enable SPI2 BUS"
                default n
        endif

    menuconfig BSP_USING_I2C1
        bool "Enable I2C1 BUS (software simulation)"
        default n
        select RT_USING_I2C
        select RT_USING_I2C_BITOPS
        select RT_USING_PIN
        if BSP_USING_I2C1
            config BSP_I2C1_SCL_PIN
                int "I2C1 scl pin number"
                range 1 N32G45X_PIN_NUMBERS
                default 29
            config BSP_I2C1_SDA_PIN
                int "I2C1 sda pin number"
                range 1 N32G45X_PIN_NUMBERS
                default 30
        endif

    menuconfig BSP_USING_ADC
        bool "Enable ADC"
        default n
        select RT_USING_ADC
        if BSP_USING_ADC
            config BSP_USING_ADC1
                bool "Enable ADC1"
                default n
            config BSP_USING_ADC2
                bool "Enable ADC2"
                default n
        endif

    menuconfig BSP_USING_CAN
        bool "Enable CAN"
        default n
        select RT_USING_CAN
        if BSP_USING_CAN
            config BSP_USING_CAN1
                bool "using CAN1"
                default n
            config BSP_USING_CAN2
                bool "using CAN2"
                default n
        endif

    menuconfig BSP_USING_SDIO
        bool "Enable SDIO"
        default n
        select RT_USING_SDIO
        if BSP_USING_SDIO
            config BSP_USING_SDIO1
                bool "Enable SDIO1"
                default n
        endif
endmenu

endmenu
```

## bsp/novosns/ns800/ns800rt7p65-nssinepad/Kconfig
```kconfig
mainmenu "RT-Thread Configuration"

BSP_DIR := .

RTT_DIR := ../../../..
LIB_DIR := ../libraries/HAL_Drivers
PKGS_DIR := packages

config SOC_SERIES_NS800RT7
    bool
    default y

config SOC_NS800RT7P6XX
    bool
    select SOC_SERIES_NS800RT7
    select RT_USING_COMPONENTS_INIT
    select RT_USING_USER_MAIN
    default y

config BOARD_NS800RT7P65X
    bool
    depends on SOC_NS800RT7P6XX
    default y

source "$(RTT_DIR)/Kconfig"
osource "$PKGS_DIR/Kconfig"
rsource "board/Kconfig"
rsource "$(LIB_DIR)/drivers/Kconfig"
```
