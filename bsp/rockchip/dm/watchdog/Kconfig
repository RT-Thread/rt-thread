## bsp/rockchip/dm/watchdog/Kconfig
```kconfig
config RT_WDT_RK8XX
    bool "Rockchip RK806 watchdog"
    depends on RT_MFD_RK8XX
```

## bsp/rockchip/rk2108/Kconfig
```kconfig
mainmenu "RT-Thread Project Configuration"

BSP_DIR := .

RTT_DIR := ../../..

source "$(RTT_DIR)/Kconfig"

config BSP_RK2108
    bool
    select ARCH_ARM
    select ARCH_ARM_CORTEX_M
    select ARCH_ARM_CORTEX_M4
    select RT_USING_COMPONENTS_INIT
    select RT_USING_USER_MAIN
    default y

source "$(BSP_DIR)/board/Kconfig"
source "$(BSP_DIR)/driver/Kconfig"
```

## bsp/rockchip/rk2108/board/Kconfig
```kconfig
menu "RT-Thread board config"

config RT_BOARD_NAME
    string "the board name you use"
    default "rk2108_evb"

config RT_RUN_MEM_BASE
    hex "the memory base address you use"
    default 0x20000000
    help
        Set RK2108 SRAM MEM BASE.

config RT_RUN_MEM_SIZE
    hex "the memory size you use"
    default 0x00100000
    help
        Set RK2108 SRAM MEM SIZE

source "$(BSP_DIR)/board/$RT_BOARD_NAME/Kconfig"

endmenu
```

## bsp/rockchip/rk2108/board/rk2108_evb/Kconfig
```kconfig
config M4_JTAG_ENABLE
    bool "Enable Cortex M4 JTAG"
    default n
    select RT_USING_UART2
    help
        you need set RT_CONSOLE_DEVICE_NAME=uart2 at the same time
```

## bsp/rockchip/rk2108/driver/Kconfig
```kconfig
source "$(BSP_DIR)/../common/drivers/Kconfig"

menu "RT-Thread rockchip RK2108 drivers"

config RT_USING_CRU
    bool "Enable CRU"
    default n

menu "Enable UART"
    config RT_USING_UART
        bool "Enable UART"
        default y

    if RT_USING_UART
    config RT_USING_UART0
        bool "Enable UART0"
        default n

    config RT_USING_UART1
        bool "Enable UART1"
        default n

    config RT_USING_UART2
        bool "Enable UART2"
        default y
    endif
endmenu

config RT_USING_SYSTICK
     bool "Enable SYSTICK"
     default n

endmenu
```

## bsp/rockchip/rk3300/Kconfig
```kconfig
mainmenu "RT-Thread Project Configuration"

BSP_DIR := .

RTT_DIR := ../../..

PKGS_DIR := packages

SOC_DM_DIR := $BSP_DIR/../dm/

source "$(SOC_DM_DIR)/Kconfig"
source "$(RTT_DIR)/Kconfig"
osource "$PKGS_DIR/Kconfig"

config SOC_RK3300
    bool
    select ARCH_ARMV8
    select ARCH_CPU_64BIT
    select ARCH_ARM_MMU
    select RT_USING_CACHE
    select RT_USING_COMPONENTS_INIT
    select RT_USING_USER_MAIN
    select RT_USING_STDC_ATOMIC
    default y

config RT_USING_AMBA_BUS
    bool
    default y
```

## bsp/rockchip/rk3500/Kconfig
```kconfig
mainmenu "RT-Thread Project Configuration"

config BSP_DIR
    string
    option env="BSP_ROOT"
    default "."

config RTT_DIR
    string
    option env="RTT_ROOT"
    default "../../.."

config PKGS_DIR
    string
    option env="PKGS_ROOT"
    default "packages"

source "$RTT_DIR/Kconfig"
source "$PKGS_DIR/Kconfig"
source "$BSP_DIR/driver/Kconfig"

config SOC_RK3568
    bool
    select ARCH_ARMV8
    select ARCH_CPU_64BIT
    select RT_USING_CACHE
    select RT_USING_COMPONENTS_INIT
    select RT_USING_USER_MAIN
    select ARCH_ARM_BOOTWITH_FLUSH_CACHE
    default y
```

## bsp/rockchip/rk3500/driver/reset/Kconfig
```kconfig
config RT_USING_RESET
    bool "Using Reset Controller support"
    depends on RT_USING_DM
    select RT_USING_OFW
    default n
```

## bsp/rockchip/rk3566/driver/Kconfig
```kconfig
menu "RT-Thread rockchip RK3500 drivers"

source "$BSP_DIR/driver/clk/Kconfig"
source "$BSP_DIR/driver/uart8250/Kconfig"
source "$BSP_DIR/driver/hwtimer/Kconfig"
endmenu
```

## bsp/rockchip/rk3566/driver/clk/Kconfig
```kconfig
menuconfig RT_CLK_ROCKCHIP
    bool "Rockchip clock controller common"
    select RT_USING_OFW
    select RT_USING_RESET
    default n

config RT_CLK_ROCKCHIP_RK3568
    bool "Rockchip RK3568 clock controller support"
    depends on RT_CLK_ROCKCHIP
    default n

config RT_CLK_ROCKCHIP_RK3588
    bool "Rockchip RK3588 clock controller support"
    depends on RT_CLK_ROCKCHIP
    default n
```

## bsp/rockchip/rk3566/driver/hwtimer/Kconfig
```kconfig
config RT_HWTIMER_ROCKCHIP
    bool "RockChip Timer"
    depends on RT_USING_DM
    depends on RT_USING_HWTIMER
    default n
```

## bsp/rockchip/rk3568/Kconfig
```kconfig
mainmenu "RT-Thread Project Configuration"

BSP_DIR := .

RTT_DIR := ../../..

PKGS_DIR := packages

source "$(RTT_DIR)/Kconfig"
osource "$PKGS_DIR/Kconfig"

config SOC_RK3568
    bool
    select ARCH_ARMV8
    select ARCH_CPU_64BIT
    select RT_USING_CACHE
    select RT_USING_COMPONENTS_INIT
    select RT_USING_USER_MAIN
    select ARCH_ARM_BOOTWITH_FLUSH_CACHE
    default y

source "$(BSP_DIR)/driver/Kconfig"
```

## bsp/rockchip/rk3568/driver/Kconfig
```kconfig
menu "Hardware Drivers Config"

    menuconfig BSP_USING_UART
        bool "Using UART"
        select RT_USING_SERIAL
        default y

        if BSP_USING_UART
            config RT_USING_UART0
                bool "Enable UART 0"
                default n

            config RT_USING_UART1
                bool "Enable UART 1"
                default n

            config RT_USING_UART2
                bool "Enable UART 2"
                default y

            config RT_USING_UART3
                bool "Enable UART 3"
                default n

            config RT_USING_UART4
                bool "Enable UART 4"
                default n

            config RT_USING_UART5
                bool "Enable UART 5"
                default n

            config RT_USING_UART6
                bool "Enable UART 6"
                default n

            config RT_USING_UART7
                bool "Enable UART 7"
                default n

            config RT_USING_UART8
                bool "Enable UART 8"
                default n

            config RT_USING_UART9
                bool "Enable UART 9"
                default n
        endif

    config BSP_USING_GIC
        bool
        default y

    config BSP_USING_GICV3
        bool
        default y

    select ARCH_ARM_CORTEX_A55
endmenu
```

## bsp/rv32m1_vega/ri5cy/Kconfig
```kconfig
mainmenu "RT-Thread Project Configuration"

BSP_DIR := .

RTT_DIR := ../../..

PKGS_DIR := packages

source "$(RTT_DIR)/Kconfig"
osource "$PKGS_DIR/Kconfig"

config SOC_VEGA_RI5CY
    bool
    select ARCH_RISCV

config BOARD_X_FRDM_VEGA
    bool
    select SOC_VEGA_RI5CY
    select RT_USING_COMPONENTS_INIT
    select RT_USING_USER_MAIN
    default y

rsource "driver/Kconfig"
```

## bsp/rv32m1_vega/ri5cy/driver/Kconfig
```kconfig
config BSP_USING_UART0
    bool "Enable UART0 (PTC7/PTC8)"
    default y
config BSP_USING_UART1
    bool "Enable UART1 (PTA25/PTA26)"
    default y
```

## bsp/simulator/Kconfig
```kconfig
mainmenu "RT-Thread Configuration"

BSP_DIR := .

RTT_DIR := ../..

PKGS_DIR := packages

source "$(RTT_DIR)/Kconfig"
osource "$PKGS_DIR/Kconfig"

config SOC_SIMULATOR
    bool
    select RT_USING_COMPONENTS_INIT
    select RT_USING_USER_MAIN
    default y

menu "Peripheral Drivers"

    config RT_USING_DFS_WINSHAREDIR
        bool "Enable shared file system between Windows"
        select RT_USING_POSIX_FS
        default y

    config BSP_USING_RTC
        bool "Enable RTC"
        select RT_USING_RTC
        default y

    config BSP_USING_ALARM
        bool "Enable RTC alarm"
        select RT_USING_ALARM
        depends on BSP_USING_RTC
        default n

    config BSP_USING_SOCKET
        bool "Enable BSD Socket"
        select RT_USING_POSIX_FS
        select RT_USING_POSIX_SOCKET
        default y

    config BSP_USING_LVGL
        bool "Enable LVGL for LCD"
        select PKG_USING_LVGL
        default n

    if BSP_USING_LVGL
        config BSP_USING_LVGL_DEMO
            bool "Enable LVGL demo"
            select PKG_USING_LV_MUSIC_DEMO
            default y

        config BSP_LCD_WIDTH
            int "LCD width"
            default 800

        config BSP_LCD_HEIGHT
            int "LCD height"
            default 480
    endif

endmenu
```

## bsp/smartfusion2/Kconfig
```kconfig
mainmenu "RT-Thread Configuration"

BSP_DIR := .

RTT_DIR := ../..

PKGS_DIR := packages

source "$(RTT_DIR)/Kconfig"
osource "$PKGS_DIR/Kconfig"
rsource "drivers/Kconfig"

config SOC_SF2_M2S010
    bool
    select RT_USING_COMPONENTS_INIT
    select RT_USING_USER_MAIN
    default y
```

## bsp/smartfusion2/drivers/Kconfig
```kconfig
menu "Hardware Drivers Config"

    menu "On-chip Peripheral Drivers"

        menu "UART Drivers"
            config BSP_USING_UART0
                bool "Enable MSS_UART0"
                select RT_USING_SERIAL
                default y
                help
                config MSS_UART0

            config BSP_USING_UART1
                bool "Enable MSS_UART1"
                select RT_USING_SERIAL
                default y
                help
                config MSS_UART1

            config RT_CONSOLE_DEVICE_NAME
                string "the device name for console"
                default "uart0"
        endmenu

        menu "GPIO Drivers"
            config BSP_USING_GPIO
            bool "Enable MSS_GPIO"
            select RT_USING_PIN
            default y
            help
            config MSS_GPIO
        endmenu
    endmenu

endmenu
```

## bsp/spacemit/dm/adc/Kconfig
```kconfig
config RT_ADC_SPACEMIT_PMIC
    bool "Spacemit PMIC ADC driver"
    depends on RT_USING_DM
    depends on RT_USING_ADC
    depends on RT_MFD_SPACEMIT_PMIC
    default n
```

## bsp/spacemit/dm/clk/Kconfig
```kconfig
menuconfig RT_CLK_SPACEMIT
    bool "Spacemit clock controller common"
    depends on RT_USING_OFW
    default y

config RT_CLK_SPACEMIT_K1X
    bool "Spacemit k1x clock controller support"
    depends on RT_CLK_SPACEMIT
    default n
```

## bsp/spacemit/dm/dma/Kconfig
```kconfig
config RT_DMA_MMP_PDMA
    bool "Spacemit K1X MMP PDMA"
    default n

config RT_DMA_MMP_PDMA_SUPPORT_64BIT
    bool "Support 64bit"
    depends on RT_DMA_MMP_PDMA
    default n
```

## bsp/spacemit/dm/hwcrypto/Kconfig
```kconfig
config RT_HWCRYPTO_SPACEMIT
    bool "Spacemit Crypto Engine"
    depends on RT_USING_CLK
    depends on RT_USING_RESET
    depends on RT_USING_HWCRYPTO
    depends on RT_HWCRYPTO_USING_AES
    depends on RT_HWCRYPTO_USING_AES_ECB
    depends on RT_HWCRYPTO_USING_AES_CBC
    default y

config RT_HWCRYPTO_RNG_SPACEMIT
    bool "Spacemit RNG Engine"
    depends on RT_USING_CLK
    depends on RT_USING_RESET
    depends on RT_USING_HWCRYPTO
    depends on RT_HWCRYPTO_USING_RNG
    default y
```
