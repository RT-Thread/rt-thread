## bsp/raspberry-pi/raspi3-64/driver/Kconfig
```kconfig
menu "Hardware Drivers Config"
    menu "BCM Peripheral Drivers"
        menuconfig BSP_USING_UART
            bool "Using UART"
            select RT_USING_SERIAL
            default y

            if BSP_USING_UART
                config RT_USING_UART0
                bool "Enabel UART 0"
                default y

                config RT_USING_UART1
                    bool "Enabel UART 1"
                    default n
            endif

        config BSP_USING_PIN
            bool "Using PIN"
            select RT_USING_PIN
            default y

        config BSP_USING_CORETIMER
            bool "Using core timer"
            select RT_USING_CORETIMER
            default y

        menuconfig BSP_USING_SYSTIMER
            bool "Enable SYSTIMER"
            default n

        if  BSP_USING_SYSTIMER
            config RT_USING_SYSTIMER1
                bool "Enable sys timer1"
                default n
            config RT_USING_SYSTIMER3
                bool "Enable sys timer3"
                default n
        endif

        menuconfig BSP_USING_I2C
            bool "Enable I2C"
            select RT_USING_I2C
            default n

        if BSP_USING_I2C
            config BSP_USING_I2C0
                bool "Enable I2C0"
                default n
            config BSP_USING_I2C1
                bool "Enable I2C1"
                default n
        endif

        menuconfig BSP_USING_SPI
            bool "Enable SPI"
            select RT_USING_SPI
            default n

        if BSP_USING_SPI
            config BSP_USING_SPI0_BUS
                bool "Enable SPI0 BUS"
                default n
            config BSP_USING_SPI0_DEVICE0
                bool "Enable SPI0 DEVICE0"
                select BSP_USING_SPI0_BUS
                default n
            config BSP_USING_SPI0_DEVICE1
                bool "Enable SPI0 DEVICE1"
                select BSP_USING_SPI0_BUS
                default n
        endif

        config BSP_USING_WDT
            bool "Enable WDT"
            select RT_USING_WDT
            default n

        menuconfig BSP_USING_RTC
            bool "Enable RTC"
            select RT_USING_RTC
            default n

        if BSP_USING_RTC
            config BSP_USING_ALARM
                bool "Enable Alarm"
                select RT_USING_ALARM
                default n
        endif

        menuconfig BSP_USING_SDIO
            bool "Enable SDIO"
            select RT_USING_SDIO
            default n

        if BSP_USING_SDIO
            config BSP_USING_SDIO0
                bool "Enable SDIO0"
                select RT_USING_SDIO
                default n
        endif
    endmenu

    menu "Board Peripheral Drivers"
        menuconfig BSP_USING_HDMI
            bool "Enable HDMI"
            default n

        if BSP_USING_HDMI
            config BSP_USING_HDMI_DISPLAY
                bool "HDMI DISPLAY"
                default n
        endif
    endmenu
endmenu
```

## bsp/raspberry-pi/raspi4-32/applications/testcases/Kconfig
```kconfig
menuconfig RT_USING_TESTCASE
    bool "testcase: Enable Test"
    default n
    select RT_USING_UTEST
    select RT_USING_ULOG
    select ULOG_USING_ISR_LOG

if RT_USING_TESTCASE

    source "applications/testcases/demo/Kconfig"

endif
```

## bsp/raspberry-pi/raspi4-32/driver/Kconfig
```kconfig
config BSP_SUPPORT_FPU
    bool "Using Float"
    default n

menu "Hardware Drivers Config"
    menu "BCM Peripheral Drivers"
        menuconfig BSP_USING_UART
            bool "Using UART"
            select RT_USING_SERIAL
            default y

            if BSP_USING_UART
                config RT_USING_UART0
                bool "Enabel UART 0"
                default y

                config RT_USING_UART1
                bool "Enabel UART 1"
                default n

                config RT_USING_UART3
                bool "Enabel UART 3"
                default n

                config RT_USING_UART4
                bool "Enabel UART 4"
                default n

                config RT_USING_UART5
                bool "Enabel UART 5"
                default n
            endif

        menuconfig BSP_USING_GIC
            bool "Enable GIC"
            select RT_USING_GIC
            default y
        if BSP_USING_GIC
            config BSP_USING_GIC400
                bool "Enable GIC400"
                default y
            config BSP_USING_GIC500
                bool "Enable GIC500"
                default n
        endif

        config BSP_USING_PIN
            bool "Using PIN"
            select RT_USING_PIN
            default y

        menuconfig BSP_USING_SPI
            bool "Enable SPI"
            select RT_USING_SPI
            default n

        if BSP_USING_SPI
            config BSP_USING_SPI0_BUS
                bool "Enable SPI0 BUS"
                default n
            config BSP_USING_SPI0_DEVICE0
                bool "Enable SPI0 DEVICE0"
                select BSP_USING_SPI0_BUS
                default n
            config BSP_USING_SPI0_DEVICE1
                bool "Enable SPI0 DEVICE1"
                select BSP_USING_SPI0_BUS
                default n
        endif

        menuconfig BSP_USING_I2C
            bool "Enable I2C"
            select RT_USING_I2C
            default n

        if BSP_USING_I2C
            config BSP_USING_I2C0
                bool "Enable I2C0 BUS"
                default n
            config BSP_USING_I2C1
                bool "Enable I2C1 BUS"
                default n
            config BSP_USING_I2C3
                bool "Enable I2C3 BUS"
                default n
            config BSP_USING_I2C4
                bool "Enable I2C4 BUS"
                default n
            config BSP_USING_I2C5
                bool "Enable I2C5 BUS"
                default n
            config BSP_USING_I2C6
                bool "Enable I2C6 BUS"
                default n
        endif

        config BSP_USING_CORETIMER
            bool "Using core timer"
            select RT_USING_CORETIMER
            default y

        menuconfig BSP_USING_SYSTIMER
            bool "Enable SYSTIMER"
            select BSP_USING_SYSTIMER
            default n

        if  BSP_USING_SYSTIMER
            config RT_USING_SYSTIMER1
                bool "Enable sys timer1"
                default n
            config RT_USING_SYSTIMER3
                bool "Enable sys timer3"
                default n
        endif

        config BSP_USING_WDT
            bool "Enable WDT"
            select RT_USING_WDT
            default n

        config BSP_USING_ETH
            bool "Enable ETH"
            default n

        config BSP_USING_BULETOOTH
            bool "Enable BULETOOTH"
            default n

        menuconfig BSP_USING_RTC
            bool "Enable RTC"
            select RT_USING_RTC
            default n

        if BSP_USING_RTC
            config BSP_USING_ALARM
                bool "Enable Alarm"
                select RT_USING_ALARM
                default n
        endif

        menuconfig BSP_USING_SDIO
            bool "Enable SDIO"
            select RT_USING_SDIO
            default n

        if BSP_USING_SDIO
            config BSP_USING_SDIO0
                bool "Enable SDIO0"
                select RT_USING_SDIO
                default n
        endif
    endmenu

    menu "Board Peripheral Drivers"
        menuconfig BSP_USING_LCD
            bool "Enable LCD"
            default n

        if BSP_USING_LCD
            config BSP_USING_HDMI_DISPLAY
                bool "HDMI DISPLAY"
                default n
            config BSP_USING_DSI_DISPLAY
                bool "DSI DISPLAY"
                default n
            config BSP_USING_ILI9486
                bool "ILI9486 DISPLAY"
                default n
        endif

        menuconfig BSP_USING_TOUCH
            bool "Enable Touch"
            default n

        if BSP_USING_TOUCH
            config BSP_USING_DSI_TOUCH_DEV
                bool "DSI TOUCH"
                default n
            config BSP_USING_XPT_TOUCH_DEV
                bool "XPT TOUCH"
                default n
        endif

        config USING_LCD_CONSOLE
            bool "LCD CONSOLE"
            default n
    endmenu
endmenu
```

## bsp/raspberry-pi/raspi4-64/Kconfig
```kconfig
mainmenu "RT-Thread Project Configuration"

BSP_DIR := .

RTT_DIR := ../../..

PKGS_DIR := packages

source "$(RTT_DIR)/Kconfig"
osource "$PKGS_DIR/Kconfig"

config BCM2711_SOC
    bool
    select ARCH_ARMV8
    select ARCH_ARM_MMU
    select RT_USING_CACHE
    select RT_USING_COMPONENTS_INIT
    select RT_USING_USER_MAIN
    select ARCH_CPU_64BIT
    default y

rsource "drivers/Kconfig"
```

## bsp/raspberry-pi/raspi4-64/driver/Kconfig
```kconfig
menu "Hardware Drivers Config"
    menu "BCM Peripheral Drivers"
        menuconfig BSP_USING_UART
            bool "Using UART"
            select RT_USING_SERIAL
            default y

            if BSP_USING_UART
                config RT_USING_UART0
                bool "Enable UART 0"
                default y

                config RT_USING_UART1
                bool "Enable UART 1"
                default n

                config RT_USING_UART3
                bool "Enable UART 3"
                default n

                config RT_USING_UART4
                bool "Enable UART 4"
                default n

                config RT_USING_UART5
                bool "Enable UART 5"
                default n
            endif

        config BSP_USING_GIC
            bool
            default y

            config BSP_USING_GICV2
                bool
                default y

        config BSP_USING_PIN
            bool "Using PIN"
            select RT_USING_PIN
            default y

        config BSP_USING_CORETIMER
            bool "Using core timer"
            select RT_USING_CORETIMER
            default y

        menuconfig BSP_USING_SYSTIMER
            bool "Enable SYSTIMER"
            select BSP_USING_SYSTIMER
            default n

        if  BSP_USING_SYSTIMER
            config RT_USING_SYSTIMER1
                bool "Enable sys timer1"
                default n
            config RT_USING_SYSTIMER3
                bool "Enable sys timer3"
                default n
        endif

        config BSP_USING_ETH
            bool "Enable ETH"
            default n

        config BSP_USING_WDT
            bool "Enable WDT"
            select RT_USING_WDT
            default n

        menuconfig BSP_USING_RTC
            bool "Enable RTC"
            select RT_USING_RTC
            default n

        if BSP_USING_RTC
            config BSP_USING_ALARM
                bool "Enable Alarm"
                select RT_USING_ALARM
                default n
        endif

        menuconfig BSP_USING_SDIO
            bool "Enable SDIO"
            select RT_USING_SDIO
            default n

        if BSP_USING_SDIO
            config BSP_USING_SDIO0
                bool "Enable SDIO0"
                select RT_USING_SDIO
                default n
        endif
    endmenu

    menu "Board Peripheral Drivers"
        menuconfig BSP_USING_HDMI
            bool "Enable HDMI"
            default n

        if BSP_USING_HDMI
            config BSP_USING_HDMI_DISPLAY
                bool "HDMI DISPLAY"
                default n
        endif
    endmenu
endmenu
```

## bsp/raspberry-pi/raspi4-64/drivers/Kconfig
```kconfig
config BSP_SUPPORT_FPU
    bool "Using Float"
    default n

menuconfig BSP_USING_VM_MODE
    bool "Enable VM mode"
    default n

menu "Hardware Drivers Config"
    menu "BCM Peripheral Drivers"
        menuconfig BSP_USING_UART
            bool "Using UART"
            select RT_USING_SERIAL
            default y

            if BSP_USING_UART
                config RT_USING_UART0
                bool "Enable UART 0"
                default y

                config RT_USING_UART1
                bool "Enable UART 1"
                default n

                config RT_USING_UART3
                bool "Enable UART 3"
                default n

                config RT_USING_UART4
                bool "Enable UART 4"
                default n

                config RT_USING_UART5
                bool "Enable UART 5"
                default n
            endif
            
        menuconfig BSP_USING_GIC
            bool "Enable GIC"
            select RT_USING_GIC
            default y
        if BSP_USING_GIC
            config BSP_USING_GICV2
                bool "Enable GIC400(GICV2)"
                default y
            config BSP_USING_GICV3
                bool "Enable GIC500(GICV3)"
                default n
        endif

        config BSP_USING_PIN
            bool "Using PIN"
            select RT_USING_PIN
            default y

            menuconfig BSP_USING_SPI
            bool "Enable SPI"
            select RT_USING_SPI
            default n
        
        if BSP_USING_SPI   
            config BSP_USING_SPI0_BUS
                bool "Enable SPI0 BUS"
                default n
            config BSP_USING_SPI0_DEVICE0
                bool "Enable SPI0 DEVICE0"
                select BSP_USING_SPI0_BUS
                default n
            config BSP_USING_SPI0_DEVICE1
                bool "Enable SPI0 DEVICE1"
                select BSP_USING_SPI0_BUS
                default n
        endif

        config BSP_USING_CORETIMER
            bool "Using core timer"
            select RT_USING_CORETIMER
            default y

        menuconfig BSP_USING_SYSTIMER
            bool "Enable SYSTIMER"
            default n

        if  BSP_USING_SYSTIMER
            config RT_USING_SYSTIMER1
                bool "Enable sys timer1"
                default n
            config RT_USING_SYSTIMER3
                bool "Enable sys timer3"
                default n
        endif

        config BSP_USING_WDT
            bool "Enable WDT"
            select RT_USING_WDT
            default n

        menuconfig BSP_USING_RTC
            bool "Enable RTC"
            select RT_USING_RTC
            default n

        if BSP_USING_RTC
            config BSP_USING_ALARM
                bool "Enable Alarm"
                select RT_USING_ALARM
                default n
        endif

        menuconfig BSP_USING_SDIO
            bool "Enable SDIO"
            select RT_USING_SDIO
            default n

        if BSP_USING_SDIO
            config BSP_USING_SDIO0
                bool "Enable SDIO0"
                select RT_USING_SDIO
                default n
        endif
    endmenu

    menu "Board Peripheral Drivers"
        menuconfig BSP_USING_HDMI
            bool "Enable HDMI"
            default n

        if BSP_USING_HDMI
            config BSP_USING_HDMI_DISPLAY
                bool "HDMI DISPLAY"
                default n
        endif

        menuconfig BSP_USING_TOUCH
            bool "Enable Touch"
            default n
    endmenu
endmenu
```

## bsp/raspberry-pico/Kconfig
```kconfig
mainmenu "RT-Thread Configuration"

BSP_DIR := .

RTT_DIR := ../..

PKGS_DIR := packages

config SOC_RP2040
    bool
    select ARCH_ARM_CORTEX_M0
    select RT_USING_COMPONENTS_INIT
    select RT_USING_USER_MAIN
    select SOC_SERIES_RP2040_PICO
    select PKG_USING_RASPBERRYPI_PICO_SDK
    default y

source "$(RTT_DIR)/Kconfig"
osource "$PKGS_DIR/Kconfig"
rsource "board/Kconfig"
```

## bsp/raspberry-pico/RP2350/Kconfig
```kconfig
mainmenu "RT-Thread Configuration"

BSP_DIR := .

RTT_DIR := ../../..

PKGS_DIR := packages

config SOC_RP2350
    bool
    select ARCH_ARM_CORTEX_M33
    select ARCH_ARM_CORTEX_SECURE
    select RT_USING_COMPONENTS_INIT
    select RT_USING_USER_MAIN
    select SOC_SERIES_RP2350_PICO
    select PKG_USING_RASPBERRYPI_PICO_RP2350_SDK
    default y

source "$(RTT_DIR)/Kconfig"
osource "$PKGS_DIR/Kconfig"
rsource "board/Kconfig"
```
