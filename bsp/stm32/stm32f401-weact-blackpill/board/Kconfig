## bsp/stm32/stm32f401-weact-blackpill/board/Kconfig
```kconfig
menu "Hardware Drivers Config"

menu "Onboard Peripheral Drivers"

    config BSP_USING_ARDUINO
        bool "Compatible with Arduino Ecosystem (RTduino)"
        select PKG_USING_RTDUINO
        select BSP_USING_STLINK_TO_USART
        select BSP_USING_UART2
        select BSP_USING_GPIO
        select BSP_USING_ADC
        select BSP_USING_ADC1
        select BSP_USING_PWM
        select BSP_USING_PWM1
        select BSP_USING_PWM1_CH1
        select BSP_USING_PWM1_CH2
        select BSP_USING_PWM1_CH3
        select BSP_USING_PWM4
        select BSP_USING_PWM4_CH1
        select BSP_USING_PWM4_CH2
        select BSP_USING_PWM4_CH3
        select BSP_USING_PWM4_CH4
        select RT_USING_I2C
        select RT_USING_SOFT_I2C
        select RT_USING_SOFT_I2C1
        select RTDUINO_USING_WIRE
        imply RTDUINO_USING_SERVO
        default n

endmenu

menu "On-chip Peripheral Drivers"

    config BSP_USING_GPIO
        bool "Enable GPIO"
        select RT_USING_PIN
        default y

    menuconfig BSP_USING_UART
        bool "Enable UART"
        default y
        select RT_USING_SERIAL
        if BSP_USING_UART
            config BSP_USING_UART1
                bool "Enable UART1"
                default y

            config BSP_UART1_RX_USING_DMA
                bool "Enable UART1 RX DMA"
                depends on BSP_USING_UART1 && RT_SERIAL_USING_DMA
                default n

            config BSP_USING_UART2
                bool "Enable UART2"
                default n

            config BSP_UART2_RX_USING_DMA
                bool "Enable UART2 RX DMA"
                depends on BSP_USING_UART2 && RT_SERIAL_USING_DMA
                default n
        endif
    
    menuconfig BSP_USING_ADC
        bool "Enable ADC"
        default n
        select RT_USING_ADC
        if BSP_USING_ADC
            config BSP_USING_ADC1
                bool "Enable ADC1"
                default n
        endif

    menuconfig BSP_USING_PWM
        bool "Enable PWM"
        default n
        select RT_USING_PWM
        if BSP_USING_PWM
        menuconfig BSP_USING_PWM1
            bool "Enable timer1 output PWM"
            default n
            if BSP_USING_PWM1
                config BSP_USING_PWM1_CH1
                    bool "Enable PWM1 channel1"
                    default n
                config BSP_USING_PWM1_CH2
                    bool "Enable PWM1 channel2"
                    default n
                config BSP_USING_PWM1_CH3
                    bool "Enable PWM1 channel3"
                    default n
            endif

        menuconfig BSP_USING_PWM4
            bool "Enable timer4 output PWM"
            default n
            if BSP_USING_PWM4
                config BSP_USING_PWM4_CH1
                    bool "Enable PWM4 channel1"
                    default n
                config BSP_USING_PWM4_CH2
                    bool "Enable PWM4 channel2"
                    default n
                config BSP_USING_PWM4_CH3
                    bool "Enable PWM4 channel3"
                    default n
                config BSP_USING_PWM4_CH4
                    bool "Enable PWM4 channel4"
                    default n
            endif

        endif

    config RT_USING_I2C
        bool
        default n
        if RT_USING_I2C
            config RT_USING_SOFT_I2C
                bool "Enable software I2C BUS"
                default n
                if RT_USING_SOFT_I2C
                    menuconfig RT_USING_SOFT_I2C1
                        bool "Enable I2C0 Bus (software simulation)"
                        default n
                        if RT_USING_SOFT_I2C1
                            comment "Please refer to the 'bsp_io.h' file to configure the pins"
                            config RT_SOFT_I2C1_SCL_PIN
                                int "i2c1 scl pin number"
                                default 47
                            config RT_SOFT_I2C1_SDA_PIN
                                int "i2c1 sda pin number"                                
                                default 46
                            config RT_SOFT_I2C1_BUS_NAME
                                string "Bus name"
                                default "i2c1"
                            config RT_SOFT_I2C1_TIMING_DELAY
                                int "Timing delay (us)"
                                range 0 32767
                                default 10
                            config RT_SOFT_I2C1_TIMING_TIMEOUT
                                int "Timing timeout (tick)"
                                range 0 32767
                                default 10
                        endif
                endif
        endif

    source "$(BSP_DIR)/../libraries/HAL_Drivers/drivers/Kconfig"

endmenu

menu "Board extended module Drivers"

endmenu

endmenu
```

## bsp/stm32/stm32f405zg-mini-template/board/Kconfig
```kconfig
menu "Hardware Drivers Config"

menu "Onboard Peripheral Drivers"

    config BSP_USING_SPI_FLASH
        bool "Enable SPI FLASH (W25Q64 spi2)"
        select BSP_USING_SPI
        select BSP_USING_SPI2
        select RT_USING_SFUD
        select RT_SFUD_USING_SFDP
        default n

    config BSP_USING_EEPROM
        bool "Enable I2C EEPROM (i2c1)"
        select BSP_USING_I2C
        select BSP_USING_I2C1
        default n

    config BSP_USING_RGB
        bool "Enable RGB LED (timer10/11/13 channel2)"
        select RT_USING_PWM
        select BSP_USING_PWM
        select BSP_USING_PWM10
        select BSP_USING_PWM10_CH1
        select BSP_USING_PWM11
        select BSP_USING_PWM11_CH1
        select BSP_USING_PWM13
        select BSP_USING_PWM13_CH1
        default n
endmenu

menu "On-chip Peripheral Drivers"

    config BSP_USING_GPIO
        bool "Enable GPIO"
        select RT_USING_PIN
        default y

    menuconfig BSP_USING_UART
        bool "Enable UART"
        default y
        select RT_USING_SERIAL
        if BSP_USING_UART
            config BSP_USING_UART1
                bool "Enable UART1"
                default y
        endif

    menuconfig BSP_USING_SPI
        bool "Enable SPI BUS"
        default n
        select RT_USING_SPI
        if BSP_USING_SPI
            config BSP_USING_SPI2
                bool "Enable SPI2 BUS"
                default n
        endif

    menuconfig BSP_USING_I2C
        bool "Enable I2C BUS"
        default n
        select RT_USING_I2C
        if BSP_USING_I2C
            config BSP_USING_I2C1
                bool "Enable I2C1 BUS"
                default n

            config BSP_USING_I2C2
                bool "Enable I2C2 BUS"
                default n
        endif

    menuconfig BSP_USING_TIM
        bool "Enable timer"
        default n
        select RT_USING_HWTIMER
        if BSP_USING_TIM
            config BSP_USING_TIM6
                bool "Enable TIM6"
                default n
        endif

    menuconfig BSP_USING_PWM
        bool "Enable PWM"
        default n
        select RT_USING_PWM
        if BSP_USING_PWM
        menuconfig BSP_USING_PWM10
            bool "Enable timer10 output PWM"
            default n
            if BSP_USING_PWM10
                config BSP_USING_PWM10_CH1
                    bool "Enable PWM10 channel1"
                    default n
            endif

        menuconfig BSP_USING_PWM11
            bool "Enable timer11 output PWM"
            default n
            if BSP_USING_PWM11
                config BSP_USING_PWM11_CH1
                    bool "Enable PWM11 channel1"
                    default n
            endif

        menuconfig BSP_USING_PWM13
            bool "Enable timer13 output PWM"
            default n
            if BSP_USING_PWM13
                config BSP_USING_PWM13_CH1
                    bool "Enable PWM13 channel1"
                    default n
            endif
        endif

    source "$(BSP_DIR)/../libraries/HAL_Drivers/drivers/Kconfig"

endmenu

menu "Board extended module Drivers"

endmenu

endmenu
```

## bsp/stm32/stm32f407-armfly-v5/board/Kconfig
```kconfig
menu "Hardware Drivers Config"

menu "Onboard Peripheral Drivers"

    config BSP_USING_RS232_TO_USART
        bool "Enable RS232 TO USART (uart1)"
        select BSP_USING_UART
        select BSP_USING_UART1
        default y

    config BSP_USING_SPI_FLASH
        bool "Enable SPI FLASH (W25Q64 spi3)"
        select BSP_USING_SPI
        select BSP_USING_SPI3
        select RT_USING_SFUD
        select RT_SFUD_USING_SFDP
        default n

    config BSP_USING_SDCARD
        bool "Enable SDCARD (sdio)"
        select BSP_USING_SDIO
        select RT_USING_DFS
        select RT_USING_DFS_ELMFAT
        default n

    config BSP_USING_MPU6050
        bool "Enable MPU6050(swi2c2)"
        select RT_USING_I2C
        select BSP_USING_SOFT_I2C
        select BSP_USING_SOFT_I2C2
        select PKG_USING_MPU6XXX
        select PKG_USING_MPU6XXX_SAMPLE
        select PKG_USING_MPU6XXX_LATEST_VERSION
        default n

    config RT_SOFT_I2C2_HAS_PIN_DEFAULT
        bool
        default y if RT_USING_SOFT_I2C2

    config RT_SOFT_I2C2_SCL_PIN_DEFAULT
        int
        default 116 if RT_USING_SOFT_I2C2

    config RT_SOFT_I2C2_SDA_PIN_DEFAULT
        int
        default 117 if RT_USING_SOFT_I2C2

endmenu

menu "On-chip Peripheral Drivers"

    config BSP_USING_GPIO
        bool "Enable GPIO"
        select RT_USING_PIN
        default y

    menuconfig BSP_USING_UART
        bool "Enable UART"
        default y
        select RT_USING_SERIAL
        if BSP_USING_UART
            config BSP_STM32_UART_V1_TX_TIMEOUT
                int "UART TX timeout"
                default 2000
                depends on RT_USING_SERIAL_V1
                
            menuconfig BSP_USING_UART1
                bool "Enable UART1"
                default y
                if BSP_USING_UART1
                    config BSP_UART1_RX_USING_DMA
                        bool "Enable UART1 RX DMA"
                        depends on BSP_USING_UART1 && RT_SERIAL_USING_DMA
                        default n

                    config BSP_UART1_TX_USING_DMA
                        bool "Enable UART1 TX DMA"
                        depends on BSP_USING_UART1 && RT_SERIAL_USING_DMA
                        default n

                    config BSP_UART1_RX_BUFSIZE
                        int "Set UART1 RX buffer size"
                        range 64 65535
                        depends on RT_USING_SERIAL_V2
                        default 256

                    config BSP_UART1_TX_BUFSIZE
                        int "Set UART1 TX buffer size"
                        range 0 65535
                        depends on RT_USING_SERIAL_V2
                        default 0

                    config BSP_UART1_DMA_PING_BUFSIZE
                        int "Set UART1 RX DMA ping-pong buffer size"
                        range 32 65535
                        depends on RT_USING_SERIAL_V2 && BSP_UART1_RX_USING_DMA
                        default 64    
                endif

            menuconfig BSP_USING_UART2
                bool "Enable UART2"
                default y
                if BSP_USING_UART2
                    config BSP_UART2_RX_USING_DMA
                        bool "Enable UART2 RX DMA"
                        depends on BSP_USING_UART2 && RT_SERIAL_USING_DMA
                        default n

                    config BSP_UART2_TX_USING_DMA
                        bool "Enable UART2 TX DMA"
                        depends on BSP_USING_UART2 && RT_SERIAL_USING_DMA
                        default n

                    config BSP_UART2_RX_BUFSIZE
                        int "Set UART2 RX buffer size"
                        range 64 65535
                        depends on RT_USING_SERIAL_V2
                        default 256

                    config BSP_UART2_TX_BUFSIZE
                        int "Set UART2 TX buffer size"
                        range 0 65535
                        depends on RT_USING_SERIAL_V2
                        default 0

                    config BSP_UART2_DMA_PING_BUFSIZE
                        int "Set UART2 RX DMA ping-pong buffer size"
                        range 32 65535
                        depends on RT_USING_SERIAL_V2 && BSP_UART2_RX_USING_DMA
                        default 64                        
                endif

        endif

    config BSP_USING_ON_CHIP_FLASH
        bool "Enable on-chip FLASH"
        default n

    menuconfig BSP_USING_SPI
        bool "Enable SPI BUS"
        default n
        select RT_USING_SPI
        if BSP_USING_SPI
            config BSP_USING_SPI3
                bool "Enable SPI3 BUS"
                default n

            config BSP_SPI3_TX_USING_DMA
                bool "Enable SPI3 TX DMA"
                depends on BSP_USING_SPI3
                default n

            config BSP_SPI3_RX_USING_DMA
                bool "Enable SPI3 RX DMA"
                depends on BSP_USING_SPI3
                select BSP_SPI3_TX_USING_DMA
                default n
        endif

    menuconfig BSP_USING_SOFT_I2C
        bool "Enable software I2C (swi2c)"
        default n
        select RT_USING_I2C
        select RT_USING_SOFT_I2C
        if BSP_USING_SOFT_I2C
        menuconfig BSP_USING_SOFT_I2C2
            bool "Enable software I2C2 Bus (swi2c2)"
            default n
            select RT_USING_SOFT_I2C2
            if BSP_USING_SOFT_I2C2
                config RT_SOFT_I2C2_SCL_PIN
                    int "swi2c2 SCL pin number"
                    default 116
                config RT_SOFT_I2C2_SDA_PIN
                    int "swi2c2 SDA pin number"
                    default 117
            endif
        endif
    menuconfig BSP_USING_TIM
        bool "Enable timer"
        default n
        select RT_USING_CLOCK_TIME
        if BSP_USING_TIM
            config BSP_USING_TIM11
                bool "Enable TIM11"
                default n

            config BSP_USING_TIM13
                bool "Enable TIM13"
                default n

            config BSP_USING_TIM14
                bool "Enable TIM14"
                default n
        endif

    menuconfig BSP_USING_PWM
        bool "Enable PWM"
        default n
        select RT_USING_PWM
        if BSP_USING_PWM
        menuconfig BSP_USING_PWM10
            bool "Enable timer10 output PWM"
            default n
            if BSP_USING_PWM10
                config BSP_USING_PWM10_CH1
                    bool "Enable PWM10 channel1"
                    default n
            endif
        endif

    menuconfig BSP_USING_ADC
        bool "Enable ADC"
        default n
        select RT_USING_ADC
        if BSP_USING_ADC
            config BSP_USING_ADC1
                bool "Enable ADC1"
                default n
        endif

    menuconfig BSP_USING_ONCHIP_RTC
        bool "Enable RTC"
        select RT_USING_RTC
        default n
        if BSP_USING_ONCHIP_RTC
            choice BSP_RTC_LS_SEL
                prompt "Select clock source"
                default BSP_RTC_USING_LSE

                config BSP_RTC_USING_LSE
                    bool "RTC USING LSE"

                config BSP_RTC_USING_LSI
                    bool "RTC USING LSI"
            endchoice
        endif

    config BSP_USING_WDT
        bool "Enable Watchdog Timer"
        select RT_USING_WDT
        default n

    config BSP_USING_SDIO
        bool "Enable SDIO"
        select RT_USING_SDIO
        select RT_USING_DFS
        default n

    source "$(BSP_DIR)/../libraries/HAL_Drivers/drivers/Kconfig"

endmenu

menu "Board extended module Drivers"

endmenu


endmenu
```
