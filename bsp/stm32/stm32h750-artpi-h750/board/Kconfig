## bsp/stm32/stm32l4r5-st-nucleo/board/Kconfig
```kconfig
menu "Hardware Drivers Config"

    menu "Onboard Peripheral Drivers"
        config BSP_USING_STLINK_TO_USART
            bool "Enable STLINK TO USART (lpuart1)"
            select BSP_USING_UART
            select BSP_USING_LPUART1
            default y
    endmenu

    menu "On-chip Peripheral Drivers"

        config BSP_USING_GPIO
            bool "Enable GPIO"
            select RT_USING_PIN
            default y

        menuconfig BSP_USING_UART
            bool "Enable UART"
            default y
            select RT_USING_SERIAL
            if BSP_USING_UART
                config BSP_STM32_UART_V1_TX_TIMEOUT
                    int "UART TX timeout"
                    default 2000
                    depends on RT_USING_SERIAL_V1
                    
                config RT_SERIAL_USING_DMA
                    bool "Enable uart using DMA"
                    default n
                config BSP_USING_LPUART1
                    bool "Enable LPUART1"
                    default y
                config BSP_LPUART1_RX_USING_DMA
                    bool "Enable LPUART1 RX DMA"
                    depends on BSP_USING_LPUART1 && RT_SERIAL_USING_DMA
                    default n
                
                menuconfig BSP_USING_UART1
                    bool "Enable UART1"
                    default n
                    if BSP_USING_UART1
                        config BSP_UART1_RX_USING_DMA
                            bool "Enable UART1 RX DMA"
                            depends on BSP_USING_UART1 && RT_SERIAL_USING_DMA
                            default n
    
                        config BSP_UART1_TX_USING_DMA
                            bool "Enable UART1 TX DMA"
                            depends on BSP_USING_UART1 && RT_SERIAL_USING_DMA
                            default n
    
                        config BSP_UART1_RX_BUFSIZE
                            int "Set UART1 RX buffer size"
                            range 64 65535
                            depends on RT_USING_SERIAL_V2
                            default 256
    
                        config BSP_UART1_TX_BUFSIZE
                            int "Set UART1 TX buffer size"
                            range 0 65535
                            depends on RT_USING_SERIAL_V2
                            default 256
    
                        config BSP_UART1_DMA_PING_BUFSIZE
                            int "Set UART1 RX DMA ping-pong buffer size"
                            range 32 65535
                            depends on RT_USING_SERIAL_V2 && BSP_UART1_RX_USING_DMA
                            default 64    
                    endif
    
                menuconfig BSP_USING_UART2
                    bool "Enable UART2"
                    default n
                    if BSP_USING_UART2
                        config BSP_UART2_RX_USING_DMA
                            bool "Enable UART2 RX DMA"
                            depends on BSP_USING_UART2 && RT_SERIAL_USING_DMA
                            default n
    
                        config BSP_UART2_TX_USING_DMA
                            bool "Enable UART2 TX DMA"
                            depends on BSP_USING_UART2 && RT_SERIAL_USING_DMA
                            default n
    
                        config BSP_UART2_RX_BUFSIZE
                            int "Set UART2 RX buffer size"
                            range 64 65535
                            depends on RT_USING_SERIAL_V2
                            default 256
    
                        config BSP_UART2_TX_BUFSIZE
                            int "Set UART2 TX buffer size"
                            range 0 65535
                            depends on RT_USING_SERIAL_V2
                            default 256
    
                        config BSP_UART2_DMA_PING_BUFSIZE
                            int "Set UART2 RX DMA ping-pong buffer size"
                            range 32 65535
                            depends on RT_USING_SERIAL_V2 && BSP_UART2_RX_USING_DMA
                            default 64                        
                    endif
    
                menuconfig BSP_USING_UART3
                    bool "Enable UART3"
                    default n
                    if BSP_USING_UART3
                        config BSP_UART3_RX_USING_DMA
                            bool "Enable UART3 RX DMA"
                            depends on BSP_USING_UART3 && RT_SERIAL_USING_DMA
                            default n
    
                        config BSP_UART3_TX_USING_DMA
                            bool "Enable UART3 TX DMA"
                            depends on BSP_USING_UART3 && RT_SERIAL_USING_DMA
                            default n
                            
                        config BSP_UART3_RX_BUFSIZE
                            int "Set UART3 RX buffer size"
                            range 64 65535
                            depends on RT_USING_SERIAL_V2
                            default 256
    
                        config BSP_UART3_TX_BUFSIZE
                            int "Set UART3 TX buffer size"
                            range 0 65535
                            depends on RT_USING_SERIAL_V2
                            default 256
    
                        config BSP_UART3_DMA_PING_BUFSIZE
                            int "Set UART3 RX DMA ping-pong buffer size"
                            range 32 65535
                            depends on RT_USING_SERIAL_V2 && BSP_UART3_RX_USING_DMA
                            default 64    
                    endif
    
                menuconfig BSP_USING_UART4
                    bool "Enable UART4"
                    default n
                    if BSP_USING_UART4
                        config BSP_UART4_RX_USING_DMA
                            bool "Enable UART4 RX DMA"
                            select RT_SERIAL_USING_DMA
                            default n
    
                        config BSP_UART4_TX_USING_DMA
                            bool "Enable UART4 TX DMA"
                            select RT_SERIAL_USING_DMA
                            default n
    
                        config BSP_UART4_RX_BUFSIZE
                            int "Set UART4 RX buffer size"
                            range 64 65535
                            depends on BSP_USING_UART4
                            default 256
    
                        config BSP_UART4_TX_BUFSIZE
                            int "Set UART4 TX buffer size"
                            range 0 65535
                            depends on BSP_USING_UART4
                            default 0
    
                        config BSP_UART4_DMA_PING_BUFSIZE
                            int "Set UART4 RX DMA ping-pong buffer size"
                            range 32 65535
                            depends on RT_USING_SERIAL_V2 && BSP_UART4_RX_USING_DMA
                            default 64                        
                    endif
    
                menuconfig BSP_USING_UART5
                    bool "Enable UART5"
                    default n
                    if BSP_USING_UART5
                        config BSP_UART5_RX_USING_DMA
                            bool "Enable UART5 RX DMA"
                            select RT_SERIAL_USING_DMA
                            default n
    
                        config BSP_UART5_TX_USING_DMA
                            bool "Enable UART5 TX DMA"
                            select RT_SERIAL_USING_DMA
                            default n
    
                        config BSP_UART5_RX_BUFSIZE
                            int "Set UART5 RX buffer size"
                            range 64 65535
                            depends on BSP_USING_UART5
                            default 256
    
                        config BSP_UART5_TX_BUFSIZE
                            int "Set UART5 TX buffer size"
                            range 0 65535
                            depends on BSP_USING_UART5
                            default 0
    
                        config BSP_UART5_DMA_PING_BUFSIZE
                            int "Set UART5 RX DMA ping-pong buffer size"
                            range 32 65535
                            depends on RT_USING_SERIAL_V2 && BSP_UART5_RX_USING_DMA
                            default 64                        
                    endif
            endif

        config BSP_USING_ON_CHIP_FLASH
            bool "Enable on-chip FLASH"
            default n

        config BSP_USING_USBD
            bool "Enable OTGFS as USB device"
            select RT_USING_USB_DEVICE
            default n

        config BSP_USING_WDT
            bool "Enable Watchdog Timer"
            select RT_USING_WDT
            default n

        menuconfig BSP_USING_ADC
            bool "Enable ADC"
            default n
            select RT_USING_ADC
            if BSP_USING_ADC
                config BSP_USING_ADC1
                    bool "Enable ADC1"
                    default n

            endif

        menuconfig BSP_USING_ONCHIP_RTC
            bool "Enable RTC"
            select RT_USING_RTC
            default n
            if BSP_USING_ONCHIP_RTC
                choice BSP_RTC_LS_SEL
                    prompt "Select clock source"
                    default BSP_RTC_USING_LSE
                    config BSP_RTC_USING_LSE
                        bool "RTC USING LSE"
                    config BSP_RTC_USING_LSI
                        bool "RTC USING LSI"
                endchoice
            endif

        menuconfig BSP_USING_SPI
            bool "Enable SPI BUS"
            default n
            select RT_USING_SPI
            if BSP_USING_SPI
                config BSP_USING_SPI1
                    bool "Enable SPI1 BUS"
                    default n
                config BSP_SPI1_TX_USING_DMA
                    bool "Enable SPI1 TX DMA"
                    depends on BSP_USING_SPI1
                    default n
                config BSP_SPI1_RX_USING_DMA
                    bool "Enable SPI1 RX DMA"
                    depends on BSP_USING_SPI1
                    select BSP_SPI1_TX_USING_DMA
                    default n
                config BSP_USING_SPI2
                    bool "Enable SPI2 BUS"
                    default n
                config BSP_SPI2_TX_USING_DMA
                    bool "Enable SPI2 TX DMA"
                    depends on BSP_USING_SPI2
                    default n
                config BSP_SPI2_RX_USING_DMA
                    bool "Enable SPI2 RX DMA"
                    depends on BSP_USING_SPI2
                    select BSP_SPI2_TX_USING_DMA
                    default n
                config BSP_USING_SPI3
                    bool "Enable SPI3 BUS"
                    default n
                config BSP_SPI3_TX_USING_DMA
                    bool "Enable SPI3 TX DMA"
                    depends on BSP_USING_SPI3
                    default n
                config BSP_SPI3_RX_USING_DMA
                    bool "Enable SPI3 RX DMA"
                    depends on BSP_USING_SPI3
                    select BSP_SPI3_TX_USING_DMA
                    default n
            endif

    menuconfig BSP_USING_SOFT_I2C
        bool "Enable software I2C (swi2c)"
        default n
        select RT_USING_I2C
        select RT_USING_SOFT_I2C
        if BSP_USING_SOFT_I2C
        menuconfig BSP_USING_SOFT_I2C1
            bool "Enable software I2C1 Bus (swi2c1)"
            default n
            select RT_USING_SOFT_I2C1
            if BSP_USING_SOFT_I2C1
                config RT_SOFT_I2C1_SCL_PIN
                    int "swi2c1 SCL pin number"
                    default 100
                config RT_SOFT_I2C1_SDA_PIN
                    int "swi2c1 SDA pin number"
                    default 101
            endif

        menuconfig BSP_USING_SOFT_I2C2
            bool "Enable software I2C2 Bus (swi2c2)"
            default n
            select RT_USING_SOFT_I2C2
            if BSP_USING_SOFT_I2C2
                config RT_SOFT_I2C2_SCL_PIN
                    int "swi2c2 SCL pin number"
                    default 10
                config RT_SOFT_I2C2_SDA_PIN
                    int "swi2c2 SDA pin number"
                    default 11
            endif
        endif
        menuconfig BSP_USING_TIM
            bool "Enable timer"
            default n
            select RT_USING_CLOCK_TIME
            if BSP_USING_TIM
                config BSP_USING_TIM1
                    bool "Enable TIM1"
                    default n
                config BSP_USING_TIM2
                    bool "Enable TIM2"
                    default n
                config BSP_USING_TIM3
                    bool "Enable TIM3"
                    default n
            endif

        menuconfig BSP_USING_PWM
            bool "Using PWM"
            default n
            select RT_USING_PWM
            if BSP_USING_PWM
                config BSP_USING_PWM1
                    bool "Using PWM1"
                    default n
                    if BSP_USING_PWM1
                        config BSP_USING_PWM1_CH1
                            bool "Enable Channel 1 (PA8)"
                            default n
                        config BSP_USING_PWM1_CH2
                            bool "Enable Channel 2 (PA9)"
                            default n
                        config BSP_USING_PWM1_CH3
                            bool "Enable Channel 3 (PA10)"
                            default n
                        config BSP_USING_PWM1_CH4
                            bool "Enable Channel 4 (PA11)"
                            default n
                    endif
            endif
    endmenu

    menu "Board extended module Drivers"

    endmenu

    config RT_SOFT_I2C1_HAS_PIN_DEFAULT
        bool
        default y if RT_USING_SOFT_I2C1

    config RT_SOFT_I2C1_SCL_PIN_DEFAULT
        int
        default 100 if RT_USING_SOFT_I2C1

    config RT_SOFT_I2C1_SDA_PIN_DEFAULT
        int
        default 101 if RT_USING_SOFT_I2C1

    config RT_SOFT_I2C2_HAS_PIN_DEFAULT
        bool
        default y if RT_USING_SOFT_I2C2

    config RT_SOFT_I2C2_SCL_PIN_DEFAULT
        int
        default 10 if RT_USING_SOFT_I2C2

    config RT_SOFT_I2C2_SDA_PIN_DEFAULT
        int
        default 11 if RT_USING_SOFT_I2C2

endmenu
```
