## bsp/essemi/es8p508x/drivers/Kconfig
```kconfig
menu "Hardware Drivers Config"

    menu "On-chip Peripheral Drivers"
        config BSP_USING_GPIO
            bool "Enable GPIO"
            select RT_USING_PIN
            default y

        menu "UART Drivers"
            config BSP_USING_UART0
                bool "Enable UART0 PB00/PB01(R/T)"
                select RT_USING_SERIAL
                default n

            config BSP_USING_UART1
                bool "Enable UART1 PA18/PA17(R/T)"
                select RT_USING_SERIAL
                default n

            config BSP_USING_UART2
                bool "Enable UART2 PA04/PA05(R/T)"
                select RT_USING_SERIAL
                default n

            config BSP_USING_UART3
                bool "Enable UART3 PA30/PA29(R/T)"
                select RT_USING_SERIAL
                default n

            config BSP_USING_UART4
                bool "Enable UART4 PB10/PB11(R/T)"
                select RT_USING_SERIAL
                default n

            config BSP_USING_UART5
                bool "Enable UART5 PB12/PB13(R/T)"
                select RT_USING_SERIAL
                default y
        endmenu

    endmenu

    menu "Onboard Peripheral Drivers"

    endmenu

    menu "Offboard Peripheral Drivers"

    endmenu

endmenu
```

## bsp/fm33lc026/board/Kconfig
```kconfig
menu "Hardware Drivers Config"

config SOC_FM33LC0XX
    bool
    select SOC_SERIES_FM33LC0XX
    select RT_USING_COMPONENTS_INIT
    select RT_USING_USER_MAIN
    default y

menu "On-chip Peripheral Drivers"

    menuconfig BSP_USING_GPIO
        bool "Enable GPIO"
        select RT_USING_PIN
        default y

    menuconfig BSP_USING_UART
        bool "Enable UART"
        default y
        select RT_USING_SERIAL
        if BSP_USING_UART
            config BSP_USING_UART0
                bool "Enable UART0"
                default n

            config BSP_USING_UART1
                bool "Enable UART1"
                default y

            config BSP_USING_UART4
                bool "Enable UART4"
                default n

            config BSP_USING_UART5
                bool "Enable UART5"
                default y

        endif
        endmenu
endmenu
```

## bsp/fm33lc026/libraries/Kconfig
```kconfig
config SOC_FAMILY_FM33
    bool

config SOC_SERIES_FM33LC0XX
    bool
    select ARCH_ARM_CORTEX_M0
    select SOC_FAMILY_FM33
```

## bsp/frdm-k64f/Kconfig
```kconfig
mainmenu "RT-Thread Configuration"

BSP_DIR := .

RTT_DIR := ../..

# you can change the RTT_ROOT default "../.." to your rtthread_root,
# example : default "F:/git_repositories/rt-thread"

PKGS_DIR := packages

source "$(RTT_DIR)/Kconfig"
osource "$PKGS_DIR/Kconfig"

config SOC_FRDM_K64F
    bool
    select ARCH_ARM_CORTEX_M4
    select RT_USING_COMPONENTS_INIT
    default y
```

## bsp/ft2004/Kconfig
```kconfig
mainmenu "RT-Thread Project Configuration"

BSP_DIR := .

RTT_DIR := ../..

PKGS_DIR := packages

source "$(RTT_DIR)/Kconfig"
osource "$PKGS_DIR/Kconfig"


config FT2004
    bool
    select ARCH_ARM_CORTEX_A
    select RT_USING_CACHE
    select RT_USING_COMPONENTS_INIT
    select RT_USING_USER_MAIN
    select RT_USING_GIC_V3
    default y


rsource "./libraries/Kconfig"
```

## bsp/ft2004/libraries/Kconfig
```kconfig
menu "Hardware Drivers Config"

menu "On-chip Peripheral Drivers"
    menuconfig BSP_USING_UART
        bool "Enable UART"
        default y
        select RT_USING_SERIAL
        if BSP_USING_UART
            config RT_USING_UART1
                bool "Enable UART1"
                default y

            config RT_USING_UART0
                bool "Enable UART0"
                default n

        endif

    menuconfig BSP_USING_SDC
        bool "Enable sd controller"
        select RT_USING_SDIO
        select RT_USING_DFS
        select RT_USING_DFS_ELMFAT
        default n

        if BSP_USING_SDC

            config BSP_SDC_DEBUG_PRINT
                bool "Enable sd controller debug print"
                default n


            config BSP_SDC_USE_IRQ
                bool "Use interrupt to handle when cmd complete, dma complete"
                default n

            if BSP_SDC_USE_IRQ
                config BSP_SDC_IRQ_CARD_REMOVE
                    bool "Use interrupt to determine if the card is pulled out"
                    default n

            endif

        endif

    menuconfig BSP_USING_GMAC
        bool "Enable gmac"
        default n
        select RT_USING_NETDEV


        if BSP_USING_GMAC
            config BSP_USING_GMAC0
                bool "Enable GMAC0"
                default y

            config BSP_USING_GMAC1
                bool "Enable GMAC1"
                default n

            config RT_LWIP_ETH_PAD_SIZE
                int "set lwip ETH_PAD_SIZE"
                range 2 256
                default 2

            config RAW_DATA_PRINT
                bool "Enable mac raw data print"
                default n

                if RAW_DATA_PRINT
                    config ETH_RX_DUMP
                        bool "Enable gmac receive raw data print "
                        default n

                    config ETH_TX_DUMP
                        bool "Enable gmac send raw data print "
                        default n
                endif

        endif


    # menuconfig BSP_USE_QSPI
    #     bool "Enable Qspi"
    #     select RT_USING_SFUD
    #     select RT_SFUD_USING_QSPI
    #     default n

    #     if BSP_USE_QSPI
    #         config BSP_QSPI_DEBUG
    #             bool "Enable qspi debug print"
    #             default n
    #     endif

    menuconfig BSP_USE_SPI
        bool "Enable Spi"
        select RT_USING_SFUD
        select RT_SFUD_USING_SPI
        select RT_SFUD_USING_SFDP
        select RT_SFUD_USING_FLASH_INFO_TABLE
        select BSP_USE_GPIO
        default n
        if BSP_USE_SPI
            config BSP_SPI_DEBUG
                bool "Enable spi debug print"
                default n
        endif

    menuconfig BSP_USE_GPIO
        bool "Enable Gpio"
        default n
        if BSP_USE_GPIO
            config BSP_GPIO_DEBUG
                bool "Enable gpio debug print"
                default n
        endif

    menuconfig BSP_USE_CAN
        bool "Enable Can"
        select RT_USING_CAN
        default n

        if BSP_USE_CAN
            config BSP_USING_CAN0
                bool "Enable can0"
                default n
            config BSP_USING_CAN1
                bool "Enable can1"
                default n

            if BSP_USING_CAN0
                config BSP_USING_CAN0_DEBUG
                    bool "Enable can0 work in loop back"
                    default n
            endif

        endif


endmenu

menu "Board extended module Drivers"

endmenu

endmenu
```

## bsp/ft32/ft32f072xb-starter/board/Kconfig
```kconfig
menu "Hardware Drivers Config"

config SOC_SERIES_FT32F0
    bool
    default y

config SOC_FT32F072RB
    bool
    select SOC_SERIES_FT32F0
    select RT_USING_COMPONENTS_INIT
    select RT_USING_USER_MAIN
    default y

menu "Onboard Peripheral Drivers"

endmenu

menu "On-chip Peripheral Drivers"

    config BSP_USING_GPIO
        bool "Enable GPIO"
        select RT_USING_PIN
        default y

    menuconfig BSP_USING_UART
        bool "Enable UART"
        default y
        if BSP_USING_UART
            choice
                prompt "Select UART framework version"
                default BSP_USING_SERIAL_V1
                
                config BSP_USING_SERIAL_V1
                    bool "Use Serial V1 framework"
                    select RT_USING_SERIAL
                    
                config BSP_USING_SERIAL_V2
                    bool "Use Serial V2 framework"
                    select RT_USING_SERIAL_V2
            endchoice

            menuconfig BSP_USING_UART1
                bool "Enable UART1"
                default n

            menuconfig BSP_USING_UART2
                bool "Enable UART2"
                default y
        endif

    source "$(BSP_DIR)/../libraries/Drivers/Kconfig"

endmenu

menu "Board extended module Drivers"

endmenu

endmenu
```

## bsp/ft32/ft32f407xe-starter/Kconfig
```kconfig
mainmenu "RT-Thread Configuration"

BSP_DIR := .

RTT_DIR := ../../..

PKGS_DIR := packages

source "$(RTT_DIR)/Kconfig"
osource "$PKGS_DIR/Kconfig"
rsource "../libraries/Kconfig"
rsource "board/Kconfig"
```

## bsp/ft32/libraries/Drivers/Kconfig
```kconfig
if BSP_USING_USBD
    config BSP_USBD_TYPE_FS
        bool
        # "USB Full Speed (FS) Core"
    config BSP_USBD_TYPE_HS
        bool
        # "USB High Speed (HS) Core"

    config BSP_USBD_SPEED_HS
        bool
        # "USB High Speed (HS) Mode"
    config BSP_USBD_SPEED_HSINFS
        bool
        # "USB High Speed (HS) Core in FS mode"

    config BSP_USBD_PHY_EMBEDDED
        bool
        # "Using Embedded phy interface"
    config BSP_USBD_PHY_UTMI
        bool
        # "UTMI: USB 2.0 Transceiver Macrocell Interace"
    config BSP_USBD_PHY_ULPI
        bool
        # "ULPI: UTMI+ Low Pin Interface"
endif

config BSP_USING_CRC
    bool "Enable CRC (CRC-32 0x04C11DB7 Polynomial)"
    select RT_USING_HWCRYPTO
    select RT_HWCRYPTO_USING_CRC
    # "Crypto device frame dose not support above 8-bits granularity"
    depends on (SOC_SERIES_FT32F0)
    default n
```

## bsp/ft32/libraries/Kconfig
```kconfig
config SOC_FAMILY_FT32
    bool

config SOC_SERIES_FT32F0
    bool
    select ARCH_ARM_CORTEX_M0
    select SOC_FAMILY_FT32
    select PKG_USING_FT32F0_STD_DRIVER

config SOC_SERIES_FT32F4
    bool
    select ARCH_ARM_CORTEX_M4
    select SOC_FAMILY_FT32
    select PKG_USING_FT32F4_STD_DRIVER
```
