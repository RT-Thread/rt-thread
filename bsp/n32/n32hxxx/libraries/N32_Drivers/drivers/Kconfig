## bsp/n32/n32l43xrl-stb/board/Kconfig
```kconfig
menu "Hardware Drivers Config"

config SOC_SERIES_N32L43X
    bool
    default y

config SOC_N32L43X
    bool
    select SOC_SERIES_N32L43X
    select RT_USING_COMPONENTS_INIT
    select RT_USING_USER_MAIN
    default y

menu "Onboard Peripheral Drivers"

endmenu

menu "On-chip Peripheral Drivers"

    config BSP_USING_GPIO
        bool "Enable GPIO"
        select RT_USING_PIN
        default y

    menuconfig BSP_USING_UART
        bool "Enable UART"
        default y
        select RT_USING_SERIAL
        if BSP_USING_UART
            config BSP_USING_USART1
                bool "Enable USART1"
                default y

            config BSP_USING_USART2
                bool "Enable USART2"
                default n

            config BSP_USING_USART3
                bool "Enable USART3"
                default n

            config BSP_USING_UART4
                bool "Enable UART4"
                default n

            config BSP_USING_UART5
                bool "Enable UART5"
                default n

        endif

    menuconfig BSP_USING_SPI
        bool "Enable SPI BUS"
        default n
        select RT_USING_SPI
        if BSP_USING_SPI
            config BSP_USING_SPI1
                bool "Enable SPI1 BUS"
                default n

            config BSP_USING_SPI2
                bool "Enable SPI2 BUS"
                default n

        endif

    menuconfig BSP_USING_I2C1
        bool "Enable I2C1 BUS (software simulation)"
        default n
        select RT_USING_I2C
        select RT_USING_I2C_BITOPS
        select RT_USING_PIN
        if BSP_USING_I2C1
            config BSP_I2C1_SCL_PIN
                int "i2c1 scl pin number"
                range 0 64
                default 22

            config BSP_I2C1_SDA_PIN
                int "I2C1 sda pin number"
                range 0 64
                default 23
        endif

    menuconfig BSP_USING_RTC
        bool "Enable RTC"
        select RT_USING_RTC
        default n
        if BSP_USING_RTC
            choice
                prompt "Select clock source"
                default BSP_RTC_USING_LSE

                config BSP_RTC_USING_LSE
                    bool "RTC USING LSE"

                config BSP_RTC_USING_HSE
                    bool "RTC USING HSE"

                config BSP_RTC_USING_LSI
                    bool "RTC USING LSI"
            endchoice
        endif

    config BSP_USING_WDT
        bool "Enable Watchdog Timer"
        select RT_USING_WDT
        default n

    menuconfig BSP_USING_HWTIMER
        bool "Enable hwtimer"
        default n
        select RT_USING_HWTIMER
        if BSP_USING_HWTIMER
            config BSP_USING_HWTIMER1
                bool "using hwtimer1"
                default n

            config BSP_USING_HWTIMER2
                bool "using hwtimer2"
                default n

            config BSP_USING_HWTIMER3
                bool "using hwtimer3"
                default n

            config BSP_USING_HWTIMER4
                bool "using hwtimer4"
                default n

            config BSP_USING_HWTIMER5
                bool "using hwtimer5"
                default n

            config BSP_USING_HWTIMER6
                bool "using hwtimer6"
                default n

            config BSP_USING_HWTIMER7
                bool "using hwtimer7"
                default n

            config BSP_USING_HWTIMER8
                bool "using hwtimer8"
                default n

            config BSP_USING_HWTIMER9
                bool "using hwtimer9"
                default n
        endif

    config BSP_USING_ADC
        bool "Enable ADC"
        select RT_USING_ADC
        default n

    config BSP_USING_DAC
        bool "Enable DAC"
        select RT_USING_DAC
        default n

    config BSP_USING_CAN
        bool "Enable CAN"
        select RT_USING_CAN
        default n

    #-----------------------------PWM----------------------------------
    menuconfig BSP_USING_PWM
        bool "Enable PWM"
        default n
        select RT_USING_PWM
        select RT_USING_HWTIMER
        if BSP_USING_PWM
        menuconfig BSP_USING_TIM1_PWM
            bool "Enable TIM1 output PWM"
            default n
            # --------------selcet remap-----------------
            if BSP_USING_TIM1_PWM
                config BSP_USING_TIM1_PWM_CH1
                    bool "Enable TIM1 channel1 PA8 AF2"
                    default n
                config BSP_USING_TIM1_PWM_CH2
                    bool "Enable TIM1 channel2 PA9 AF2"
                    default n
                config BSP_USING_TIM1_PWM_CH3
                    bool "Enable TIM1 channel3 PA10 AF2"
                    default n
                config BSP_USING_TIM1_PWM_CH4
                    bool "Enable TIM1 channel4 PA11 AF2"
                    default n
            endif#BSP_USING_TIM1_PWM
        

        menuconfig BSP_USING_TIM2_PWM
            bool "Enable TIM2 output PWM"
            default n
            if BSP_USING_TIM2_PWM
                config BSP_USING_TIM2_PWM_CH1
                    bool "Enable TIM2 channel1"
                    default n
                    if BSP_USING_TIM2_PWM_CH1
                        choice
                        prompt "Select Pin"
                        default TIM2_PWM_CH1_PA0
                        config TIM2_PWM_CH1_PA0
                            bool "PA0 AF2"
                        config TIM2_PWM_CH1_PA15
                            bool "PA15 AF5"
                        endchoice
                    endif
                config BSP_USING_TIM2_PWM_CH2
                    bool "Enable TIM2 channel2"
                    default n
                    if BSP_USING_TIM2_PWM_CH2
                        choice
                        prompt "Select Pin"
                        default TIM2_PWM_CH2_PA1
                        config TIM2_PWM_CH2_PA1
                            bool "PA1 AF2"
                        config TIM2_PWM_CH2_PB3
                            bool "PB3 AF2"
                        endchoice
                    endif
                config BSP_USING_TIM2_PWM_CH3
                    bool "Enable TIM2 channel3"
                    default n
                    if BSP_USING_TIM2_PWM_CH3
                        choice
                        prompt "Select Pin"
                        default TIM2_PWM_CH3_PA2
                        config TIM2_PWM_CH3_PA2
                            bool "PA2 AF2"
                        config TIM2_PWM_CH3_PB10
                            bool "PB10 AF2"
                        endchoice
                    endif
                config BSP_USING_TIM2_PWM_CH4
                    bool "Enable TIM2 channel3 AF2 PB11"
                    default n
            endif#BSP_USING_TIM2_PWM

        menuconfig BSP_USING_TIM3_PWM
            bool "Enable TIM3 output PWM"
            default n
            if BSP_USING_TIM3_PWM
                config BSP_USING_TIM3_PWM_CH1
                    bool "Enable TIM3 channel1"
                    default n
                    if BSP_USING_TIM3_PWM_CH1
                        choice
                        prompt "Select Pin"
                        default TIM3_PWM_CH1_PA6
                        config TIM3_PWM_CH1_PA6
                            bool "PA6 AF2"
                        config TIM3_PWM_CH1_PB4
                            bool "PB4 AF2"
                        config TIM3_PWM_CH1_PC6
                            bool "PC6 AF5"
                        endchoice
                    endif
                config BSP_USING_TIM3_PWM_CH2
                    bool "Enable TIM3 channel2"
                    default n
                    if BSP_USING_TIM3_PWM_CH2
                        choice
                        prompt "Select Pin"
                        default TIM3_PWM_CH2_PA7
                        config TIM3_PWM_CH2_PA7
                            bool "PA7 AF2"
                        config TIM3_PWM_CH2_PB5
                            bool "PB5 AF2"
                        config TIM3_PWM_CH2_PC7
                            bool "PC7 AF2"
                        endchoice
                    endif
                config BSP_USING_TIM3_PWM_CH3
                    bool "Enable TIM3 channel3"
                    default n
                    if BSP_USING_TIM3_PWM_CH3
                        choice
                        prompt "Select Pin"
                        default TIM3_PWM_CH3_PB0
                        config TIM3_PWM_CH3_PB0
                            bool "PB0 AF2"
                        config TIM3_PWM_CH3_PC8
                            bool "PC8 AF2"
                        endchoice
                    endif
                config BSP_USING_TIM3_PWM_CH4
                    bool "Enable TIM3 channel3 AF2 PB11"
                    default n
                    if BSP_USING_TIM3_PWM_CH4
                        choice
                        prompt "Select Pin"
                        default TIM3_PWM_CH4_PB1
                        config TIM3_PWM_CH4_PB1
                            bool "PB1 AF2"
                        config TIM3_PWM_CH4_PC9
                            bool "PC9 AF2"
                        endchoice
                    endif
            endif  #BSP_USING_TIM3_PWM
        endif#BSP_USING_PWM
        
    rsource "../../libraries/n32_drivers/Kconfig"

endmenu

menu "Board extended module Drivers"

endmenu

endmenu
```

## bsp/n32g452xx/Kconfig
```kconfig
mainmenu "RT-Thread Configuration"

config BSP_DIR
    string
    option env="BSP_ROOT"
    default "."

config RTT_DIR
    string
    option env="RTT_ROOT"
    default "../.."

config PKGS_DIR
    string
    option env="PKGS_ROOT"
    default "packages"

source "$RTT_DIR/Kconfig"
source "$PKGS_DIR/Kconfig"

config SOC_N32G452XX
    bool 
    select RT_USING_COMPONENTS_INIT
    select RT_USING_USER_MAIN
    default y
    
config RT_USING_UART1
    bool "Using UART1"
    select RT_USING_SERIAL
    default y

config RT_USING_UART2
    bool "Using UART2"
    select RT_USING_SERIAL
    default n

config RT_USING_UART3
    bool "Using UART3"
    select RT_USING_SERIAL
    default n
    
config RT_USING_UART4
    bool "Using UART4"
    select RT_USING_SERIAL
    default n
```

## bsp/n32g452xx/libraries/Kconfig
```kconfig
config SOC_FAMILY_N32
    bool

config SOC_SERIES_N32G452XX
    bool
    select ARCH_ARM_CORTEX_M4
    select SOC_FAMILY_N32
```
