## bsp/allwinner/libraries/sunxi-hal/hal/source/gpadc/Kconfig
```kconfig
menu "GPADC Devices"

config DRIVERS_GPADC
    bool "enable gpadc driver"
        default y

config HAL_TEST_GPADC
    bool "enable gpadc hal APIs test command"
    depends on DRIVERS_GPADC
        default n

endmenu
```

## bsp/allwinner/libraries/sunxi-hal/hal/source/gpio/Kconfig
```kconfig
menu "GPIO Devices"

config DRIVERS_GPIO
    bool "enable gpio driver"
        default y

config HAL_TEST_GPIO
    bool "enable gpio hal APIs test command"
    depends on DRIVERS_GPIO
        default n

endmenu
```

## bsp/allwinner/libraries/sunxi-hal/hal/source/hwspinlock/Kconfig
```kconfig
menu "HW SPINLOCK Devices"

config DRIVERS_HWSPINLOCK
    bool "enable hwspinlock driver"
        default n

endmenu
```

## bsp/allwinner/libraries/sunxi-hal/hal/source/intc/Kconfig
```kconfig
menu "INTC driver"

config DRIVERS_INTC
    bool "enable INTC driver"
    default n

menu "INTC option features"

config DRIVERS_INTC_FEATURE_1
    bool "INTC feature 1"
    select DRIVERS_INTC
    default n

endmenu

endmenu
```

## bsp/allwinner/libraries/sunxi-hal/hal/source/ir/Kconfig
```kconfig
menu "IR Devices"

config DRIVERS_IR
    bool "enable ir driver"
        default y

config HAL_TEST_IR
    bool "enable ir hal APIs test command"
    depends on DRIVERS_IR
        default n

endmenu
```

## bsp/allwinner/libraries/sunxi-hal/hal/source/ledc/Kconfig
```kconfig
menu "LEDC Devices"

config DRIVERS_LEDC
    bool "enable ledc driver"
        default y
endmenu
```

## bsp/allwinner/libraries/sunxi-hal/hal/source/lradc/Kconfig
```kconfig
menu "LRADC Devices"

config DRIVERS_LRADC
    bool "enable lradc driver"
        default y

config HAL_TEST_LRADC
    bool "enable lradc hal APIs test command"
    depends on DRIVERS_LRADC
        default n

endmenu
```

## bsp/allwinner/libraries/sunxi-hal/hal/source/mbus/Kconfig
```kconfig
menu "MBUS Devices"

config DRIVERS_MBUS
    bool "enable mbus driver"
        default y

if DRIVERS_MBUS
    config DRIVERS_MBUS_GPU_BW
        bool "mbus gpu bandwidth"
        default n
    config DRIVERS_MBUS_RV_SYS_BW
        bool "mbus riscv sys bandwidth"
        default n
    config DRIVERS_MBUS_MAHB_BW
        bool "mbus mahb bandwidth"
        default n
    config DRIVERS_MBUS_DMA_BW
        bool "mbus dma bandwidth"
        default n
    config DRIVERS_MBUS_CE_BW
        bool "mbus ce bandwidth"
        default n
    config DRIVERS_MBUS_TVD_BW
        bool "mbus tvd bandwidth"
        default n
    config DRIVERS_MBUS_CSI_BW
        bool "mbus csi bandwidth"
        default n
    config DRIVERS_MBUS_DSP_SYS_BW
        bool "mbus dsp sys bandwidth"
        default n
    config DRIVERS_MBUS_G2D_BW
        bool "mbus g2d bandwidth"
        default n
    config DRIVERS_MBUS_DI_BW
        bool "mbus di bandwidth"
        default n
    config DRIVERS_MBUS_IOMMU_BW
        bool "mbus iommu bandwidth"
        default n
endif

config HAL_TEST_MBUS
    bool "enable mbus hal APIs test command"
    depends on DRIVERS_MBUS
        default n

endmenu
```

## bsp/allwinner/libraries/sunxi-hal/hal/source/msgbox/Kconfig
```kconfig
menu "Message Box Devices"

config DRIVERS_MSGBOX
    bool "enable Message Box driver"
        default n

config DRIVERS_MSGBOX_SX
    bool "enable Message Box(SX) driver"
    depends on DRIVERS_MSGBOX
        default n

config DRIVERS_MSGBOX_AMP
    bool "enable Message Box(amp) driver"
    depends on DRIVERS_MSGBOX
        default n

endmenu
```

## bsp/allwinner/libraries/sunxi-hal/hal/source/prcm/Kconfig
```kconfig
menu "PRCM Devices"

config DRIVERS_PRCM
    bool "enable prcm driver"
        default y

config HAL_TEST_PRCM
    bool "enable prcm hal APIs test command"
    depends on DRIVERS_PRCM
        default n

endmenu
```

## bsp/allwinner/libraries/sunxi-hal/hal/source/pwm/Kconfig
```kconfig
menu "PWM Devices"

config DRIVERS_PWM
    bool "enable pwm driver"
        default y

config HAL_TEST_PWM
    bool "enable pwm hal APIs test command"
    depends on DRIVERS_PWM
        default n

endmenu
```
