## bsp/phytium/libraries/standalone/drivers/iopad/Kconfig
```kconfig
    config ENABLE_IOPAD
        bool
        prompt "Enable iopad"
        default y if TARGET_E2000
```

## bsp/phytium/libraries/standalone/drivers/ipc/Kconfig
```kconfig
config ENABLE_FSEMAPHORE
    bool
    prompt "Use FSemaphore"
    default n
    depends on TARGET_E2000S || TARGET_E2000D || TARGET_E2000Q || TARGET_T2000Q
    help
        Select FSemaphore driver component
	
	
```

## bsp/phytium/libraries/standalone/drivers/media/Kconfig
```kconfig
menu "Media Configuration"
    config ENABLE_FDC_DP
        bool
        prompt "USE FMEDIA"
        default n
        help
            Select fdcdp driver component

    config ENABLE_FDC_DP_USE_LIB
        bool
        prompt "USE FMEDIA LIB TO LINK"
        default n
        help
            Select fdcdp driver component
    

endmenu
```

## bsp/phytium/libraries/standalone/drivers/mio/Kconfig
```kconfig
menu "Hardware Mio Configuration"
    config ENABLE_MIO
        bool
        prompt "Use Mio"
        depends on TARGET_E2000 || TARGET_TARDIGRADE

        default n
endmenu
```

## bsp/phytium/libraries/standalone/drivers/mmc/Kconfig
```kconfig
config ENABLE_FSDMMC
    bool
    prompt "Use FSdmmc"
    default n
    depends on USE_SDMMC
    help
        Select FSdmmc driver component

config ENABLE_FSDIO
    bool
    prompt "Use FSdio"
    default n
    depends on USE_SDMMC
    help
        Select FSdio driver component
	
	
```

## bsp/phytium/libraries/standalone/drivers/nand/Kconfig
```kconfig
menu "NAND Configuration"
    menu "FNAND ip config"
        choice
        prompt "choice fnand driver"
        config ENABLE_FNAND
            bool
            prompt "Use FNAND"

        if ENABLE_FNAND
            config FNAND_COMMON_DEBUG_EN
                bool
                prompt "Use FNAND common mode debug"

            config FNAND_DMA_DEBUG_EN
                bool
                prompt "Use FNAND DMA mode debug"

            config FNAND_TOGGLE_DEBUG_EN
                bool
                prompt "Use FNAND toggle mode debug"

            config FNAND_ONFI_DEBUG_EN
                bool
                prompt "Use FNAND onfi mode debug"

        endif

        endchoice
    endmenu

endmenu
```

## bsp/phytium/libraries/standalone/drivers/pcie/Kconfig
```kconfig
menu "Pcie Configuration"
    config ENABLE_F_PCIE
        bool
        prompt "Use F_PCIE"
        default n

endmenu
```

## bsp/phytium/libraries/standalone/drivers/pwm/Kconfig
```kconfig
menu "FPWM Configuration"
    config USE_FPWM
        bool
        prompt "Use FPWM"
        default n

endmenu
```

## bsp/phytium/libraries/standalone/drivers/qspi/Kconfig
```kconfig
menu "Qspi Configuration"
    config USE_FQSPI
        bool
        prompt "Use FQSPI"
        default n  
    
endmenu
```

## bsp/phytium/libraries/standalone/drivers/rtc/Kconfig
```kconfig
menu "FRTC Configuration"
    config ENABLE_FRTC
        bool
        prompt "Use FRTC"
        default n

endmenu
```

## bsp/phytium/libraries/standalone/drivers/sata/Kconfig
```kconfig
menu "FSATA Configuration"
    config ENABLE_FSATA
        bool
        prompt "Use FSATA"
        default n

endmenu
```

## bsp/phytium/libraries/standalone/drivers/scmi/Kconfig
```kconfig
menu "Scmi Configuration"
    config ENABLE_SCMI_MHU
        bool
        prompt "Use Scmi MHU"
        default n
        
endmenu
```

## bsp/phytium/libraries/standalone/drivers/serial/Kconfig
```kconfig
menu "Usart Configuration"
    config ENABLE_Pl011_UART
        bool
        prompt "Use Pl011 uart"
        default n
        
endmenu
```

## bsp/phytium/libraries/standalone/drivers/spi/Kconfig
```kconfig
config USE_FSPIM
    bool
    prompt "Use FSPIM"
    default n
    depends on USE_SPI
    help
        Select FSPIM driver component
```

## bsp/phytium/libraries/standalone/drivers/timer/Kconfig
```kconfig
menu "Hardware Timer Configuration"
    config ENABLE_TIMER_TACHO
        bool
        prompt "Use Timer Tacho"
        depends on TARGET_E2000S || TARGET_E2000D || TARGET_E2000Q || TARGET_T2000Q

        default n
endmenu
```

## bsp/phytium/libraries/standalone/drivers/usb/Kconfig
```kconfig
config ENABLE_USB_FXHCI
    bool
    prompt "Use USB3.0 Host(FUSB_HC_XHCI)"
    default n
    depends on USE_USB
    help
        Select USB FUSB_HC_XHCI Host driver component
```

## bsp/phytium/libraries/standalone/drivers/watchdog/Kconfig
```kconfig
menu "FWDT Configuration"
    config USE_FWDT
        bool
        prompt "Use FWDT"
        default n

endmenu
```

## bsp/phytium/libraries/system_example/Kconfig
```kconfig
menu "System Example"
    config BSP_USING_SYSTEM_EXAMPLE
        bool "Enable system example"
        default n
        if BSP_USING_SYSTEM_EXAMPLE
            config BSP_USING_OPENAMP_EXAMPLE
                bool "Enable OpenAMP Example"
                default n
        endif
endmenu
```

## bsp/qemu-riscv-virt64/Kconfig
```kconfig
mainmenu "RT-Thread Project Configuration"

config BSP_DIR
    string
    option env="BSP_ROOT"
    default "."

config RTT_DIR
    string
    option env="RTT_ROOT"
    default "../../"

config PKGS_DIR
    string
    option env="PKGS_ROOT"
    default "packages"

source "$RTT_DIR/Kconfig"
source "$PKGS_DIR/Kconfig"

config BOARD_virt
    bool
    select ARCH_RISCV64
    select RT_USING_COMPONENTS_INIT
    select RT_USING_USER_MAIN
    default y

config RT_USING_USERSPACE
    bool
    default y

source "driver/Kconfig"

config __STACKSIZE__
    int "stack size for interrupt"
    default 4096
```

## bsp/qemu-vexpress-a9/Kconfig
```kconfig
mainmenu "RT-Thread Project Configuration"

BSP_DIR := .

RTT_DIR := ../..

PKGS_DIR := packages

source "$(RTT_DIR)/Kconfig"
osource "$PKGS_DIR/Kconfig"
source "$(BSP_DIR)/drivers/Kconfig"
```

## bsp/qemu-vexpress-a9/drivers/Kconfig
```kconfig
menu "Hardware Drivers Config"

config SOC_VEXPRESS_A9
    bool
    select ARCH_ARM_CORTEX_A9
    select RT_USING_CACHE
    select ARCH_ARM_MMU
    select RT_USING_COMPONENTS_INIT
    select RT_USING_USER_MAIN
    select RT_USING_GIC_V2
    default y

menu "Onboard Peripheral Drivers"
    menuconfig BSP_USING_UART
        bool "Enable UART"
        default y
        select RT_USING_SERIAL
        if BSP_USING_UART
            menuconfig BSP_USING_UART0
                bool "Enable UART0 (Debugger)"
                default y
                if BSP_USING_UART0
                    config BSP_UART0_RX_BUFSIZE
                        int "Set UART0 RX buffer size"
                        range 64 65535
                        depends on RT_USING_SERIAL_V2
                        default 1024

                    config BSP_UART0_TX_BUFSIZE
                        int "Set UART0 TX buffer size"
                        range 0 65535
                        depends on RT_USING_SERIAL_V2
                        default 0
                endif

            menuconfig BSP_USING_UART1
                bool "Enable UART1"
                default n
                if BSP_USING_UART1
                    config BSP_UART1_RX_BUFSIZE
                        int "Set UART1 RX buffer size"
                        range 64 65535
                        depends on RT_USING_SERIAL_V2
                        default 1024

                    config BSP_UART1_TX_BUFSIZE
                        int "Set UART1 TX buffer size"
                        range 0 65535
                        depends on RT_USING_SERIAL_V2
                        default 0
                endif

            menuconfig BSP_USING_UART2
                bool "Enable UART2"
                default n
                if BSP_USING_UART2
                    config BSP_UART2_RX_BUFSIZE
                        int "Set UART2 RX buffer size"
                        range 64 65535
                        depends on RT_USING_SERIAL_V2
                        default 1024

                    config BSP_UART2_TX_BUFSIZE
                        int "Set UART2 TX buffer size"
                        range 0 65535
                        depends on RT_USING_SERIAL_V2
                        default 0
                endif

            menuconfig BSP_USING_UART3
                bool "Enable UART3"
                default n
                if BSP_USING_UART3
                    config BSP_UART3_RX_BUFSIZE
                        int "Set UART3 RX buffer size"
                        range 64 65535
                        depends on RT_USING_SERIAL_V2
                        default 1024

                    config BSP_UART3_TX_BUFSIZE
                        int "Set UART3 TX buffer size"
                        range 0 65535
                        depends on RT_USING_SERIAL_V2
                        default 0
                endif

        endif

    config BSP_USING_LVGL
        bool "Enable LVGL for LCD"
        select PKG_USING_LVGL
        select BSP_DRV_CLCD
        select BSP_DRV_MOUSE
        default n

    if BSP_USING_LVGL
        config BSP_USING_LVGL_DEMO
            bool "Enable LVGL demo"
            select PKG_USING_LV_MUSIC_DEMO
            default y
    endif

    config BSP_DRV_CLCD
        bool "CLCD driver"
        select RT_USING_LCD
        default n

    config BSP_DRV_MOUSE
        bool "MOUSE driver"
        default n

    if BSP_DRV_CLCD
        config BSP_LCD_WIDTH
            int "Width of LCD panel"
            default 640

        config BSP_LCD_HEIGHT
            int "Height of LCD panel"
            default 480
    endif

    config BSP_DRV_EMAC
        bool "Enable EMAC driver"
        select RT_USING_LWIP
        select RT_USING_POSIX_FS
        select RT_USING_POSIX_SOCKET
        default n

    config BSP_DRV_AUDIO
        bool "Audio driver"
        select RT_USING_AUDIO
        default n

    endmenu

endmenu
```

## bsp/qemu-vexpress-gemini/Kconfig
```kconfig
mainmenu "RT-Thread Project Configuration"

config BSP_DIR
    string
    option env="BSP_ROOT"
    default "."

config RTT_DIR
    string
    option env="RTT_ROOT"
    default "../.."

config PKGS_DIR
    string
    option env="PKGS_ROOT"
    default "packages"

source "$RTT_DIR/Kconfig"
source "$PKGS_DIR/Kconfig"

config SOC_VEXPRESS_GEMINI
    bool
    select ARCH_ARM_CORTEX_A9
    select RT_USING_COMPONENTS_INIT
    # select RT_USING_USER_MAIN
    default y

source "$BSP_DIR/drivers/Kconfig"
```

## bsp/qemu-vexpress-gemini/drivers/Kconfig
```kconfig
config RT_USING_UART0
    bool "Enable UART0"
    default n

config RT_USING_UART1
    bool "Enable UART1"
    default y
```

## bsp/qemu-virt-rv64/driver/Kconfig
```kconfig
menu "General Purpose UARTs"

menuconfig BSP_USING_UART1
    bool "Enable UART1"
    default n
    if BSP_USING_UART1
        config BSP_UART1_TXD_PIN
            int "uart1 TXD pin number"
            default 20
        config BSP_UART1_RXD_PIN
            int "uart1 RXD pin number"
            default 21
    endif

endmenu
```
