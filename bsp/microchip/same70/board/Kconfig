## bsp/microchip/same70/board/Kconfig
```kconfig
menu "Hardware Drivers Config"

choice
    prompt "select chip type"
    default SOC_SAME70Q21

    config SOC_SAME70Q21
    bool "SOC_SAME70Q21"
    help
        Refer to SAME70 DataSheet

    config SOC_SAME70N21
    bool "SOC_SAME70N21"
    help
        Refer to SAME70 DataSheet

    config SOC_SAME70J21
    bool "SOC_SAME70J21"
    help
        Refer to SAME70 DataSheet

endchoice
endmenu

menu "Onboard Peripheral Drivers"
    config SAME70_CAN0
        bool "Enable CAN0"
        default false

    config SAME70_ADC0
        bool "Enable ADC0"
        default false

    config SAME70_I2C0
        bool "Enable I2C0"
        default false

    config SAME70_GMAC
        bool "Enable GMAC"
        default false
endmenu

menu "Application Demo Config"
    config SAM_CAN_EXAMPLE
        bool "Enable SAM CAN Example"
        depends on SAME70_CAN0
        default true
        help
            Add CAN example task to project

    config SAM_ADC_EXAMPLE
        bool "Enable SAM ADC Example"
        depends on SAME70_ADC0
        default true
        help
            Add ADC example task to project

    config SAM_I2C_EXAMPLE
        bool "Enable SAM I2C Example"
        depends on SAME70_I2C0
        default true
        help
            Add I2C example task to project

    config SAM_LWIP_EXAMPLE
        bool "Enable SAM LWIP Example"
        depends on SAME70_GMAC
        default false
        help
            Add GMAC LWIP example task to project

endmenu
```

## bsp/microchip/saml10/Kconfig
```kconfig
mainmenu "RT-Thread Configuration"

BSP_DIR := .

RTT_DIR := ../../..

# you can change the RTT_ROOT default: "rt-thread"

PKGS_DIR := packages

source "$(RTT_DIR)/Kconfig"
osource "$PKGS_DIR/Kconfig"
rsource "board/Kconfig"

config SOC_SAML10
    bool
    select ARCH_ARM
    select ARCH_ARM_CORTEX_M
    select RT_USING_COMPONENTS_INIT
    select RT_USING_USER_MAIN
    default y
```

## bsp/microchip/saml10/board/Kconfig
```kconfig
menu "Hardware Drivers Config"

choice
    prompt "select chip type"
    default SOC_SAML10E16

    config SOC_SAML10E16
    bool "SOC_SAML10E16"
    help
        Refer to SAML10 DataSheet

    config SOC_SAML10E15
    bool "SOC_SAML10E15"
    help
        Refer to SAML10 DataSheet

    config SOC_SAML10E14
    bool "SOC_SAML10E14"
    help
        Refer to SAML10 DataSheet

    config SOC_SAML10D16
    bool "SOC_SAML10D16"
    help
        Refer to SAML10 DataSheet

    config SOC_SAML10D15
    bool "SOC_SAML10D15"
    help
        Refer to SAML10 DataSheet

    config SOC_SAML10D14
    bool "SOC_SAML10D14"
    help
        Refer to SAML10 DataSheet
endchoice
endmenu

menu "Onboard Peripheral Drivers"
    depends on SOC_SAML10E16

    config SAML10_ADC0
        bool "Enable ADC0"
        default false

    config SAML10_I2C0
        bool "Enable I2C0"
        default false

endmenu

menu "Application Demo Config"
    config SAM_ADC_EXAMPLE
        bool "Enable SAM ADC Example"
        depends on SAML10_ADC0
        default true
        help
            Add ADC example task to project

    config SAM_I2C_EXAMPLE
        bool "Enable SAM I2C Example"
        depends on SAML10_I2C0
        default true
        help
            Add I2C example task to project
endmenu
```

## bsp/mimxrt1050-evk/KConfig
```kconfig
mainmenu "RT-Thread Configuration"

config $BSP_DIR
    string
    option env="BSP_ROOT"
    default "."

config $RTT_DIR
    string
    option env="RTT_ROOT"
    default "../.."

config $PKGS_DIR
    string
    option env="PKGS_ROOT"
    default "packages"

source "$RTT_DIR/KConfig"
source "$PKGS_DIR/KConfig"

menu "BSP_SPECIAL CONFIG"

config RT_USING_UART
    bool "Using RT_USING_UART"
    default y

if RT_USING_UART
config RT_USING_UART1
    bool "Using RT_USING_UART1"
    default y      
endif
    
endmenu



    
    
```

## bsp/mini2440/Kconfig
```kconfig
mainmenu "RT-Thread Project Configuration"

BSP_DIR := .

RTT_DIR := ../..

PKGS_DIR := packages

config BOARD_MINI2440
    bool
    select ARCH_ARM_ARM9
    select RT_USING_CACHE
    select RT_USING_COMPONENTS_INIT
    select RT_USING_USER_MAIN
    default y

choice
    prompt "Lcd for mini2440"
    default RT_MINI2440_LCD_T35
    depends on PKG_USING_GUIENGINE

    config RT_MINI2440_LCD_A70
        bool "A70"

    config RT_MINI2440_LCD_T43
        bool "T43"

    config RT_MINI2440_LCD_N35
        bool "N35"

    config RT_MINI2440_LCD_T35
        bool "T35"

    config RT_MINI2440_LCD_X35
        bool "X35"
endchoice

source "$(RTT_DIR)/Kconfig"
osource "$PKGS_DIR/Kconfig"
```

## bsp/mipssim/Kconfig
```kconfig
mainmenu "RT-Thread Configuration"

BSP_DIR := .

RTT_DIR := ../..

# you can change the RTT_ROOT default "../.." to your rtthread_root,
# example : default "F:/git_repositories/rt-thread"

PKGS_DIR := packages

source "$(RTT_DIR)/Kconfig"
source "$(RTT_DIR)/libcpu/mips/common/Kconfig"
osource "$PKGS_DIR/Kconfig"

config MIPSSIM
    bool
    select ARCH_MIPS
    select RT_USING_COMPONENTS_INIT
    select RT_USING_USER_MAIN
    select RT_USING_DEVICE
    default y
```

## bsp/mm32/libraries/Kconfig
```kconfig
config SOC_FAMILY_MM32
    bool

config SOC_SERIES_MM32F103
    bool
    select ARCH_ARM_CORTEX_M3
    select SOC_FAMILY_MM32
    select PKG_USING_MM32F103XX_CMSIS
    select PKG_USING_MM32F103XX_HAL_DRIVER

config SOC_SERIES_MM32F327
    bool
    select ARCH_ARM_CORTEX_M3
    select SOC_FAMILY_MM32
    select PKG_USING_MM32F3270X_CMSIS
    select PKG_USING_MM32F3270X_HAL_DRIVER

config SOC_SERIES_MM32F3277
    bool
    select ARCH_ARM_CORTEX_M3
    select SOC_FAMILY_MM32
    select PKG_USING_MM32F3270X_CMSIS
    select PKG_USING_MM32F3270X_HAL_DRIVER

config SOC_SERIES_MM32F526
    bool
    select ARCH_ARM_CORTEX_M33
    select SOC_FAMILY_MM32
    select PKG_USING_MM32F5260X_CMSIS
    select PKG_USING_MM32F5260X_HAL_DRIVER

config SOC_SERIES_MM32L0
    bool
    select ARCH_ARM_CORTEX_M0
    select SOC_FAMILY_MM32
    select PKG_USING_MM32L0XX_CMSIS
    select PKG_USING_MM32L0XX_HAL_DRIVER

config SOC_SERIES_MM32L3
    bool
    select ARCH_ARM_CORTEX_M3
    select SOC_FAMILY_MM32
    select PKG_USING_MM32L3XX_CMSIS
    select PKG_USING_MM32L3XX_HAL_DRIVER
```

## bsp/mm32/mm32f3270-100ask-pitaya/board/Kconfig
```kconfig
menu "Hardware Drivers Config"

config SOC_MM32F3277
    bool
    select SOC_SERIES_MM32F3277
    select RT_USING_COMPONENTS_INIT
    select RT_USING_USER_MAIN
    default y

menu "Onboard Peripheral Drivers"

    config BSP_USING_USB_TO_USART
        bool "Enable USB TO USART (uart1)"
        select BSP_USING_UART
        select BSP_USING_UART1
        default y

    config BSP_USING_USER_LED
        bool "Enable User LED (pa1)"
        select RT_USING_PIN
        default y

    config BSP_USING_USER_KEY
        bool "Enable User Key (pa0)"
        select RT_USING_PIN
        default y
endmenu

menu "On-chip Peripheral Drivers"

    config BSP_USING_GPIO
        bool "Enable GPIO"
        select RT_USING_PIN
        default y

    menuconfig BSP_USING_UART
        bool "Enable UART"
        default y
        select RT_USING_SERIAL
        if BSP_USING_UART
            config BSP_USING_UART1
                bool "Enable UART1"
                default y
            config BSP_USING_UART2
                bool "Enable UART2"
                default n
            config BSP_USING_UART3
                bool "Enable UART3"
                default n
        endif

    rsource "../../libraries/HAL_Drivers/Kconfig"

endmenu

menu "Board extended module Drivers"

endmenu

endmenu
```

## bsp/mm32/mm32f327x/Kconfig
```kconfig
mainmenu "RT-Thread Configuration"

BSP_DIR := .

RTT_DIR := ../../..

PKGS_DIR := packages

config SOC_MM32F3277
    bool
    select SOC_SERIES_MM32F3277
    select RT_USING_COMPONENTS_INIT
    select RT_USING_USER_MAIN
    default y

source "$(RTT_DIR)/Kconfig"
osource "$PKGS_DIR/Kconfig"
rsource "../libraries/Kconfig"
rsource "board/Kconfig"
```

## bsp/mm32/mm32f526x/Kconfig
```kconfig
mainmenu "RT-Thread Configuration"

BSP_DIR := .

RTT_DIR := ../../..

PKGS_DIR := packages

config SOC_MM32F526x
    bool
    select SOC_SERIES_MM32F526
    select RT_USING_COMPONENTS_INIT
    select RT_USING_USER_MAIN
    default y

source "$(RTT_DIR)/Kconfig"
osource "$PKGS_DIR/Kconfig"
rsource "../libraries/Kconfig"
rsource "board/Kconfig"
```

## bsp/mm32/mm32l07x/Kconfig
```kconfig
mainmenu "RT-Thread Configuration"

BSP_DIR := .

RTT_DIR := ../../..

PKGS_DIR := packages

config SOC_MM32L073
    bool
    select SOC_SERIES_MM32L0
    select RT_USING_COMPONENTS_INIT
    select RT_USING_USER_MAIN
    default y

source "$(RTT_DIR)/Kconfig"
osource "$PKGS_DIR/Kconfig"
rsource "../libraries/Kconfig"
rsource "board/Kconfig"
```

## bsp/mm32f327x/Kconfig
```kconfig
mainmenu "RT-Thread Configuration"

BSP_DIR := .

RTT_DIR := ../..

PKGS_DIR := packages

source "$(RTT_DIR)/Kconfig"
osource "$PKGS_DIR/Kconfig"
rsource "drivers/Kconfig"

config SOC_MM32F373
    bool
    select RT_USING_COMPONENTS_INIT
    select RT_USING_USER_MAIN
    default y
```

## bsp/mm32f327x/drivers/Kconfig
```kconfig
menu "Hardware Drivers Config"
    menu "On-chip Peripheral Drivers"
	
        menu "GPIO Drivers"
            config BSP_USING_GPIO
                bool "Enable GPIO"
                select RT_USING_PIN
                default n
        endmenu
		
        menu "UART Drivers"
            config BSP_USING_UART1
                bool "Enable UART1 PA9/10(T/R)"
                select RT_USING_SERIAL
                default n
            config BSP_USING_UART2
                bool "Enable UART2 PA2/3(T/R)"
                select RT_USING_SERIAL
                default y
        endmenu
		
        menuconfig BSP_USING_ADC
            bool "Enable ADC"
            default n
            select RT_USING_ADC
            if BSP_USING_ADC
                config BSP_USING_ADC1
                    bool "Enable ADC1"
                    default n
    
                config BSP_USING_ADC2
                    bool "Enable ADC2"
                    default n
            endif

        menu "Flash Drivers"
            config BSP_USING_OCFLASH
                bool "Enable On Chip Flash"
                default n
            config OCFLASH_USE_FAL
                bool "Enable On Chip Flash FAL Driver"
                depends on BSP_USING_OCFLASH
                select RT_USING_FAL
                default n
            config OCFLASH_USE_LFS
                bool "Enable On Chip Flash DFS Driver"
                depends on OCFLASH_USE_FAL
                select RT_USING_DFS
                select RT_USING_MTD_NOR
                select PKG_USING_LITTLEFS
                default n
        endmenu
    endmenu
endmenu
```

## bsp/mm32l07x/drivers/Kconfig
```kconfig
menu "Hardware Drivers Config"

    menu "On-chip Peripheral Drivers"

        menu "UART Drivers"
            config BSP_USING_UART1
                bool "Enable UART1 PA9/10(T/R)"
                select RT_USING_SERIAL
                default n
        
            config BSP_USING_UART2
                bool "Enable UART2 PA2/3(T/R)"
                select RT_USING_SERIAL
                default y
        endmenu 
    endmenu
        
endmenu
```

## bsp/mm32l3xx/drivers/Kconfig
```kconfig
menu "Hardware Drivers Config"

    menu "On-chip Peripheral Drivers"
        menu "GPIO Drivers"
            config BSP_USING_GPIO
                bool "Enable GPIO"
                select RT_USING_PIN
                default n
        endmenu
        menu "UART Drivers"
            config BSP_USING_UART1
                bool "Enable UART1 PA9/10(T/R)"
                select RT_USING_SERIAL
                default n

            config BSP_USING_UART2
                bool "Enable UART2 PA2/3(T/R)"
                select RT_USING_SERIAL
                default y
        endmenu
    endmenu

endmenu
```

## bsp/msp432e401y-LaunchPad/board/Kconfig
```kconfig
menu "Hardware Drivers Config"

config  msp432e401y
    bool
    select RT_USING_COMPONENTS_INIT
    select RT_USING_USER_MAIN
    default y

menu "On-chip Peripheral Drivers"

    config BSP_USING_GPIO
        bool "Enable GPIO"
        select RT_USING_PIN
        default y

    menuconfig BSP_USING_UART
        bool "Enable UART"
        default y
        select RT_USING_SERIAL
        if BSP_USING_UART
            config BSP_USING_UART0
                bool "Enable UART0"
                default y

            config BSP_USING_UART1
                bool "Enable UART1"
                default n

            config BSP_UART1_RX_USING_DMA
                bool "Enable UART1 RX DMA"
                depends on BSP_USING_UART1 && RT_SERIAL_USING_DMA
                default n

            config BSP_USING_UART2
                bool "Enable UART2"
                default n

            config BSP_UART2_RX_USING_DMA
                bool "Enable UART2 RX DMA"
                depends on BSP_USING_UART2 && RT_SERIAL_USING_DMA
                default n
                
            config BSP_USING_UART3
                bool "Enable UART3"
                default n

            config BSP_UART3_RX_USING_DMA
                bool "Enable UART3 RX DMA"
                depends on BSP_USING_UART3 && RT_SERIAL_USING_DMA
                default n  
        endif
endmenu

menu "Board extended module Drivers"

endmenu

endmenu
```
