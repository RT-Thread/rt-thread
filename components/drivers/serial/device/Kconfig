## components/drivers/virtio/Kconfig
```kconfig
menuconfig RT_USING_VIRTIO
    bool "Using VirtIO device drivers"
    depends on RT_USING_DM
    depends on RT_USING_DMA
    default n

config RT_VIRTIO_TRANSPORT_MMIO
    bool "Using VirtIO MMIO transport"
    depends on RT_USING_VIRTIO
    depends on RT_USING_OFW
    default y

config RT_VIRTIO_TRANSPORT_PCI
    bool "Using VirtIO PCI transport"
    depends on RT_USING_VIRTIO
    depends on RT_USING_PCI
    default y
    help
      We not support the version of 0.95 in PCI. The minimum version >= 1.0

config RT_VIRTIO_NET
    bool "VirtIO Net"
    depends on RT_USING_VIRTIO
    depends on RT_USING_ETHERNET
    default y

config RT_VIRTIO_BLK
    bool "VirtIO BLK"
    depends on RT_USING_VIRTIO
    depends on RT_USING_BLK
    default y

config RT_VIRTIO_CONSOLE
    bool "VirtIO Console"
    depends on RT_USING_VIRTIO
    depends on RT_USING_SERIAL
    select RT_USING_DEVICE_IPC
    select RT_USING_SYSTEM_WORKQUEUE
    default y

config RT_VIRTIO_RNG
    bool "VirtIO RNG"
    depends on RT_USING_VIRTIO
    depends on RT_USING_HWCRYPTO
    depends on RT_HWCRYPTO_USING_RNG
    default y

config RT_VIRTIO_SCSI
    bool "VirtIO SCSI"
    depends on RT_USING_VIRTIO
    depends on RT_SCSI_SD || RT_SCSI_CDROM
    default y

config RT_VIRTIO_9P
    bool "VirtIO 9P"
    depends on RT_USING_VIRTIO
    select RT_USING_DFS_9PFS
    default y

config RT_VIRTIO_RPROC_SERIAL
    bool "VirtIO Remoteproc Serial Link"
    depends on RT_USING_VIRTIO
    select RT_VIRTIO_CONSOLE
    default y

config RT_VIRTIO_GPU
    bool "VirtIO GPU"
    depends on RT_USING_VIRTIO
    default y

config RT_VIRTIO_INPUT
    bool "VirtIO Input"
    depends on RT_USING_VIRTIO
    depends on RT_USING_INPUT
    depends on RT_INPUT_TOUCHSCREEN
    default y

config RT_VIRTIO_CRYPTO
    bool "VirtIO Crypto"
    depends on RT_USING_VIRTIO
    depends on RT_USING_HWCRYPTO
    depends on RT_HWCRYPTO_USING_AES
    depends on RT_HWCRYPTO_USING_AES_ECB
    depends on RT_HWCRYPTO_USING_AES_CBC
    depends on RT_HWCRYPTO_USING_AES_CTR
    depends on RT_HWCRYPTO_USING_DES
    depends on RT_HWCRYPTO_USING_DES_ECB
    depends on RT_HWCRYPTO_USING_DES_CBC
    depends on RT_HWCRYPTO_USING_3DES
    depends on RT_HWCRYPTO_USING_3DES_ECB
    depends on RT_HWCRYPTO_USING_3DES_CBC
    depends on RT_HWCRYPTO_USING_RC4
    default y

config RT_VIRTIO_SCMI
    bool "VirtIO SCMI"
    depends on RT_USING_VIRTIO
    depends on RT_FIRMWARE_ARM_SCMI
    default y
```

## components/drivers/watchdog/Kconfig
```kconfig
menuconfig RT_USING_WDT
    bool "Using Watch Dog device drivers"
    default n
    help
      Enable the common watchdog device layer so watchdog-capable SoCs or
      external supervisors can be exposed through the RT-Thread `rt_watchdog`
      APIs. Selecting this option allows watchdog platform drivers to register
      /dev/wdt style devices, lets applications query/set timeout windows, and
      integrates watchdog notifications into the driver-model (DM) probe/remove
      flow. Disable it only when the hardware has no watchdog or it is managed
      entirely outside of RT-Thread, because the system will no longer be able
      to arm, feed or inspect watchdogs during boot and runtime.

config RT_WDT_DW
    bool "Synopsys DesignWare watchdog"
    depends on RT_USING_DM
    depends on RT_USING_WDT
    depends on RT_USING_RESET
    default n
    help
      Build the driver for Synopsys DesignWare watchdog blocks that appear in
      many ARM and RISC-V SoCs. The driver maps the DM platform resources,
      exports the 16 preset timeout levels ("TOPs"), supports optional pre-
      timeout interrupts, and automatically toggles the associated reset line
      through `RT_USING_RESET`. Once started the DW watchdog cannot be disabled,
      so the driver only gates the peripheral clock and pulses the reset
      controller to keep it under control. Use this when your device tree
      exposes a `snps,dw-wdt` node and you need either reset-based system
      recovery or two-stage IRQ/Reset supervision; otherwise leave it off.

config RT_WDT_I6300ESB
    bool "Intel 6300ESB Timer/Watchdog"
    depends on RT_USING_DM
    depends on RT_USING_WDT
    depends on RT_USING_PCI
    help
      Enable support for the watchdog integrated in Intel 6300ESB southbridge
      chipsets. The driver binds to the PCI device, unlocks the dual-stage timer,
      and exposes the 1 kHz heartbeat window (1–2046 seconds) through the
      standard watchdog IOCTLs. It can optionally enter "nowayout" mode when the
      firmware locks the control register, so be careful when testing on shared
      x86 hardware. Select this only on boards that actually contain the 6300ESB
      watchdog because the driver directly touches PCI config space and assumes
      the LPC reset registers are routed correctly.

if RT_USING_DM && RT_USING_WDT
    osource "$(SOC_DM_WDT_DIR)/Kconfig"
endif
```

## components/drivers/wlan/Kconfig
```kconfig
menuconfig RT_USING_WIFI
    bool "Using Wi-Fi framework"
    default n
    help
      Enable the RT-Thread Wi-Fi middleware which manages STA/AP interfaces,
      connection profiles, protocol glue, workqueues, and debugging hooks.

    if RT_USING_WIFI
        config RT_WLAN_DEVICE_STA_NAME
            string "The device name for station"
            default "wlan0"
            help
              Logical device name used for the station interface.

        config RT_WLAN_DEVICE_AP_NAME
            string "The device name for ap"
            default "wlan1"
            help
              Logical device name for the SoftAP interface.

        config RT_WLAN_SSID_MAX_LENGTH
            int "SSID maximum length"
            default 32
            help
              Upper bound for SSID strings stored by the framework.

        config RT_WLAN_PASSWORD_MAX_LENGTH
            int "Password maximum length"
            default 32
            help
              Maximum length of passphrases saved in configs.

        config RT_WLAN_DEV_EVENT_NUM
            int "Driver events maxcount"
            default 2
            help
              Number of event objects reserved for notifying upper layers.

        config RT_WLAN_MANAGE_ENABLE
            bool "Connection management Enable"
            default y
            help
              Turn on the connection manager (auto reconnect, scanning, CLI).

        if RT_WLAN_MANAGE_ENABLE
            config RT_WLAN_SCAN_WAIT_MS
                int "Set scan timeout time(ms)"
                default 10000
                help
                  Timeout for synchronous scan requests in milliseconds.

            config RT_WLAN_CONNECT_WAIT_MS
                int "Set connect timeout time(ms)"
                default 10000
                help
                  Connection attempt timeout.

            config RT_WLAN_SCAN_SORT
                bool "Automatic sorting of scan results"
                default y
                help
                  Sort scan results by RSSI/channel automatically.

            config RT_WLAN_MSH_CMD_ENABLE
                bool "MSH command Enable"
                default y
                help
                  Add msh shell commands (`wifi`, etc.) for management.

            config RT_WLAN_JOIN_SCAN_BY_MGNT
                bool "Enable wlan join scan"
                default y
                help
                  Allow connection manager to trigger scans before joining.

            config RT_WLAN_AUTO_CONNECT_ENABLE
                bool "Auto connect Enable"
                select RT_WLAN_CFG_ENABLE
                select RT_WLAN_WORK_THREAD_ENABLE
                default y
                help
                  Automatically reconnect using saved profiles when link drops.

            if RT_WLAN_AUTO_CONNECT_ENABLE
                config AUTO_CONNECTION_PERIOD_MS
                    int "Auto connect period(ms)"
                    default 2000
                    help
                      Interval between automatic reconnect attempts.
            endif
        endif

        config RT_WLAN_CFG_ENABLE
            bool "WiFi information automatically saved Enable"
            default y
            help
              Persist Wi-Fi credentials and settings to storage.

        if RT_WLAN_CFG_ENABLE
            config RT_WLAN_CFG_INFO_MAX
                int "Maximum number of WiFi information automatically saved"
                default 3
                help
                  Maximum number of networks stored for auto-connect.
        endif

        config RT_WLAN_PROT_ENABLE
            bool "Transport protocol manage Enable"
            default y
            help
              Allow protocol modules (lwIP, etc.) to register with WLAN core.

        if RT_WLAN_PROT_ENABLE
            config RT_WLAN_PROT_NAME_LEN
                int "Transport protocol name length"
                default 8
                help
                  Max length for protocol identifier strings.

            config RT_WLAN_PROT_MAX
                int "Transport protocol maxcount"
                default 2
                help
                  Number of protocol backends that can be registered.

            config RT_WLAN_DEFAULT_PROT
                string "Default transport protocol"
                default "lwip"
                help
                  Name of the protocol backend used when none specified.

            config RT_WLAN_PROT_LWIP_ENABLE
                bool "LWIP transport protocol Enable"
                select RT_USING_LWIP
                default y
                help
                  Register lwIP as a transport backend for WLAN sockets.

            if RT_WLAN_PROT_LWIP_ENABLE
                config RT_WLAN_PROT_LWIP_NAME
                    string "LWIP transport protocol name"
                    default "lwip"
                    help
                      Name exported for the lwIP backend.

                config RT_WLAN_PROT_LWIP_PBUF_FORCE
                    bool "Forced use of PBUF transmission"
                    default n
                    help
                      Force PBUF-based data path even when zero-copy is possible.
            endif
        endif

        config RT_WLAN_WORK_THREAD_ENABLE
            bool "WLAN work queue thread Enable"
            default y
            help
              Spawn the WLAN workqueue thread that handles asynchronous tasks.

        if RT_WLAN_WORK_THREAD_ENABLE
            config RT_WLAN_WORKQUEUE_THREAD_NAME
                string "WLAN work queue thread name"
                default "wlan"
                help
                  Name of the workqueue thread.

            config RT_WLAN_WORKQUEUE_THREAD_SIZE
                int "WLAN work queue thread size"
                default 2048
                help
                  Stack size in bytes for the workqueue thread.

            config RT_WLAN_WORKQUEUE_THREAD_PRIO
                int "WLAN work queue thread priority"
                default 15
                help
                  RT-Thread priority of the WLAN workqueue.
        endif

        menuconfig RT_WLAN_DEBUG
            bool "Enable WLAN Debugging Options"
            default n
            help
              Enable fine-grained debug switches for WLAN subsystems.

        if RT_WLAN_DEBUG
            config RT_WLAN_CMD_DEBUG
                bool "Enable Debugging of wlan_cmd.c"
                default n
                help
                  Log detailed info from the command module.

            config RT_WLAN_MGNT_DEBUG
                bool "Enable Debugging of wlan_mgnt.c"
                default n
                help
                  Debug connection management state transitions.

            config RT_WLAN_DEV_DEBUG
                bool "Enable Debugging of wlan_dev.c"
                default n
                help
                  Trace driver-level operations.

            config RT_WLAN_PROT_DEBUG
                bool "Enable Debugging of wlan_prot.c"
                default n
                help
                  Dump protocol manager operations.

            config RT_WLAN_CFG_DEBUG
                bool "Enable Debugging of wlan_cfg.c"
                default n
                help
                  Trace configuration load/save.

            config RT_WLAN_LWIP_DEBUG
                bool "Enable Debugging of wlan_lwip.c"
                default n
                help
                  Print lwIP glue logs.
        endif
    endif
```

## components/fal/Kconfig
```kconfig
# Kconfig file for package fal
menuconfig RT_USING_FAL
    bool "FAL: flash abstraction layer"
    default n

if RT_USING_FAL
    config FAL_USING_DEBUG
        bool "Enable debug log output"
        default y if RT_USING_DEBUG
        default n

    config FAL_PART_HAS_TABLE_CFG
        bool "FAL partition table config has defined on 'fal_cfg.h'"
        default y
        help
            If defined partition table on 'fal_cfg.h' please enable this option.
            When this option is disable, it will auto find and load the partition table
            on a specified location in flash partition.

    if !FAL_PART_HAS_TABLE_CFG

        config FAL_PART_TABLE_FLASH_DEV_NAME
            string "The flash device which saving partition table"
            default "onchip"
             help
                It will auto find the partition table on this flash device.

        config FAL_PART_TABLE_END_OFFSET
            int "The patition table end address relative to flash device offset."
            default 65536
            help
                The auto find and load the partition table process is forward from this
                offset address on flash.

    endif

    config FAL_USING_SFUD_PORT
        bool "FAL uses SFUD drivers"
        default n
        help
            The fal_flash_sfud_port.c in the samples\porting directory will be used.

    if FAL_USING_SFUD_PORT
        config FAL_USING_NOR_FLASH_DEV_NAME
            string "The name of the device used by FAL"
            default "norflash0"
    endif

    config FAL_DEV_NAME_MAX
        int "FAL device/partition name max length"
        default 24
        range 8 128
        help
            Configure the maximum length of flash/partition device name used by FAL.
            This value corresponds to macro FAL_DEV_NAME_MAX.
            Increase it if your flash device name or partition name is longer.
            Note: Larger value may increase memory usage in some implementations.

    config FAL_DEV_BLK_MAX
        int "FAL max flash device blocks"
        default 6
        range 1 32
        help
            Configure the maximum number of flash device blocks managed by FAL.
            This value corresponds to macro FAL_DEV_BLK_MAX.
            If you have multiple flash devices (onchip/spi-nor/spi-nand, etc.)
            or multiple underlying blocks, increase this value accordingly.
            Note: Larger value may increase RAM/ROM usage.

endif
```
