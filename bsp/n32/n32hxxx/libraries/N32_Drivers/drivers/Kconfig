## bsp/nrf5x/nrf5340/Kconfig
```kconfig
mainmenu "RT-Thread Configuration"

BSP_DIR := .

RTT_DIR := ../../..

PKGS_DIR := packages

rsource "board/Kconfig"
source "$(RTT_DIR)/Kconfig"
osource "$PKGS_DIR/Kconfig"
```
