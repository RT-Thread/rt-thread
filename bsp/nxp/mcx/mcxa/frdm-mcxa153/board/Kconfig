## bsp/nxp/mcx/mcxn/frdm-mcxn947/board/Kconfig
```kconfig
menu "Hardware Drivers Config"

config SOC_MCXN947
    bool
    select SOC_MCXN947_SERIES
    select RT_USING_COMPONENTS_INIT
    select RT_USING_USER_MAIN
    default y

menu "On-chip Peripheral Drivers"

    config BSP_USING_DMA
        bool "Enable DMA"
        select RT_USING_DMA
        default n

    config BSP_USING_PIN
        bool "Enable GPIO"
        select RT_USING_PIN
        default y

    menuconfig BSP_USING_UART
        bool "Enable UART"
        default y
        select RT_USING_SERIAL
        if BSP_USING_UART
            config BSP_USING_UART4
                bool "Enable UART4"
                default y

            config BSP_USING_UART5
                bool "Enable UART5"
                default n

            config BSP_USING_UART2
                bool "Enable UART2"
                default n

        endif

    menuconfig BSP_USING_I2C
        config BSP_USING_I2C
            bool "Enable I2C"
            select RT_USING_I2C
            default y

            if BSP_USING_I2C
                config BSP_USING_I2C0
                    bool "Enable Flexcomm0 I2C"
                    default y
                config BSP_USING_I2C1
                    bool "Enable Flexcomm1 I2C"
                    default y
            endif

    menuconfig BSP_USING_SPI
        config BSP_USING_SPI
            bool "Enable SPI"
            select RT_USING_SPI
            select BSP_USING_PIN
            default y

            if BSP_USING_SPI
                config BSP_USING_SPI1
                    bool "Enable Flexcomm1 as SPI"
                    default n

                config BSP_USING_SPI3
                    bool "Enable Flexcomm3 as SPI"
                    default n

                config BSP_USING_SPI6
                    bool "Enable Flexcomm6 as SPI"
                    default n
                    if BSP_USING_SPI6
                        config BSP_USING_SPI6_SAMPLE
                            bool "Enable SPI6 BUS Sample"
                            default n
                    endif

                config BSP_USING_SPI7
                    bool "Enable Flexcomm7 as SPI"
                    default n
            endif

    menuconfig BSP_USING_ADC
        config BSP_USING_ADC
            bool "Enable ADC Channel"
            select RT_USING_ADC
            default y

            if BSP_USING_ADC
                config BSP_USING_ADC0
                    bool
                    default n

                config BSP_USING_ADC0_CH0
                    bool "Enable ADC0 Channel0"
                    select BSP_USING_ADC0
                    default y

                config BSP_USING_ADC0_CH1
                    bool "Enable ADC0 Channel1"
                    select BSP_USING_ADC0
                    default n

                config BSP_USING_ADC0_CH8
                    bool "Enable ADC0 Channel8"
                    select BSP_USING_ADC0
                    default n

                config BSP_USING_ADC0_CH13
                    bool "Enable ADC0 Channel13"
                    select BSP_USING_ADC0
                    default n

                config BSP_USING_ADC0_CH26
                    bool "Enable ADC0 Channel26"
                    select BSP_USING_ADC0
                    default n

            endif

    menuconfig BSP_USING_DAC
        config BSP_USING_DAC
            bool "Enable DAC Channel"
            select RT_USING_DAC
            default y

            if BSP_USING_DAC
                config BSP_USING_DAC0
                    bool "Enable DAC0 Channel"
                    default n

                config BSP_USING_DAC1
                    bool "Enable DAC1 Channel"
                    default n

                config BSP_USING_DAC2
                    bool "Enable DAC2 Channel"
                    default n

            endif

    config BSP_USING_SDIO
        bool "Enable SDIO SD Card Interface"
        select RT_USING_SDIO
        select RT_USING_DFS
        select RT_USING_DFS_ELMFAT
        default y

    config BSP_USING_ETH
        bool "Enable Ethernet"
        default n
        select RT_USING_LWIP
        select RT_USING_NETDEV
        select RT_USING_SAL

    config BSP_USING_RTC
        bool "Enable RTC"
        select RT_USING_RTC
        default y

    config BSP_USING_WDT
        bool "Enable WatchDog"
        select RT_USING_WDT
        default n

    menuconfig BSP_USING_HWTIMER
        config BSP_USING_HWTIMER
            bool "Enable Timer"
            select RT_USING_HWTIMER
            default y

    menuconfig BSP_USING_PWM
        config BSP_USING_PWM
            bool "Enable PWM"
            select RT_USING_PWM
            default y

            if BSP_USING_PWM
                config BSP_USING_LEDG_PWM
                    bool "Enable on-board green LED as PWM output (pwm0, channel 3)"
                    default y
            endif

    menuconfig BSP_USING_USB
       bool "Enable USB"
       default n
       if BSP_USING_USB
            config BSP_USING_USB_DEVICE
                bool "Enable USB Device, default is msc ramdisk"
                default n
                select RT_USING_CHERRYUSB
                select RT_CHERRYUSB_DEVICE
                select RT_CHERRYUSB_DEVICE_SPEED_HS
                select RT_CHERRYUSB_DEVICE_CHIPIDEA_MCX
                select RT_CHERRYUSB_DEVICE_MSC
                select RT_CHERRYUSB_DEVICE_TEMPLATE_MSC
            config BSP_USING_USB_HOST
                bool "Enable USB Host"
                default n
                select RT_USING_CHERRYUSB
                select RT_CHERRYUSB_HOST
                select RT_CHERRYUSB_HOST_EHCI_MCX
                select RT_CHERRYUSB_HOST_CDC_ACM
                select RT_CHERRYUSB_HOST_HID
                select RT_CHERRYUSB_HOST_MSC
                select RT_CHERRYUSB_HOST_CDC_RNDIS
       endif


endmenu


menu "Board extended module Drivers"
    menuconfig BSP_USING_RW007
        bool "Enable RW007"
        default n
        select BSP_USING_SPI
        select BSP_USING_SPI1
        select PKG_USING_RW007
        select RT_USING_MEMPOOL
        select RW007_NOT_USE_EXAMPLE_DRIVERS

    if BSP_USING_RW007
        config BOARD_RW007_SPI_BUS_NAME
            string "RW007 BUS NAME"
            default "spi1"

        config BOARD_RW007_CS_PIN
            hex "CS pin index"
            default 27

        config BOARD_RW007_INT_BUSY_PIN
            hex "INT/BUSY pin index"
            default 10

        config BOARD_RW007_RST_PIN
            hex "RESET pin index"
            default 28
    endif
endmenu

endmenu
```

## bsp/phytium/aarch32/Kconfig
```kconfig
mainmenu "RT-Thread Project Configuration"

RTT_DIR := ../../..

SDK_DIR := .././libraries/phytium_standalone_sdk

PKGS_DIR := packages

source "$(RTT_DIR)/Kconfig"
osource "$PKGS_DIR/Kconfig"
source "$(BSP_DIR)/../libraries/drivers/Kconfig"

config PHYTIUM_ARCH_AARCH32
    bool
    select ARCH_ARM_CORTEX_A
    select RT_USING_CACHE
    select RT_USING_COMPONENTS_INIT
    select RT_USING_USER_MAIN
    select RT_USING_GIC_V3
    select TARGET_ARMV8_AARCH32
    select USE_AARCH64_L1_TO_AARCH32
    default y

menu "Standalone Setting"
    config TARGET_ARMV8_AARCH32
        bool "Armv8 Aarch32"
        default y
    
    config USE_AARCH64_L1_TO_AARCH32
        bool
        prompt "Use Aarch64 L1 to Aarch32 code"
        default y
        help
            Use the Aarch64 to Aarch32 mode function

    source "$(SDK_DIR)/soc/soc.kconfig"
    source "$(BSP_DIR)/../board/board.kconfig"
    source "$(SDK_DIR)/common/common.kconfig"
endmenu
```

## bsp/phytium/aarch32/defconfig
```kconfig
CONFIG_RT_NAME_MAX=16
CONFIG_RT_USING_SMP=y
CONFIG_RT_CPUS_NR=2
CONFIG_RT_ALIGN_SIZE=4
CONFIG_IDLE_THREAD_STACK_SIZE=4096
CONFIG_RT_TIMER_THREAD_STACK_SIZE=4096
CONFIG_RT_USING_SLAB_AS_HEAP=y
CONFIG_RT_USING_HEAP_ISR=y
CONFIG_RT_MAIN_THREAD_STACK_SIZE=8192
CONFIG_RT_USING_DFS_ELMFAT=y
CONFIG_RT_USING_DFS_RAMFS=y
CONFIG_RT_SYSTEM_WORKQUEUE_STACKSIZE=4096
CONFIG_RT_SERIAL_RB_BUFSZ=1024
CONFIG_RT_USING_NULL=y
CONFIG_RT_USING_ZERO=y
CONFIG_RT_USING_RANDOM=y
CONFIG_RT_USING_PWM=y
CONFIG_RT_USING_RTC=y
CONFIG_RT_USING_POSIX_SELECT=y
CONFIG_RT_USING_POSIX_TERMIOS=y
CONFIG_RT_USING_POSIX_AIO=y
CONFIG_RT_USING_POSIX_TIMER=y
CONFIG_RT_USING_POSIX_PIPE=y
CONFIG_RT_USING_POSIX_MESSAGE_QUEUE=y
CONFIG_RT_USING_POSIX_MESSAGE_SEMAPHORE=y
CONFIG_RT_USING_SAL=y
CONFIG_RT_USING_LWIP=y
CONFIG_RT_USING_LWIP212=y
CONFIG_RT_LWIP_MEM_ALIGNMENT=64
# CONFIG_RT_LWIP_DHCP is not set
CONFIG_RT_LWIP_IPADDR="192.168.4.10"
CONFIG_RT_LWIP_GWADDR="192.168.4.1"
CONFIG_RT_LWIP_PBUF_NUM=512
CONFIG_RT_LWIP_TCPTHREAD_PRIORITY=16
CONFIG_RT_LWIP_TCPTHREAD_STACKSIZE=16184
CONFIG_RT_LWIP_ETHTHREAD_STACKSIZE=8192
CONFIG_RT_LWIP_REASSEMBLY_FRAG=y
CONFIG_RT_USING_RYM=y
CONFIG_RT_USING_UTEST=y
CONFIG_RT_USING_UART0=y
CONFIG_TARGET_E2000D=y
```

## bsp/phytium/aarch64/Kconfig
```kconfig
mainmenu "RT-Thread Project Configuration"

RTT_DIR := ../../..

SDK_DIR:= .././libraries/phytium_standalone_sdk

PKGS_DIR := packages

source "$(RTT_DIR)/Kconfig"
osource "$PKGS_DIR/Kconfig"
source "$(BSP_DIR)/../libraries/drivers/Kconfig"

config BSP_USING_GIC
    bool
    default y
    config BSP_USING_GICV3
        bool
        default y

config PHYTIUM_ARCH_AARCH64
    bool
    select ARCH_ARMV8
    select RT_USING_COMPONENTS_INIT
    select RT_USING_USER_MAIN
    select ARCH_CPU_64BIT
    select RT_USING_CACHE
    select TARGET_ARMV8_AARCH64
    select ARCH_ARM_BOOTWITH_FLUSH_CACHE
    select ARCH_USING_IRQ_CTX_LIST
    select RT_USING_HW_ATOMIC
    default y
    

if TARGET_E2000Q
    config ARM_SPI_BIND_CPU_ID
        int 
        default 2
endif

if TARGET_E2000D
    config ARM_SPI_BIND_CPU_ID
        int 
        default 0
endif

if TARGET_PHYTIUMPI
    config ARM_SPI_BIND_CPU_ID
        int 
        default 2
endif

if RT_USING_SMP

endif

menu "Standalone Setting"
    config TARGET_ARMV8_AARCH64
        bool "Armv8 Aarch64"
        default y

    source "$(SDK_DIR)/soc/soc.kconfig"
    source "$(BSP_DIR)/../board/board.kconfig"
    source "$(SDK_DIR)/common/common.kconfig"

endmenu
```

## bsp/phytium/aarch64/defconfig
```kconfig
CONFIG_RT_NAME_MAX=16
CONFIG_RT_USING_SMP=y
CONFIG_RT_CPUS_NR=2
CONFIG_RT_ALIGN_SIZE=4
CONFIG_IDLE_THREAD_STACK_SIZE=8192
CONFIG_RT_TIMER_THREAD_STACK_SIZE=8192
# CONFIG_RT_DEBUGING_CONTEXT is not set
CONFIG_RT_USING_SLAB_AS_HEAP=y
CONFIG_RT_USING_HEAP_ISR=y
CONFIG_ARCH_TEXT_OFFSET=0x80000
CONFIG_ARCH_RAM_OFFSET=0x80000000
CONFIG_RT_MAIN_THREAD_STACK_SIZE=8192
CONFIG_RT_USING_DFS_ELMFAT=y
CONFIG_RT_USING_DFS_RAMFS=y
CONFIG_RT_USING_DEV_BUS=y
CONFIG_RT_SYSTEM_WORKQUEUE_STACKSIZE=8192
CONFIG_RT_USING_NULL=y
CONFIG_RT_USING_ZERO=y
CONFIG_RT_USING_RANDOM=y
CONFIG_RT_USING_RTC=y
# CONFIG_RT_USING_PIN is not set
CONFIG_RT_USING_POSIX_FS=y
CONFIG_RT_USING_POSIX_TERMIOS=y
CONFIG_RT_USING_POSIX_CLOCK=y
CONFIG_RT_USING_POSIX_TIMER=y
CONFIG_RT_USING_SAL=y
CONFIG_RT_USING_LWIP=y
CONFIG_RT_USING_LWIP212=y
CONFIG_RT_LWIP_MEM_ALIGNMENT=64
# CONFIG_RT_LWIP_DHCP is not set
CONFIG_RT_LWIP_IPADDR="192.168.4.10"
CONFIG_RT_LWIP_GWADDR="192.168.4.1"
CONFIG_RT_LWIP_PBUF_NUM=512
CONFIG_RT_LWIP_TCPTHREAD_PRIORITY=16
CONFIG_RT_LWIP_TCPTHREAD_STACKSIZE=16184
CONFIG_RT_LWIP_ETHTHREAD_STACKSIZE=8192
CONFIG_RT_LWIP_REASSEMBLY_FRAG=y
CONFIG_RT_USING_RYM=y
CONFIG_RT_PAGE_MAX_ORDER=16
CONFIG_PKG_USING_KERNEL_SAMPLES=y
CONFIG_TARGET_E2000D=y
CONFIG_LOG_DEBUG=y
# CONFIG_USE_DEFAULT_INTERRUPT_CONFIG is not set
```
